/dts-v1/;

/ {
	model = "MT6765";
	compatible = "mediatek,MT6765";
	interrupt-parent = <0x01>;
	#address-cells = <0x02>;
	#size-cells = <0x02>;

	chosen {
		bootargs = "console=tty0 console=ttyS0,921600n1 vmalloc=400M slub_debug=OFZPU page_owner=on swiotlb=noforce androidboot.hardware=mt6765 maxcpus=8 loop.max_part=7 firmware_class.path=/vendor/firmware";
		kaslr-seed = <0x00 0x00>;
		linux,phandle = <0x4c>;
		phandle = <0x4c>;
	};

	cpus {
		#address-cells = <0x01>;
		#size-cells = <0x00>;

		cpu@000 {
			device_type = "cpu";
			compatible = "arm,cortex-a53";
			reg = <0x00>;
			enable-method = "psci";
			clock-frequency = <0x89267940>;
			cpu-idle-states = <0x02 0x03 0x04 0x05 0x06 0x07 0x08>;
			linux,phandle = <0x09>;
			phandle = <0x09>;
		};

		cpu@001 {
			device_type = "cpu";
			compatible = "arm,cortex-a53";
			reg = <0x01>;
			enable-method = "psci";
			clock-frequency = <0x89267940>;
			cpu-idle-states = <0x02 0x03 0x04 0x05 0x06 0x07 0x08>;
			linux,phandle = <0x0a>;
			phandle = <0x0a>;
		};

		cpu@002 {
			device_type = "cpu";
			compatible = "arm,cortex-a53";
			reg = <0x02>;
			enable-method = "psci";
			clock-frequency = <0x89267940>;
			cpu-idle-states = <0x02 0x03 0x04 0x05 0x06 0x07 0x08>;
			linux,phandle = <0x0b>;
			phandle = <0x0b>;
		};

		cpu@003 {
			device_type = "cpu";
			compatible = "arm,cortex-a53";
			reg = <0x03>;
			enable-method = "psci";
			clock-frequency = <0x89267940>;
			cpu-idle-states = <0x02 0x03 0x04 0x05 0x06 0x07 0x08>;
			linux,phandle = <0x0c>;
			phandle = <0x0c>;
		};

		cpu@100 {
			device_type = "cpu";
			compatible = "arm,cortex-a53";
			reg = <0x100>;
			enable-method = "psci";
			clock-frequency = <0x6b49d200>;
			cpu-idle-states = <0x02 0x03 0x04 0x05 0x06 0x07 0x08>;
			linux,phandle = <0x0d>;
			phandle = <0x0d>;
		};

		cpu@101 {
			device_type = "cpu";
			compatible = "arm,cortex-a53";
			reg = <0x101>;
			enable-method = "psci";
			clock-frequency = <0x6b49d200>;
			cpu-idle-states = <0x02 0x03 0x04 0x05 0x06 0x07 0x08>;
			linux,phandle = <0x0e>;
			phandle = <0x0e>;
		};

		cpu@102 {
			device_type = "cpu";
			compatible = "arm,cortex-a53";
			reg = <0x102>;
			enable-method = "psci";
			clock-frequency = <0x6b49d200>;
			cpu-idle-states = <0x02 0x03 0x04 0x05 0x06 0x07 0x08>;
			linux,phandle = <0x0f>;
			phandle = <0x0f>;
		};

		cpu@103 {
			device_type = "cpu";
			compatible = "arm,cortex-a53";
			reg = <0x103>;
			enable-method = "psci";
			clock-frequency = <0x6b49d200>;
			cpu-idle-states = <0x02 0x03 0x04 0x05 0x06 0x07 0x08>;
			linux,phandle = <0x10>;
			phandle = <0x10>;
		};

		cpu-map {

			cluster0 {

				core0 {
					cpu = <0x09>;
				};

				core1 {
					cpu = <0x0a>;
				};

				core2 {
					cpu = <0x0b>;
				};

				core3 {
					cpu = <0x0c>;
				};
			};

			cluster1 {

				core0 {
					cpu = <0x0d>;
				};

				core1 {
					cpu = <0x0e>;
				};

				core2 {
					cpu = <0x0f>;
				};

				core3 {
					cpu = <0x10>;
				};
			};
		};

		idle-states {
			entry-method = "arm,psci";

			standby {
				compatible = "arm,idle-state";
				arm,psci-suspend-param = <0x01>;
				entry-latency-us = <0x258>;
				exit-latency-us = <0x258>;
				min-residency-us = <0x4b0>;
				linux,phandle = <0x02>;
				phandle = <0x02>;
			};

			mcdi-cpu {
				compatible = "arm,idle-state";
				arm,psci-suspend-param = <0x10001>;
				entry-latency-us = <0x258>;
				exit-latency-us = <0x258>;
				min-residency-us = <0x4b0>;
				linux,phandle = <0x03>;
				phandle = <0x03>;
			};

			mcdi-cluster {
				compatible = "arm,idle-state";
				arm,psci-suspend-param = <0x1010001>;
				entry-latency-us = <0x258>;
				exit-latency-us = <0x258>;
				min-residency-us = <0x4b0>;
				linux,phandle = <0x04>;
				phandle = <0x04>;
			};

			sodi {
				compatible = "arm,idle-state";
				arm,psci-suspend-param = <0x1010002>;
				entry-latency-us = <0x320>;
				exit-latency-us = <0x3e8>;
				min-residency-us = <0x7d0>;
				linux,phandle = <0x05>;
				phandle = <0x05>;
			};

			sodi3 {
				compatible = "arm,idle-state";
				arm,psci-suspend-param = <0x1010003>;
				entry-latency-us = <0x320>;
				exit-latency-us = <0x3e8>;
				min-residency-us = <0x7d0>;
				linux,phandle = <0x06>;
				phandle = <0x06>;
			};

			dpidle {
				compatible = "arm,idle-state";
				arm,psci-suspend-param = <0x1010004>;
				entry-latency-us = <0x320>;
				exit-latency-us = <0x3e8>;
				min-residency-us = <0x7d0>;
				linux,phandle = <0x07>;
				phandle = <0x07>;
			};

			suspend {
				compatible = "arm,idle-state";
				arm,psci-suspend-param = <0x1010005>;
				entry-latency-us = <0x320>;
				exit-latency-us = <0x3e8>;
				min-residency-us = <0x7d0>;
				linux,phandle = <0x08>;
				phandle = <0x08>;
			};
		};
	};

	psci {
		compatible = "arm,psci-1.0";
		method = "smc";
	};

	pmu {
		compatible = "arm,armv8-pmuv3";
		interrupt-parent = <0x11>;
		interrupts = <0x01 0x07 0x08>;
	};

	l2c_parity {
		compatible = "mediatek,l2c_parity-v1";
		interrupts = <0x00 0x18 0x04 0x00 0x19 0x04>;
	};

	memory {
		device_type = "memory";
		reg = <0x00 0x40000000 0x00 0x20000000>;
	};

	reserved-memory {
		#address-cells = <0x02>;
		#size-cells = <0x02>;
		ranges;
		linux,phandle = <0x4d>;
		phandle = <0x4d>;

		zmc-default {
			compatible = "mediatek,zone_movable_cma";
			size = <0x00 0xffc00000>;
			alignment = <0x00 0x10000000>;
			alloc-ranges = <0x00 0xc0000000 0x01 0x80000000>;
		};

		reserve-memory-sspm_share {
			compatible = "mediatek,reserve-memory-sspm_share";
			no-map;
			status = "okay";
			size = <0x00 0x510000>;
			alignment = <0x00 0x10000>;
			alloc-ranges = <0x00 0x40000000 0x00 0x60000000>;
		};

		reserve-memory-scp_share {
			compatible = "mediatek,reserve-memory-scp_share";
			no-map;
			size = <0x00 0x300000>;
			alignment = <0x00 0x1000000>;
			alloc-ranges = <0x00 0x40000000 0x00 0x50000000>;
		};

		consys-reserve-memory {
			compatible = "mediatek,consys-reserve-memory";
			no-map;
			size = <0x00 0x400000>;
			alignment = <0x00 0x1000000>;
			alloc-ranges = <0x00 0x40000000 0x00 0x80000000>;
		};

		wifi-reserve-memory {
			compatible = "mediatek,wifi-reserve-memory";
			no-map;
			size = <0x00 0x300000>;
			alignment = <0x00 0x1000000>;
			alloc-ranges = <0x00 0x40000000 0x00 0x80000000>;
		};

		soter-shared-mem {
			compatible = "microtrust,shared_mem";
			no-map;
			size = <0x00 0x200000>;
			alloc-ranges = <0x00 0x40000000 0x00 0x50000000>;
		};
	};

	cpu_dbgapb@0d410000 {
		compatible = "mediatek,hw_dbg";
		num = <0x08>;
		reg = <0x00 0xd410000 0x00 0x1000 0x00 0xd510000 0x00 0x1000 0x00 0xd610000 0x00 0x1000 0x00 0xd710000 0x00 0x1000 0x00 0xd810000 0x00 0x1000 0x00 0xd910000 0x00 0x1000 0x00 0xda10000 0x00 0x1000 0x00 0xdb10000 0x00 0x1000>;
		linux,phandle = <0x4e>;
		phandle = <0x4e>;
	};

	atf_logger {
		compatible = "mediatek,atf_logger";
		interrupts = <0x00 0xf7 0x01>;
	};

	amms_control {
		compatible = "mediatek,amms";
		interrupts = <0x00 0x86 0x01>;
	};

	utos {
		compatible = "microtrust,utos";
		interrupts = <0x00 0xf9 0x01 0x00 0xfa 0x01>;
	};

	utos_tester {
		compatible = "microtrust,tester-v1";
	};

	tkcore {
		compatible = "trustkernel,tkcore";
		interrupts = <0x00 0xf8 0x01>;
	};

	plat_sram_flag@0011db00 {
		compatible = "mediatek,plat_sram_flag";
		reg = <0x00 0x10e5f0 0x00 0x10>;
	};

	interrupt-controller@0c000000 {
		compatible = "arm,gic-v3";
		#interrupt-cells = <0x03>;
		#address-cells = <0x02>;
		#size-cells = <0x02>;
		#redistributor-regions = <0x01>;
		interrupt-parent = <0x11>;
		interrupt-controller;
		reg = <0x00 0xc000000 0x00 0x40000 0x00 0xc100000 0x00 0x200000 0x00 0x10200a80 0x00 0x50>;
		interrupts = <0x01 0x09 0x04>;
		linux,phandle = <0x11>;
		phandle = <0x11>;
	};

	intpol-controller@10200a80 {
		compatible = "mediatek,mt6577-sysirq";
		interrupt-controller;
		#interrupt-cells = <0x03>;
		interrupt-parent = <0x11>;
		reg = <0x00 0x10200a80 0x00 0x50>;
		linux,phandle = <0x01>;
		phandle = <0x01>;
	};

	infracfg_ao@10001000 {
		compatible = "mediatek,infracfg_ao\0syscon";
		reg = <0x00 0x10001000 0x00 0x1000>;
		interrupts = <0x00 0x93 0x01>;
		#clock-cells = <0x01>;
		linux,phandle = <0x24>;
		phandle = <0x24>;
	};

	mcdi@0010fc00 {
		compatible = "mediatek,mt6765-mcdi";
		reg = <0x00 0x10fc00 0x00 0x800>;
	};

	scpsys@10001000 {
		compatible = "mediatek,scpsys\0syscon";
		reg = <0x00 0x10001000 0x00 0x1000 0x00 0x10006000 0x00 0x1000 0x00 0x14002000 0x00 0x1000 0x00 0x1020e000 0x00 0x1000 0x00 0x18004000 0x00 0x1000 0x00 0x18002000 0x00 0x1000>;
		#clock-cells = <0x01>;
		linux,phandle = <0x25>;
		phandle = <0x25>;
	};

	topckgen@10000000 {
		compatible = "mediatek,topckgen\0syscon";
		reg = <0x00 0x10000000 0x00 0x1000>;
		#clock-cells = <0x01>;
		linux,phandle = <0x1e>;
		phandle = <0x1e>;
	};

	io_cfg_lt@10002000 {
		compatible = "mediatek,io_cfg_lt";
		reg = <0x00 0x10002000 0x00 0x200>;
	};

	syscfg_pctl_1@0x10002000 {
		compatible = "mediatek,mt6765-pctl-1-syscfg\0syscon";
		reg = <0x00 0x10002000 0x00 0x1000>;
		linux,phandle = <0x13>;
		phandle = <0x13>;
	};

	io_cfg_lm@10002200 {
		compatible = "mediatek,io_cfg_lm";
		reg = <0x00 0x10002200 0x00 0x200>;
	};

	syscfg_pctl_2@0x10002200 {
		compatible = "mediatek,mt6765-pctl-2-syscfg\0syscon";
		reg = <0x00 0x10002200 0x00 0x1000>;
		linux,phandle = <0x14>;
		phandle = <0x14>;
	};

	io_cfg_lb@10002400 {
		compatible = "mediatek,io_cfg_lb";
		reg = <0x00 0x10002400 0x00 0x200>;
	};

	syscfg_pctl_3@0x10002400 {
		compatible = "mediatek,mt6765-pctl-3-syscfg\0syscon";
		reg = <0x00 0x10002400 0x00 0x1000>;
		linux,phandle = <0x15>;
		phandle = <0x15>;
	};

	io_cfg_bl@10002600 {
		compatible = "mediatek,io_cfg_bl";
		reg = <0x00 0x10002600 0x00 0x200>;
	};

	syscfg_pctl_4@0x10002600 {
		compatible = "mediatek,mt6765-pctl-4-syscfg\0syscon";
		reg = <0x00 0x10002600 0x00 0x1000>;
		linux,phandle = <0x16>;
		phandle = <0x16>;
	};

	io_cfg_rr@10002800 {
		compatible = "mediatek,io_cfg_rr";
		reg = <0x00 0x10002800 0x00 0x200>;
	};

	syscfg_pctl_5@0x10002800 {
		compatible = "mediatek,mt6765-pctl-5-syscfg\0syscon";
		reg = <0x00 0x10002800 0x00 0x1000>;
		linux,phandle = <0x17>;
		phandle = <0x17>;
	};

	io_cfg_rb@10002a00 {
		compatible = "mediatek,io_cfg_rb";
		reg = <0x00 0x10002a00 0x00 0x200>;
	};

	syscfg_pctl_6@0x10002a00 {
		compatible = "mediatek,mt6765-pctl-6-syscfg\0syscon";
		reg = <0x00 0x10002a00 0x00 0x1000>;
		linux,phandle = <0x18>;
		phandle = <0x18>;
	};

	io_cfg_rt@10002c00 {
		compatible = "mediatek,io_cfg_rt";
		reg = <0x00 0x10002c00 0x00 0x200>;
	};

	syscfg_pctl_7@0x10002c00 {
		compatible = "mediatek,mt6765-pctl-7-syscfg\0syscon";
		reg = <0x00 0x10002c00 0x00 0x1000>;
		linux,phandle = <0x19>;
		phandle = <0x19>;
	};

	pericfg@10003000 {
		compatible = "mediatek,pericfg\0syscon";
		reg = <0x00 0x10003000 0x00 0x1000>;
		#clock-cells = <0x01>;
		linux,phandle = <0x4f>;
		phandle = <0x4f>;
	};

	efuse_dbg@10004000 {
		compatible = "mediatek,efuse_dbg";
		reg = <0x00 0x10004000 0x00 0x1000>;
	};

	gpio {
		compatible = "mediatek,gpio_usage_mapping";
		linux,phandle = <0x50>;
		phandle = <0x50>;
	};

	gpio@10005000 {
		compatible = "mediatek,gpio";
		reg = <0x00 0x10005000 0x00 0x1000>;
		linux,phandle = <0x51>;
		phandle = <0x51>;
	};

	syscfg_pctl_0@10005000 {
		compatible = "mediatek,mt6765-pctl-0-syscfg\0syscon";
		reg = <0x00 0x10005000 0x00 0x1000>;
		linux,phandle = <0x12>;
		phandle = <0x12>;
	};

	pinctrl@1000b000 {
		compatible = "mediatek,mt6765-pinctrl";
		reg = <0x00 0x1000b000 0x00 0x1000>;
		mediatek,pctl-regmap = <0x12 0x13 0x14 0x15 0x16 0x17 0x18 0x19>;
		pins-are-numbered;
		gpio-controller;
		#gpio-cells = <0x02>;
		interrupt-controller;
		#interrupt-cells = <0x04>;
		interrupts = <0x00 0xab 0x04>;
		linux,phandle = <0x3c>;
		phandle = <0x3c>;

		msdc0@default {
			linux,phandle = <0x32>;
			phandle = <0x32>;

			pins_cmd {
				drive-strength = [03];
			};

			pins_dat {
				drive-strength = [03];
			};

			pins_clk {
				drive-strength = [03];
			};

			pins_rst {
				drive-strength = [03];
			};

			pins_ds {
				drive-strength = [03];
			};
		};

		msdc0@hs400 {
			linux,phandle = <0x33>;
			phandle = <0x33>;

			pins_cmd {
				drive-strength = [03];
			};

			pins_dat {
				drive-strength = [04];
			};

			pins_clk {
				drive-strength = [04];
			};

			pins_rst {
				drive-strength = [03];
			};

			pins_ds {
				drive-strength = [04];
			};
		};

		msdc0@hs200 {
			linux,phandle = <0x34>;
			phandle = <0x34>;

			pins_cmd {
				drive-strength = [03];
			};

			pins_dat {
				drive-strength = [04];
			};

			pins_clk {
				drive-strength = [04];
			};

			pins_rst {
				drive-strength = [03];
			};

			pins_ds {
				drive-strength = [04];
			};
		};

		msdc0@register_default {
			cmd_edge = [00];
			rdata_edge = [00];
			wdata_edge = [00];
			linux,phandle = <0x35>;
			phandle = <0x35>;
		};

		msdc1@default {
			linux,phandle = <0x37>;
			phandle = <0x37>;

			pins_cmd {
				drive-strength = [03];
			};

			pins_dat {
				drive-strength = [03];
			};

			pins_clk {
				drive-strength = [03];
			};
		};

		msdc1@sdr104 {
			linux,phandle = <0x38>;
			phandle = <0x38>;

			pins_cmd {
				drive-strength = [03];
			};

			pins_dat {
				drive-strength = [03];
			};

			pins_clk {
				drive-strength = [03];
			};
		};

		msdc1@sdr50 {
			linux,phandle = <0x39>;
			phandle = <0x39>;

			pins_cmd {
				drive-strength = [03];
			};

			pins_dat {
				drive-strength = [03];
			};

			pins_clk {
				drive-strength = [03];
			};
		};

		msdc1@ddr50 {
			linux,phandle = <0x3a>;
			phandle = <0x3a>;

			pins_cmd {
				drive-strength = [03];
			};

			pins_dat {
				drive-strength = [03];
			};

			pins_clk {
				drive-strength = [03];
			};
		};

		msdc1@register_default {
			cmd_edge = [00];
			rdata_edge = [00];
			wdata_edge = [00];
			linux,phandle = <0x3b>;
			phandle = <0x3b>;
		};

		msdc3@default {
			linux,phandle = <0x52>;
			phandle = <0x52>;

			pins_cmd {
				drive-strength = [04];
			};

			pins_dat {
				drive-strength = [04];
			};

			pins_clk {
				drive-strength = [04];
			};
		};

		msdc3@register_default {
			cmd_edge = [01];
			rdata_edge = [01];
			wdata_edge = [01];
			linux,phandle = <0x53>;
			phandle = <0x53>;
		};
	};

	sleep@10006000 {
		compatible = "mediatek,sleep";
		reg = <0x00 0x10006000 0x00 0x1000>;
		interrupts = <0x00 0xb5 0x08>;
		wakeup-source = <0x1a 0x00 0x04 0x1b 0x01 0x20 0x1c 0x03 0x2000000>;
	};

	toprgu@10007000 {
		compatible = "mediatek,mt6765-toprgu";
		reg = <0x00 0x10007000 0x00 0x1000>;
		interrupts = <0x00 0x8b 0x00>;
	};

	chipid@08000000 {
		compatible = "mediatek,chipid";
		reg = <0x00 0x8000000 0x00 0x04 0x00 0x8000004 0x00 0x04 0x00 0x8000008 0x00 0x04 0x00 0x800000c 0x00 0x04>;
	};

	mobicore {
		compatible = "trustonic,mobicore";
		interrupts = <0x00 0x10f 0x01>;
	};

	timer {
		compatible = "arm,armv8-timer";
		interrupt-parent = <0x11>;
		interrupts = <0x01 0x0d 0x08 0x01 0x0e 0x08 0x01 0x0b 0x08 0x01 0x0a 0x08>;
		clock-frequency = <0xc65d40>;
	};

	clocks {

		clk26m {
			compatible = "fixed-clock";
			#clock-cells = <0x00>;
			clock-frequency = <0x18cba80>;
			linux,phandle = <0x1f>;
			phandle = <0x1f>;
		};

		clk32k {
			compatible = "fixed-clock";
			#clock-cells = <0x00>;
			clock-frequency = <0x7d00>;
			linux,phandle = <0x1d>;
			phandle = <0x1d>;
		};
	};

	apxgpt@10008000 {
		compatible = "mediatek,apxgpt";
		reg = <0x00 0x10008000 0x00 0x1000>;
		interrupts = <0x00 0xaa 0x08>;
		clocks = <0x1d>;
	};

	hacc@1000a000 {
		compatible = "mediatek,hacc";
		reg = <0x00 0x1000a000 0x00 0x1000>;
		interrupts = <0x00 0xbd 0x08>;
	};

	apmixed@1000c000 {
		compatible = "mediatek,apmixed\0syscon";
		reg = <0x00 0x1000c000 0x00 0x1000>;
		#clock-cells = <0x01>;
		linux,phandle = <0x41>;
		phandle = <0x41>;
	};

	fhctl@1000ce00 {
		compatible = "mediatek,fhctl";
		reg = <0x00 0x1000ce00 0x00 0x200>;
	};

	pwrap@1000d000 {
		compatible = "mediatek,pwrap";
		reg = <0x00 0x1000d000 0x00 0x1000>;
		interrupts = <0x00 0xb3 0x04>;
	};

	mt-pmic {
		compatible = "mediatek,mt_pmic";
		interrupt-controller;
		linux,phandle = <0x54>;
		phandle = <0x54>;

		mt635x-auxadc {
			compatible = "mediatek,mt635x-auxadc";
			#io-channel-cells = <0x01>;
			linux,phandle = <0x55>;
			phandle = <0x55>;

			batadc {
				channel = <0x00>;
				resistance-ratio = <0x03 0x01>;
				avg-num = <0x80>;
			};

			isense {
				channel = <0x01>;
				resistance-ratio = <0x03 0x01>;
				avg-num = <0x80>;
			};

			vcdt {
				channel = <0x02>;
			};

			bat_temp {
				channel = <0x03>;
				resistance-ratio = <0x01 0x01>;
			};

			chip_temp {
				channel = <0x05>;
			};

			vcore_temp {
				channel = <0x06>;
			};

			vproc_temp {
				channel = <0x07>;
			};

			accdet {
				channel = <0x09>;
			};

			tsx_temp {
				channel = <0x0b>;
				avg-num = <0x80>;
			};

			hpofs_cal {
				channel = <0x0c>;
				avg-num = <0x100>;
			};

			dcxo_temp {
				channel = <0x0d>;
				avg-num = <0x10>;
			};

			vbif {
				channel = <0x0e>;
				resistance-ratio = <0x01 0x01>;
			};
		};

		buck_regulators {

			buck_vs1 {
				regulator-name = "vs1";
				regulator-min-microvolt = <0x124f80>;
				regulator-max-microvolt = <0x2191c0>;
				regulator-ramp-delay = <0x30d4>;
				regulator-enable-ramp-delay = <0xdc>;
				linux,phandle = <0x56>;
				phandle = <0x56>;
			};

			buck_vmodem {
				regulator-name = "vmodem";
				regulator-min-microvolt = <0x7a120>;
				regulator-max-microvolt = <0x123716>;
				regulator-ramp-delay = <0x186a>;
				regulator-enable-ramp-delay = <0xdc>;
				linux,phandle = <0x57>;
				phandle = <0x57>;
			};

			buck_vcore {
				regulator-name = "vcore";
				regulator-min-microvolt = <0x7ea5e>;
				regulator-max-microvolt = <0x1406f4>;
				regulator-ramp-delay = <0x186a>;
				regulator-enable-ramp-delay = <0xdc>;
				linux,phandle = <0x58>;
				phandle = <0x58>;
			};

			buck_vproc {
				regulator-name = "vproc";
				regulator-min-microvolt = <0x7ea5e>;
				regulator-max-microvolt = <0x1406f4>;
				regulator-ramp-delay = <0x186a>;
				regulator-enable-ramp-delay = <0xdc>;
				linux,phandle = <0x59>;
				phandle = <0x59>;
			};

			buck_vpa {
				regulator-name = "vpa";
				regulator-min-microvolt = <0x7a120>;
				regulator-max-microvolt = <0x37b1d0>;
				regulator-ramp-delay = <0xc350>;
				regulator-enable-ramp-delay = <0xdc>;
				linux,phandle = <0x5a>;
				phandle = <0x5a>;
			};
		};

		ldo_regulators {

			ldo_vfe28 {
				compatible = "regulator-fixed";
				regulator-name = "vfe28";
				regulator-min-microvolt = <0x2ab980>;
				regulator-max-microvolt = <0x2ab980>;
				regulator-enable-ramp-delay = <0x108>;
				linux,phandle = <0x5b>;
				phandle = <0x5b>;
			};

			ldo_vxo22 {
				regulator-name = "vxo22";
				regulator-min-microvolt = <0x2191c0>;
				regulator-max-microvolt = <0x249f00>;
				regulator-enable-ramp-delay = <0x6e>;
				linux,phandle = <0x5c>;
				phandle = <0x5c>;
			};

			ldo_vrf18 {
				compatible = "regulator-fixed";
				regulator-name = "vrf18";
				regulator-min-microvolt = <0x1b7740>;
				regulator-max-microvolt = <0x1b7740>;
				regulator-enable-ramp-delay = <0x6e>;
				linux,phandle = <0x5d>;
				phandle = <0x5d>;
			};

			ldo_vrf12 {
				compatible = "regulator-fixed";
				regulator-name = "vrf12";
				regulator-min-microvolt = <0x124f80>;
				regulator-max-microvolt = <0x124f80>;
				regulator-enable-ramp-delay = <0x6e>;
				linux,phandle = <0x5e>;
				phandle = <0x5e>;
			};

			ldo_vefuse {
				regulator-name = "vefuse";
				regulator-min-microvolt = <0x124f80>;
				regulator-max-microvolt = <0x325aa0>;
				regulator-enable-ramp-delay = <0x108>;
				linux,phandle = <0x5f>;
				phandle = <0x5f>;
			};

			ldo_vcn33_bt {
				regulator-name = "vcn33_bt";
				regulator-min-microvolt = <0x325aa0>;
				regulator-max-microvolt = <0x3567e0>;
				regulator-enable-ramp-delay = <0x108>;
				linux,phandle = <0x60>;
				phandle = <0x60>;
			};

			ldo_vcn33_wifi {
				regulator-name = "vcn33_wifi";
				regulator-min-microvolt = <0x325aa0>;
				regulator-max-microvolt = <0x3567e0>;
				regulator-enable-ramp-delay = <0x108>;
				linux,phandle = <0x61>;
				phandle = <0x61>;
			};

			ldo_vcn28 {
				compatible = "regulator-fixed";
				regulator-name = "vcn28";
				regulator-min-microvolt = <0x2ab980>;
				regulator-max-microvolt = <0x2ab980>;
				regulator-enable-ramp-delay = <0x108>;
				linux,phandle = <0x62>;
				phandle = <0x62>;
			};

			ldo_vcn18 {
				compatible = "regulator-fixed";
				regulator-name = "vcn18";
				regulator-min-microvolt = <0x1b7740>;
				regulator-max-microvolt = <0x1b7740>;
				regulator-enable-ramp-delay = <0x108>;
				linux,phandle = <0x63>;
				phandle = <0x63>;
			};

			ldo_vcama {
				regulator-name = "vcama";
				regulator-min-microvolt = <0x2625a0>;
				regulator-max-microvolt = <0x2ab980>;
				regulator-enable-ramp-delay = <0x108>;
				linux,phandle = <0x64>;
				phandle = <0x64>;
			};

			ldo_vcamd {
				regulator-name = "vcamd";
				regulator-min-microvolt = <0xf4240>;
				regulator-max-microvolt = <0x1b7740>;
				regulator-enable-ramp-delay = <0x108>;
				linux,phandle = <0x65>;
				phandle = <0x65>;
			};

			ldo_vcamio {
				compatible = "regulator-fixed";
				regulator-name = "vcamio";
				regulator-min-microvolt = <0x1b7740>;
				regulator-max-microvolt = <0x1b7740>;
				regulator-enable-ramp-delay = <0x108>;
				linux,phandle = <0x66>;
				phandle = <0x66>;
			};

			ldo_vldo28 {
				regulator-name = "vldo28";
				regulator-min-microvolt = <0x2ab980>;
				regulator-max-microvolt = <0x2dc6c0>;
				regulator-enable-ramp-delay = <0x108>;
				linux,phandle = <0x67>;
				phandle = <0x67>;
			};

			ldo_vsram_others {
				regulator-name = "vsram_others";
				regulator-min-microvolt = <0x7ea5e>;
				regulator-max-microvolt = <0x1406f4>;
				regulator-ramp-delay = <0x186a>;
				regulator-enable-ramp-delay = <0x6e>;
				linux,phandle = <0x68>;
				phandle = <0x68>;
			};

			ldo_vsram_proc {
				regulator-name = "vsram_proc";
				regulator-min-microvolt = <0x7ea5e>;
				regulator-max-microvolt = <0x1406f4>;
				regulator-ramp-delay = <0x186a>;
				regulator-enable-ramp-delay = <0x6e>;
				linux,phandle = <0x69>;
				phandle = <0x69>;
			};

			ldo_vaux18 {
				compatible = "regulator-fixed";
				regulator-name = "vaux18";
				regulator-min-microvolt = <0x1b7740>;
				regulator-max-microvolt = <0x1b7740>;
				regulator-enable-ramp-delay = <0x108>;
				linux,phandle = <0x6a>;
				phandle = <0x6a>;
			};

			ldo_vaud28 {
				compatible = "regulator-fixed";
				regulator-name = "vaud28";
				regulator-min-microvolt = <0x2ab980>;
				regulator-max-microvolt = <0x2ab980>;
				regulator-enable-ramp-delay = <0x108>;
				linux,phandle = <0x6b>;
				phandle = <0x6b>;
			};

			ldo_vio28 {
				compatible = "regulator-fixed";
				regulator-name = "vio28";
				regulator-min-microvolt = <0x2ab980>;
				regulator-max-microvolt = <0x2ab980>;
				regulator-enable-ramp-delay = <0x108>;
				linux,phandle = <0x6c>;
				phandle = <0x6c>;
			};

			ldo_vio18 {
				compatible = "regulator-fixed";
				regulator-name = "vio18";
				regulator-min-microvolt = <0x1b7740>;
				regulator-max-microvolt = <0x1b7740>;
				regulator-enable-ramp-delay = <0x108>;
				linux,phandle = <0x6d>;
				phandle = <0x6d>;
			};

			ldo_vdram {
				regulator-name = "vdram";
				regulator-min-microvolt = <0x10c8e0>;
				regulator-max-microvolt = <0x124f80>;
				regulator-enable-ramp-delay = <0xce4>;
				linux,phandle = <0x6e>;
				phandle = <0x6e>;
			};

			ldo_vmc {
				regulator-name = "vmc";
				regulator-min-microvolt = <0x1b7740>;
				regulator-max-microvolt = <0x325aa0>;
				regulator-enable-ramp-delay = <0x2c>;
				linux,phandle = <0x3e>;
				phandle = <0x3e>;
			};

			ldo_vmch {
				regulator-name = "vmch";
				regulator-min-microvolt = <0x2c4020>;
				regulator-max-microvolt = <0x325aa0>;
				regulator-enable-ramp-delay = <0x2c>;
				linux,phandle = <0x3d>;
				phandle = <0x3d>;
			};

			ldo_vemc {
				regulator-name = "vemc";
				regulator-min-microvolt = <0x2c4020>;
				regulator-max-microvolt = <0x325aa0>;
				regulator-enable-ramp-delay = <0x2c>;
				linux,phandle = <0x36>;
				phandle = <0x36>;
			};

			ldo_vsim1 {
				regulator-name = "vsim1";
				regulator-min-microvolt = <0x19f0a0>;
				regulator-max-microvolt = <0x2f4d60>;
				regulator-enable-ramp-delay = <0x108>;
				linux,phandle = <0x6f>;
				phandle = <0x6f>;
			};

			ldo_vsim2 {
				regulator-name = "vsim2";
				regulator-min-microvolt = <0x19f0a0>;
				regulator-max-microvolt = <0x2f4d60>;
				regulator-enable-ramp-delay = <0x108>;
				linux,phandle = <0x70>;
				phandle = <0x70>;
			};

			ldo_vibr {
				regulator-name = "vibr";
				regulator-min-microvolt = <0x124f80>;
				regulator-max-microvolt = <0x325aa0>;
				regulator-enable-ramp-delay = <0x2c>;
				linux,phandle = <0x71>;
				phandle = <0x71>;
			};

			ldo_vusb33 {
				regulator-name = "vusb33";
				regulator-min-microvolt = <0x2dc6c0>;
				regulator-max-microvolt = <0x2f4d60>;
				regulator-enable-ramp-delay = <0x108>;
				linux,phandle = <0x72>;
				phandle = <0x72>;
			};
		};
	};

	scp@10500000 {
		compatible = "mediatek,scp";
		status = "okay";
		reg = <0x00 0x10500000 0x00 0x40000 0x00 0x105c0000 0x00 0x3000 0x00 0x105c4000 0x00 0x1000 0x00 0x105d4000 0x00 0x6000>;
		interrupts = <0x00 0xc0 0x04>;
		core_1 = "enable";
		scp_sramSize = <0x40000>;
	};

	scp_dvfs {
		compatible = "mediatek,scp_dvfs";
		clocks = <0x1e 0x63 0x1f 0x1e 0x0e 0x1e 0x1a 0x1e 0x02 0x1e 0x17 0x1e 0x06 0x1e 0x19>;
		clock-names = "clk_mux\0clk_pll_0\0clk_pll_1\0clk_pll_2\0clk_pll_3\0clk_pll_4\0clk_pll_5\0clk_pll_6";
	};

	sleep_reg_md@1000f000 {
		compatible = "mediatek,sleep_reg_md";
		reg = <0x00 0x1000f000 0x00 0x1000>;
	};

	kp@10010000 {
		compatible = "mediatek,kp";
		reg = <0x00 0x10010000 0x00 0x1000>;
		interrupts = <0x00 0xb4 0x02>;
		linux,phandle = <0x1a>;
		phandle = <0x1a>;
	};

	otg_iddig {
		compatible = "mediatek,usb_iddig_bi_eint";
		linux,phandle = <0x73>;
		phandle = <0x73>;
	};

	mrdump_ext_rst {
		compatible = "mediatek, mrdump_ext_rst-eint";
		force_mode = "EINT";
		mode = "IRQ";
		status = "okay";
		linux,phandle = <0x74>;
		phandle = <0x74>;
	};

	touch {
		compatible = "mediatek,touch";
		linux,phandle = <0x75>;
		phandle = <0x75>;
	};

	accdet {
		compatible = "mediatek,pmic-accdet";
		linux,phandle = <0x76>;
		phandle = <0x76>;
	};

	fingerprint {
		compatible = "mediatek,goodix-fp";
		linux,phandle = <0x77>;
		phandle = <0x77>;
	};

	mt6357_gauge {
		compatible = "mediatek,mt6357_gauge";
		gauge_name = "gauge";
		alias_name = "mt6357";
	};

	gauge_timer {
		compatible = "mediatek,gauge_timer_service";
	};

	battery {
		compatible = "mediatek,bat_gm30";
		DIFFERENCE_FULLOCV_ITH = <0xc8>;
		SHUTDOWN_1_TIME = <0x1e>;
		KEEP_100_PERCENT = <0x01>;
		R_FG_VALUE = <0x0a>;
		EMBEDDED_SEL = <0x01>;
		PMIC_SHUTDOWN_CURRENT = <0x14>;
		FG_METER_RESISTANCE = <0x4b>;
		CAR_TUNE_VALUE = <0x64>;
		PMIC_MIN_VOL = <0x82dc>;
		POWERON_SYSTEM_IBOOT = <0x1f4>;
		SHUTDOWN_GAUGE0_VOLTAGE = <0x84d0>;
		TEMPERATURE_T0 = <0x32>;
		TEMPERATURE_T1 = <0x19>;
		TEMPERATURE_T2 = <0x0a>;
		TEMPERATURE_T3 = <0x00>;
		TEMPERATURE_T4 = <0xfffffff6>;
		g_FG_PSEUDO100_T0 = <0x64>;
		g_FG_PSEUDO100_T1 = <0x64>;
		g_FG_PSEUDO100_T2 = <0x64>;
		g_FG_PSEUDO100_T3 = <0x64>;
		g_FG_PSEUDO100_T4 = <0x64>;
		Q_MAX_SYS_VOLTAGE_BAT0 = <0xd16>;
		Q_MAX_SYS_VOLTAGE_BAT1 = <0xd16>;
		Q_MAX_SYS_VOLTAGE_BAT2 = <0xd16>;
		Q_MAX_SYS_VOLTAGE_BAT3 = <0xd16>;
		g_PMIC_MIN_VOL = <0x8660 0x82dc 0x8020 0x82dc 0x8660 0x82dc 0x8020 0x82dc 0x8598 0x82dc 0x8020 0x82dc 0x7ef4 0x7ef4 0x7ef4 0x7ef4 0x7c9c 0x7c9c 0x7c9c 0x7c9c 0x7b0c 0x7b0c 0x7b0c 0x7b0c 0x7918 0x7918 0x7918 0x7918 0x7918 0x7918 0x7918 0x7918 0x7918 0x7918 0x7918 0x7918 0x7918 0x7918 0x7918 0x79e0>;
		SHUTDOWN_GAUGE1_VBAT_EN = <0x01>;
		UI_LOW_LIMIT_SOC0 = <0xc8>;
		UI_LOW_LIMIT_VTH0 = <0x87f0>;
		UI_LOW_LIMIT_SOC1 = <0xc8>;
		UI_LOW_LIMIT_VTH1 = <0x87f0>;
		UI_LOW_LIMIT_SOC2 = <0xc8>;
		UI_LOW_LIMIT_VTH2 = <0x87f0>;
		UI_LOW_LIMIT_SOC3 = <0xc8>;
		UI_LOW_LIMIT_VTH3 = <0x87f0>;
		UI_LOW_LIMIT_SOC4 = <0x64>;
		UI_LOW_LIMIT_VTH4 = <0x86c4>;
		battery0_profile_t0_num = <0x64>;
		battery0_profile_t0 = <0x00 0xaadc 0x352 0x254 0xaa1f 0x352 0x4a8 0xa98a 0x370 0x6fc 0xa8f5 0x353 0x950 0xa86a 0x36f 0xba4 0xa7e9 0x370 0xdf8 0xa771 0x383 0x104c 0xa6f1 0x384 0x12a0 0xa66f 0x355 0x14f4 0xa5f8 0x36e 0x1748 0xa577 0x354 0x199c 0xa509 0x380 0x1bf0 0xa492 0x384 0x1e44 0xa41b 0x372 0x2098 0xa3a4 0x370 0x22ec 0xa32d 0x370 0x2540 0xa2be 0x382 0x2794 0xa248 0x372 0x29e8 0xa1da 0x370 0x2c3c 0xa164 0x370 0x2e90 0xa0fe 0x381 0x30e4 0xa08a 0x384 0x3338 0xa01b 0x384 0x358c 0x9fb6 0x384 0x37e0 0x9f4b 0x384 0x3a34 0x9ee6 0x384 0x3c88 0x9e83 0x39c 0x3edc 0x9e1f 0x3a2 0x4130 0x9db4 0x38a 0x4384 0x9d4f 0x384 0x45d8 0x9ceb 0x384 0x482c 0x9c90 0x39b 0x4a80 0x9c3e 0x3b1 0x4cd4 0x9be7 0x3a7 0x4f28 0x9b95 0x3c8 0x517c 0x9b3e 0x3bd 0x53d0 0x9aed 0x3cc 0x5624 0x9a9d 0x3e3 0x5878 0x9a4e 0x3e8 0x5acc 0x99fe 0x3fe 0x5d20 0x99b6 0x414 0x5f74 0x9962 0x41a 0x61c8 0x9909 0x41a 0x641c 0x98a2 0x41a 0x6670 0x9819 0x3d5 0x68c4 0x9792 0x386 0x6b18 0x9732 0x37d 0x6d6c 0x96e3 0x363 0x6fc0 0x96a1 0x366 0x7214 0x9665 0x370 0x7468 0x9630 0x37d 0x76bc 0x95f8 0x377 0x7910 0x95c3 0x370 0x7b64 0x9597 0x37c 0x7db8 0x9569 0x378 0x800c 0x953e 0x37c 0x8260 0x9510 0x366 0x84b4 0x94ea 0x370 0x8708 0x94c1 0x378 0x895c 0x949b 0x37c 0x8bb0 0x947d 0x384 0x8e04 0x945f 0x384 0x9058 0x943c 0x384 0x92ac 0x9419 0x384 0x9500 0x9401 0x394 0x9754 0x93e8 0x3a2 0x99a8 0x93cf 0x3a7 0x9bfc 0x93b6 0x3ac 0x9e50 0x9399 0x3a2 0xa0a4 0x9380 0x3ac 0xa2f8 0x9362 0x3ac 0xa54c 0x932b 0x393 0xa7a0 0x92e1 0x37a 0xa9f4 0x92a0 0x370 0xac48 0x9273 0x370 0xae9c 0x924b 0x370 0xb0f0 0x9224 0x370 0xb344 0x91fc 0x370 0xb598 0x91d4 0x370 0xb7ec 0x91b1 0x370 0xba40 0x9193 0x379 0xbc94 0x9171 0x391 0xbee8 0x9145 0x395 0xc13c 0x910f 0x384 0xc390 0x90d4 0x384 0xc5e4 0x9098 0x384 0xc838 0x9059 0x384 0xca8c 0x900b 0x371 0xcce0 0x8fc9 0x352 0xcf34 0x8fb6 0x364 0xd188 0x8faf 0x38f 0xd3dc 0x8f9e 0x3a9 0xd630 0x8f91 0x3d2 0xd884 0x8f76 0x40d 0xdad8 0x8f1d 0x403 0xdd2c 0x8e18 0x3ca 0xdf80 0x8c57 0x3c6 0xe1d4 0x8a04 0x3f8 0xe428 0x8611 0x43f 0xe550 0x83b8 0x46a>;
		battery0_profile_t1_num = <0x64>;
		battery0_profile_t1 = <0x00 0xab86 0x4b0 0x254 0xaabf 0x4b0 0x4a8 0xaa20 0x4b0 0x6fc 0xa995 0x4b0 0x950 0xa90a 0x4b0 0xba4 0xa87f 0x49d 0xdf8 0xa7fd 0x49c 0x104c 0xa77c 0x49c 0x12a0 0xa704 0x49c 0x14f4 0xa68d 0x49c 0x1748 0xa616 0x49c 0x199c 0xa59f 0x49c 0x1bf0 0xa528 0x49c 0x1e44 0xa4b0 0x481 0x2098 0xa442 0x499 0x22ec 0xa3cc 0x49c 0x2540 0xa355 0x481 0x2794 0xa2e6 0x499 0x29e8 0xa279 0x49c 0x2c3c 0xa203 0x49c 0x2e90 0xa195 0x49c 0x30e4 0xa127 0x4ad 0x3338 0xa0b2 0x49f 0x358c 0xa04b 0x4ad 0x37e0 0x9fe0 0x4b0 0x3a34 0x9f7b 0x4b0 0x3c88 0x9f30 0x4d9 0x3edc 0x9ef3 0x50b 0x4130 0x9e9f 0x514 0x4384 0x9e0d 0x4dc 0x45d8 0x9d5e 0x4b6 0x482c 0x9cbb 0x4b0 0x4a80 0x9c3c 0x4c8 0x4cd4 0x9bdc 0x4ce 0x4f28 0x9b9a 0x4dd 0x517c 0x9b66 0x508 0x53d0 0x9b3c 0x52b 0x5624 0x9b05 0x532 0x5878 0x9aba 0x532 0x5acc 0x9a72 0x541 0x5d20 0x9a25 0x55c 0x5f74 0x99d6 0x573 0x61c8 0x997f 0x578 0x641c 0x991f 0x56a 0x6670 0x98b4 0x541 0x68c4 0x9832 0x4ec 0x6b18 0x97b5 0x497 0x6d6c 0x9752 0x470 0x6fc0 0x9700 0x456 0x7214 0x96b7 0x44c 0x7468 0x9678 0x44c 0x76bc 0x9643 0x44c 0x7910 0x9611 0x44c 0x7b64 0x95d9 0x43f 0x7db8 0x95aa 0x445 0x800c 0x957c 0x43f 0x8260 0x9551 0x445 0x84b4 0x9529 0x44c 0x8708 0x9501 0x44c 0x895c 0x94e0 0x44c 0x8bb0 0x94bc 0x44c 0x8e04 0x949a 0x45e 0x9058 0x947c 0x46a 0x92ac 0x945f 0x46a 0x9500 0x9441 0x46a 0x9754 0x9423 0x46a 0x99a8 0x940b 0x475 0x9bfc 0x93f1 0x47e 0x9e50 0x93d9 0x47e 0xa0a4 0x93c5 0x47e 0xa2f8 0x93b1 0x47e 0xa54c 0x9398 0x473 0xa7a0 0x9380 0x474 0xa9f4 0x9361 0x464 0xac48 0x933f 0x44c 0xae9c 0x9321 0x44c 0xb0f0 0x9303 0x44c 0xb344 0x92e1 0x44c 0xb598 0x92b9 0x44c 0xb7ec 0x9291 0x44c 0xba40 0x9269 0x443 0xbc94 0x9246 0x441 0xbee8 0x9228 0x45a 0xc13c 0x9202 0x46a 0xc390 0x91c7 0x45d 0xc5e4 0x9186 0x459 0xc838 0x914a 0x46a 0xca8c 0x910f 0x472 0xcce0 0x90cb 0x47e 0xcf34 0x907c 0x46a 0xd188 0x9044 0x458 0xd3dc 0x9034 0x472 0xd630 0x902a 0x491 0xd884 0x901c 0x4bb 0xdad8 0x9005 0x4e1 0xdd2c 0x8fd8 0x51a 0xdf80 0x8f47 0x53f 0xe1d4 0x8de4 0x539 0xe428 0x8bb8 0x557 0xe550 0x8656 0x62c>;
		battery0_profile_t2_num = <0x64>;
		battery0_profile_t2 = <0x00 0xab86 0x7ee 0x254 0xaab5 0x7ee 0x4a8 0xaa02 0x7d0 0x6fc 0xa96d 0x7d0 0x950 0xa8d8 0x7bd 0xba4 0xa843 0x78c 0xdf8 0xa7c1 0x76d 0x104c 0xa740 0x759 0x12a0 0xa6c8 0x758 0x14f4 0xa651 0x758 0x1748 0xa5da 0x73c 0x199c 0xa563 0x727 0x1bf0 0xa4ec 0x726 0x1e44 0xa47e 0x726 0x2098 0xa407 0x70b 0x22ec 0xa399 0x708 0x2540 0xa32c 0x723 0x2794 0xa2be 0x726 0x29e8 0xa251 0x726 0x2c3c 0xa1e4 0x726 0x2e90 0xa16e 0x726 0x30e4 0xa0ff 0x726 0x3338 0xa092 0x726 0x358c 0xa02d 0x726 0x37e0 0x9fd2 0x726 0x3a34 0x9f8a 0x750 0x3c88 0x9f55 0x7bb 0x3edc 0x9f0a 0x7f9 0x4130 0x9e8a 0x7d9 0x4384 0x9dcf 0x798 0x45d8 0x9d00 0x74a 0x482c 0x9c57 0x73a 0x4a80 0x9bdf 0x752 0x4cd4 0x9b7a 0x741 0x4f28 0x9b2e 0x751 0x517c 0x9af0 0x767 0x53d0 0x9ac4 0x792 0x5624 0x9a94 0x7c4 0x5878 0x9a63 0x7e6 0x5acc 0x9a22 0x7d8 0x5d20 0x99d5 0x7d0 0x5f74 0x997f 0x7c1 0x61c8 0x991e 0x798 0x641c 0x98b4 0x751 0x6670 0x9846 0x709 0x68c4 0x97e0 0x6d1 0x6b18 0x977d 0x69f 0x6d6c 0x9727 0x67b 0x6fc0 0x96de 0x664 0x7214 0x9699 0x65e 0x7468 0x965a 0x64a 0x76bc 0x9625 0x654 0x7910 0x95ed 0x64a 0x7b64 0x95be 0x653 0x7db8 0x9590 0x65e 0x800c 0x9565 0x65e 0x8260 0x9537 0x64b 0x84b4 0x950b 0x653 0x8708 0x94ea 0x66a 0x895c 0x94c6 0x666 0x8bb0 0x94a4 0x66a 0x8e04 0x9486 0x672 0x9058 0x9468 0x684 0x92ac 0x944b 0x690 0x9500 0x942d 0x690 0x9754 0x9415 0x690 0x99a8 0x93fb 0x690 0x9bfc 0x93e3 0x690 0x9e50 0x93d5 0x69b 0xa0a4 0x93c5 0x6a4 0xa2f8 0x93b7 0x6a4 0xa54c 0x93ad 0x6b4 0xa7a0 0x93a3 0x6cc 0xa9f4 0x9394 0x6d6 0xac48 0x9380 0x6d6 0xae9c 0x936c 0x6e5 0xb0f0 0x9353 0x6f4 0xb344 0x9335 0x6fe 0xb598 0x9313 0x716 0xb7ec 0x92eb 0x726 0xba40 0x92c3 0x72f 0xbc94 0x92a0 0x751 0xbee8 0x9279 0x77a 0xc13c 0x9248 0x793 0xc390 0x920d 0x7ab 0xc5e4 0x91cc 0x7d2 0xc838 0x9190 0x803 0xca8c 0x9151 0x83d 0xcce0 0x9107 0x87b 0xcf34 0x90b8 0x8ac 0xd188 0x907c 0x8f2 0xd3dc 0x9062 0x961 0xd630 0x904a 0x9de 0xd884 0x9030 0xa7f 0xdad8 0x9011 0xb60 0xdd2c 0x8fd1 0xc63 0xdf80 0x8f3b 0xd8e 0xe1d4 0x8deb 0xe98 0xe428 0x8bc9 0x1031 0xe550 0x864c 0x15ae>;
		battery0_profile_t3_num = <0x64>;
		battery0_profile_t3 = <0x00 0xab90 0xdca 0x254 0xaaa2 0xdca 0x4a8 0xa9db 0xdac 0x6fc 0xa931 0xd7b 0x950 0xa892 0xd49 0xba4 0xa807 0xd35 0xdf8 0xa785 0xd04 0x104c 0xa704 0xce5 0x12a0 0xa68c 0xcd1 0x14f4 0xa615 0xcb4 0x1748 0xa59e 0xc9f 0x199c 0xa527 0xc70 0x1bf0 0xa4b9 0xc6c 0x1e44 0xa442 0xc3e 0x2098 0xa3d4 0xc1f 0x22ec 0xa367 0xc1c 0x2540 0xa303 0xc1c 0x2794 0xa28e 0xc0a 0x29e8 0xa21f 0xbee 0x2c3c 0xa1bb 0xc04 0x2e90 0xa14f 0xc08 0x30e4 0xa0e1 0xbee 0x3338 0xa074 0xbbf 0x358c 0xa020 0xbe2 0x37e0 0x9fd1 0xc2d 0x3a34 0x9f92 0xc8d 0x3c88 0x9f46 0xcd8 0x3edc 0x9ed6 0xce4 0x4130 0x9e3e 0xcab 0x4384 0x9d77 0xc25 0x45d8 0x9cbe 0xbc8 0x482c 0x9c23 0xb90 0x4a80 0x9bad 0xb86 0x4cd4 0x9b48 0xb76 0x4f28 0x9af4 0xb81 0x517c 0x9ab4 0xb9d 0x53d0 0x9a78 0xbca 0x5624 0x9a3d 0xbd6 0x5878 0x99f2 0xbc0 0x5acc 0x99aa 0xba9 0x5d20 0x995d 0xb8e 0x5f74 0x98ff 0xb53 0x61c8 0x989c 0xb06 0x641c 0x9847 0xaf0 0x6670 0x97e9 0xabf 0x68c4 0x9794 0xa95 0x6b18 0x9745 0xa7e 0x6d6c 0x96f5 0xa63 0x6fc0 0x96b3 0xa6e 0x7214 0x9678 0xa64 0x7468 0x963c 0xa5a 0x76bc 0x9607 0xa6e 0x7910 0x95d5 0xa85 0x7b64 0x959d 0xa7f 0x7db8 0x956e 0xa78 0x800c 0x9547 0xa85 0x8260 0x9519 0xa8c 0x84b4 0x94ed 0xa8c 0x8708 0x94cc 0xa9e 0x895c 0x94ae 0xac8 0x8bb0 0x948a 0xadc 0x8e04 0x9468 0xadc 0x9058 0x944a 0xadc 0x92ac 0x9432 0xaf9 0x9500 0x941f 0xb19 0x9754 0x9410 0xb33 0x99a8 0x9401 0xb4b 0x9bfc 0x93f2 0xb65 0x9e50 0x93e3 0xb7d 0xa0a4 0x93d5 0xba1 0xa2f8 0x93cb 0xbd3 0xa54c 0x93c1 0xc14 0xa7a0 0x93b2 0xc54 0xa9f4 0x93a3 0xc9f 0xac48 0x9394 0xce9 0xae9c 0x937b 0xd1b 0xb0f0 0x935d 0xd57 0xb344 0x933f 0xda1 0xb598 0x9322 0xdfa 0xb7ec 0x92ff 0xe5d 0xba40 0x92d7 0xec1 0xbc94 0x92ab 0xf16 0xbee8 0x927e 0xf80 0xc13c 0x9249 0xff6 0xc390 0x9208 0x1064 0xc5e4 0x91cc 0x1102 0xc838 0x9188 0x11a2 0xca8c 0x9141 0x124c 0xcce0 0x90fd 0x130a 0xcf34 0x90b2 0x13cd 0xd188 0x9074 0x14b4 0xd3dc 0x904a 0x15d3 0xd630 0x9029 0x173b 0xd884 0x9001 0x18d6 0xdad8 0x8fce 0x1ac7 0xdd2c 0x8f72 0x1cfc 0xdf80 0x8ec3 0x1f86 0xe1d4 0x8d76 0x22a4 0xe428 0x8b5e 0x26bd 0xe550 0x85e8 0x32b4>;
		battery0_profile_t4_num = <0x64>;
		battery0_profile_t4 = <0x00 0xabae 0x1bbc 0x254 0xaa84 0x1bbc 0x4a8 0xa99f 0x1b77 0x6fc 0xa8d8 0x1b14 0x950 0xa82f 0x1ac4 0xba4 0xa790 0x1a92 0xdf8 0xa6fa 0x1a4d 0x104c 0xa66f 0x19fe 0x12a0 0xa5e4 0x19cb 0x14f4 0xa562 0x1986 0x1748 0xa4ea 0x1966 0x199c 0xa473 0x1923 0x1bf0 0xa3fc 0x1902 0x1e44 0xa385 0x18ee 0x2098 0xa30e 0x18a4 0x22ec 0xa29f 0x189c 0x2540 0xa229 0x185e 0x2794 0xa1bb 0x183c 0x29e8 0xa145 0x180c 0x2c3c 0xa0d6 0x17f5 0x2e90 0xa083 0x1803 0x30e4 0xa034 0x1831 0x3338 0x9fe4 0x1862 0x358c 0x9f84 0x1883 0x37e0 0x9f08 0x1845 0x3a34 0x9e6e 0x17d5 0x3c88 0x9dbe 0x1755 0x3edc 0x9d0c 0x16c4 0x4130 0x9c69 0x1647 0x4384 0x9bda 0x15e0 0x45d8 0x9b67 0x15b4 0x482c 0x9afa 0x1577 0x4a80 0x9a9c 0x1578 0x4cd4 0x9a52 0x157c 0x4f28 0x9a05 0x157c 0x517c 0x99bd 0x157c 0x53d0 0x9970 0x157c 0x5624 0x9920 0x156d 0x5878 0x98d1 0x1552 0x5acc 0x9882 0x153b 0x5d20 0x9832 0x1520 0x5f74 0x97e3 0x150a 0x61c8 0x979a 0x14ef 0x641c 0x974e 0x14d8 0x6670 0x9705 0x14bd 0x68c4 0x96c7 0x14c9 0x6b18 0x968b 0x14e0 0x6d6c 0x9649 0x14e6 0x6fc0 0x9611 0x14fa 0x7214 0x95d8 0x1511 0x7468 0x95a3 0x152c 0x76bc 0x9572 0x1543 0x7910 0x9540 0x155d 0x7b64 0x9515 0x1575 0x7db8 0x94ed 0x159b 0x800c 0x94c5 0x15c1 0x8260 0x94a4 0x15d8 0x84b4 0x9486 0x15f2 0x8708 0x9468 0x160a 0x895c 0x9450 0x1641 0x8bb0 0x9442 0x168b 0x8e04 0x9432 0x16e2 0x9058 0x941f 0x173a 0x92ac 0x9410 0x17a0 0x9500 0x9401 0x1801 0x9754 0x93f2 0x1866 0x99a8 0x93e3 0x18e3 0x9bfc 0x93d5 0x196f 0x9e50 0x93c5 0x19e9 0xa0a4 0x93b2 0x1a67 0xa2f8 0x939e 0x1b06 0xa54c 0x938a 0x1bb4 0xa7a0 0x9371 0x1c49 0xa9f4 0x9358 0x1ce7 0xac48 0x933f 0x1da4 0xae9c 0x9326 0x1e61 0xb0f0 0x9309 0x1f27 0xb344 0x92e6 0x1ff7 0xb598 0x92c3 0x20e0 0xb7ec 0x929c 0x21cf 0xba40 0x9274 0x22af 0xbc94 0x9248 0x23ba 0xbee8 0x9216 0x24df 0xc13c 0x91e5 0x2602 0xc390 0x91af 0x2748 0xc5e4 0x9173 0x287b 0xc838 0x913c 0x29d9 0xca8c 0x9106 0x2b86 0xcce0 0x90ce 0x2d6b 0xcf34 0x9099 0x2f5b 0xd188 0x9061 0x3153 0xd3dc 0x902c 0x336e 0xd630 0x8ff0 0x35a3 0xd884 0x8fad 0x37cd 0xdad8 0x8f57 0x39f5 0xdd2c 0x8edf 0x3bf9 0xdf80 0x8e25 0x3de9 0xe1d4 0x8d0f 0x400b 0xe428 0x8b6f 0x4319 0xe550 0x86ba 0x4cc2>;
		battery1_profile_t0_num = <0x64>;
		battery1_profile_t0 = <0x00 0xaac3 0x424 0x259 0xaa14 0x420 0x4b2 0xa979 0x410 0x70b 0xa8f0 0x410 0x964 0xa86c 0x410 0xbbd 0xa7e7 0x406 0xe16 0xa76b 0x408 0x106f 0xa6f1 0x40e 0x12c8 0xa677 0x408 0x1521 0xa5fd 0x406 0x177a 0xa583 0x3fc 0x19d3 0xa509 0x3fc 0x1c2c 0xa492 0x3fc 0x1e85 0xa41d 0x3fc 0x20de 0xa3a6 0x3f8 0x2337 0xa332 0x3f2 0x2590 0xa2bf 0x3f7 0x27e9 0xa24a 0x40f 0x2a42 0xa1d6 0x420 0x2c9b 0xa166 0x431 0x2ef4 0xa0f6 0x442 0x314d 0xa087 0x43d 0x33a6 0xa01c 0x44c 0x35ff 0x9fb2 0x452 0x3858 0x9f49 0x452 0x3ab1 0x9ee1 0x44d 0x3d0a 0x9e7c 0x459 0x3f63 0x9e18 0x465 0x41bc 0x9db7 0x477 0x4415 0x9d57 0x46d 0x466e 0x9cf6 0x46f 0x48c7 0x9c9a 0x474 0x4b20 0x9c41 0x479 0x4d79 0x9be8 0x47e 0x4fd2 0x9b90 0x482 0x522b 0x9b3b 0x489 0x5484 0x9aea 0x495 0x56dd 0x9a9c 0x4a5 0x5936 0x9a4e 0x4be 0x5b8f 0x99ff 0x4cd 0x5de8 0x99b1 0x4e2 0x6041 0x995c 0x4e8 0x629a 0x98f0 0x4f1 0x64f3 0x985f 0x4db 0x674c 0x97e3 0x499 0x69a5 0x9776 0x449 0x6bfe 0x972a 0x425 0x6e57 0x96e6 0x410 0x70b0 0x96a9 0x409 0x7309 0x966a 0x406 0x7563 0x9635 0x3fc 0x77bc 0x9601 0x3fc 0x7a15 0x95cd 0x3fc 0x7c6e 0x959d 0x3fc 0x7ec7 0x9570 0x405 0x8120 0x9544 0x3fc 0x8379 0x951b 0x3fc 0x85d2 0x94f0 0x3fc 0x882b 0x94ca 0x403 0x8a84 0x94a3 0x3fd 0x8cdd 0x9481 0x406 0x8f36 0x9460 0x409 0x918f 0x9440 0x415 0x93e8 0x9422 0x413 0x9641 0x9401 0x419 0x989a 0x93e6 0x42f 0x9af3 0x93ce 0x436 0x9d4c 0x93b4 0x430 0x9fa5 0x9393 0x435 0xa1fe 0x9372 0x438 0xa457 0x9328 0x438 0xa6b0 0x92d6 0x435 0xa909 0x9297 0x423 0xab62 0x9266 0x40b 0xadbb 0x923f 0x3fd 0xb014 0x9211 0x3fc 0xb26d 0x91e3 0x3f8 0xb4c6 0x91bb 0x3fd 0xb71f 0x919a 0x402 0xb978 0x9178 0x3fc 0xbbd1 0x9154 0x406 0xbe2a 0x911e 0x406 0xc083 0x90e1 0x40c 0xc2dc 0x90a3 0x410 0xc535 0x906d 0x410 0xc78e 0x902a 0x41c 0xc9e7 0x8fde 0x424 0xcc40 0x8faf 0x41e 0xce99 0x8fa2 0x416 0xd0f2 0x8f97 0x410 0xd34b 0x8f8a 0x41f 0xd5a4 0x8f73 0x440 0xd7fd 0x8f38 0x458 0xda56 0x8e97 0x480 0xdcaf 0x8d16 0x488 0xdf08 0x8ae3 0x488 0xe161 0x87ee 0x498 0xe3ba 0x8379 0x4d4 0xe613 0x81ac 0x52c 0xe86c 0x81ac 0x5e6>;
		battery1_profile_t1_num = <0x64>;
		battery1_profile_t1 = <0x00 0xab5b 0x424 0x259 0xaab0 0x420 0x4b2 0xaa1b 0x410 0x70b 0xa993 0x410 0x964 0xa911 0x410 0xbbd 0xa88e 0x406 0xe16 0xa813 0x408 0x106f 0xa799 0x40e 0x12c8 0xa71d 0x408 0x1521 0xa6a3 0x406 0x177a 0xa627 0x3fc 0x19d3 0xa5b1 0x3fc 0x1c2c 0xa53c 0x3fc 0x1e85 0xa4c5 0x3fc 0x20de 0xa44f 0x3f8 0x2337 0xa3d9 0x3f2 0x2590 0xa365 0x3f7 0x27e9 0xa2ef 0x40f 0x2a42 0xa27e 0x420 0x2c9b 0xa20e 0x431 0x2ef4 0xa19e 0x442 0x314d 0xa12c 0x43d 0x33a6 0xa0bf 0x44c 0x35ff 0xa051 0x452 0x3858 0x9fe6 0x452 0x3ab1 0x9f7c 0x44d 0x3d0a 0x9f1c 0x459 0x3f63 0x9ebf 0x465 0x41bc 0x9e60 0x477 0x4415 0x9df4 0x46d 0x466e 0x9d80 0x46f 0x48c7 0x9d0c 0x474 0x4b20 0x9ca1 0x479 0x4d79 0x9c43 0x47e 0x4fd2 0x9bf0 0x482 0x522b 0x9ba2 0x489 0x5484 0x9b5b 0x495 0x56dd 0x9b14 0x4a5 0x5936 0x9ac6 0x4be 0x5b8f 0x9a78 0x4cd 0x5de8 0x9a26 0x4e2 0x6041 0x99ce 0x4e8 0x629a 0x9972 0x4f1 0x64f3 0x9903 0x4db 0x674c 0x9883 0x499 0x69a5 0x9802 0x449 0x6bfe 0x979e 0x425 0x6e57 0x9744 0x410 0x70b0 0x96fe 0x409 0x7309 0x96be 0x406 0x7563 0x9680 0x3fc 0x77bc 0x964b 0x3fc 0x7a15 0x9617 0x3fc 0x7c6e 0x95e3 0x3fc 0x7ec7 0x95b4 0x405 0x8120 0x9588 0x3fc 0x8379 0x955f 0x3fc 0x85d2 0x9536 0x3fc 0x882b 0x9510 0x403 0x8a84 0x94e7 0x3fd 0x8cdd 0x94c5 0x406 0x8f36 0x94a2 0x409 0x918f 0x9484 0x415 0x93e8 0x9464 0x413 0x9641 0x9445 0x419 0x989a 0x942c 0x42f 0x9af3 0x9414 0x436 0x9d4c 0x93fa 0x430 0x9fa5 0x93e0 0x435 0xa1fe 0x93c5 0x438 0xa457 0x93ae 0x438 0xa6b0 0x9390 0x435 0xa909 0x936e 0x423 0xab62 0x9347 0x40b 0xadbb 0x9322 0x3fd 0xb014 0x92ff 0x3fc 0xb26d 0x92d5 0x3f8 0xb4c6 0x92ac 0x3fd 0xb71f 0x9288 0x402 0xb978 0x9264 0x3fc 0xbbd1 0x9245 0x406 0xbe2a 0x921f 0x406 0xc083 0x91ee 0x40c 0xc2dc 0x91b3 0x410 0xc535 0x9176 0x410 0xc78e 0x913d 0x41c 0xc9e7 0x9101 0x424 0xcc40 0x90b1 0x41e 0xce99 0x9074 0x416 0xd0f2 0x9045 0x410 0xd34b 0x9036 0x41f 0xd5a4 0x902b 0x440 0xd7fd 0x9018 0x458 0xda56 0x8ffc 0x480 0xdcaf 0x8f81 0x488 0xdf08 0x8ec6 0x488 0xe161 0x8d00 0x498 0xe3ba 0x8aa1 0x4d4 0xe613 0x875f 0x52c 0xe86c 0x824b 0x5e6>;
		battery1_profile_t2_num = <0x64>;
		battery1_profile_t2 = <0x00 0xab71 0x5d2 0x259 0xaab1 0x5d0 0x4b2 0xaa10 0x5cc 0x70b 0xa982 0x5c9 0x964 0xa8f6 0x5b7 0xbbd 0xa872 0x5b4 0xe16 0xa7f1 0x5a8 0x106f 0xa775 0x59c 0x12c8 0xa6fa 0x599 0x1521 0xa683 0x59f 0x177a 0xa608 0x596 0x19d3 0xa591 0x594 0x1c2c 0xa51a 0x58c 0x1e85 0xa4a2 0x58c 0x20de 0xa42d 0x588 0x2337 0xa3ba 0x583 0x2590 0xa349 0x594 0x27e9 0xa2d5 0x590 0x2a42 0xa265 0x596 0x2c9b 0xa1f5 0x59e 0x2ef4 0xa185 0x5aa 0x314d 0xa115 0x5b4 0x33a6 0xa0a6 0x5b4 0x35ff 0xa03a 0x5ba 0x3858 0x9fd4 0x5be 0x3ab1 0x9f70 0x5c0 0x3d0a 0x9f1a 0x5e6 0x3f63 0x9ec0 0x612 0x41bc 0x9e5d 0x629 0x4415 0x9ddb 0x61f 0x466e 0x9d51 0x60d 0x48c7 0x9cca 0x601 0x4b20 0x9c55 0x5fa 0x4d79 0x9bf9 0x601 0x4fd2 0x9bae 0x60d 0x522b 0x9b67 0x619 0x5484 0x9b25 0x61f 0x56dd 0x9ae3 0x621 0x5936 0x9a9d 0x640 0x5b8f 0x9a50 0x64a 0x5de8 0x99f8 0x64a 0x6041 0x999b 0x644 0x629a 0x9937 0x62d 0x64f3 0x98c7 0x5f6 0x674c 0x9853 0x5ba 0x69a5 0x97e8 0x583 0x6bfe 0x9784 0x554 0x6e57 0x9733 0x541 0x70b0 0x96e7 0x52e 0x7309 0x96a5 0x51f 0x7563 0x966a 0x51e 0x77bc 0x9635 0x51e 0x7a15 0x9600 0x519 0x7c6e 0x95cd 0x514 0x7ec7 0x959e 0x51d 0x8120 0x9570 0x516 0x8379 0x9549 0x526 0x85d2 0x9520 0x520 0x882b 0x94fa 0x525 0x8a84 0x94d5 0x528 0x8cdd 0x94b3 0x532 0x8f36 0x9491 0x532 0x918f 0x9471 0x535 0x93e8 0x9454 0x53b 0x9641 0x9436 0x53c 0x989a 0x941b 0x546 0x9af3 0x9402 0x549 0x9d4c 0x93eb 0x550 0x9fa5 0x93d2 0x550 0xa1fe 0x93bc 0x550 0xa457 0x93ac 0x551 0xa6b0 0x939b 0x557 0xa909 0x9387 0x550 0xab62 0x9373 0x554 0xadbb 0x935f 0x55a 0xb014 0x933d 0x54e 0xb26d 0x9317 0x546 0xb4c6 0x92ec 0x546 0xb71f 0x92c5 0x54e 0xb978 0x929f 0x55a 0xbbd1 0x9280 0x571 0xbe2a 0x9257 0x582 0xc083 0x9223 0x588 0xc2dc 0x91e6 0x59b 0xc535 0x91ab 0x5af 0xc78e 0x9171 0x5c1 0xc9e7 0x912e 0x5d9 0xcc40 0x90db 0x5e6 0xce99 0x908e 0x5ee 0xd0f2 0x906e 0x60d 0xd34b 0x9057 0x635 0xd5a4 0x9044 0x671 0xd7fd 0x902c 0x6b3 0xda56 0x9007 0x703 0xdcaf 0x8fc0 0x789 0xdf08 0x8ecd 0x7e0 0xe161 0x8cf7 0x82b 0xe3ba 0x8a80 0x8fd 0xe613 0x8716 0xa7d 0xe86c 0x81a0 0xd70>;
		battery1_profile_t3_num = <0x64>;
		battery1_profile_t3 = <0x00 0xab96 0xa5a 0x259 0xaac1 0xa5e 0x4b2 0xaa17 0xa6a 0x70b 0xa985 0xa5e 0x964 0xa8f9 0xa52 0xbbd 0xa86f 0xa32 0xe16 0xa7f0 0xa20 0x106f 0xa771 0x9f8 0x12c8 0xa6fa 0x9ec 0x1521 0xa683 0x9ec 0x177a 0xa608 0x9e2 0x19d3 0xa592 0x9da 0x1c2c 0xa51d 0x9da 0x1e85 0xa4a8 0x9ce 0x20de 0xa434 0x9ce 0x2337 0xa3c4 0x9ce 0x2590 0xa351 0x9c2 0x27e9 0xa2e3 0x9ad 0x2a42 0xa273 0x9a2 0x2c9b 0xa206 0x99e 0x2ef4 0xa198 0x992 0x314d 0xa12b 0x98d 0x33a6 0xa0bb 0x97e 0x35ff 0xa051 0x971 0x3858 0x9ff1 0x97f 0x3ab1 0x9f95 0x99f 0x3d0a 0x9f40 0x9e0 0x3f63 0x9ee6 0xa22 0x41bc 0x9e79 0xa32 0x4415 0x9def 0xa14 0x466e 0x9d5d 0x9e9 0x48c7 0x9cc6 0x9b2 0x4b20 0x9c45 0x993 0x4d79 0x9bd6 0x981 0x4fd2 0x9b7b 0x987 0x522b 0x9b31 0x983 0x5484 0x9ae9 0x97b 0x56dd 0x9aa3 0x974 0x5936 0x9a5e 0x96d 0x5b8f 0x9a0f 0x961 0x5de8 0x99b2 0x940 0x6041 0x9951 0x919 0x629a 0x98e9 0x8df 0x64f3 0x9881 0x89e 0x674c 0x9820 0x873 0x69a5 0x97c6 0x850 0x6bfe 0x9772 0x838 0x6e57 0x9722 0x81b 0x70b0 0x96de 0x813 0x7309 0x969c 0x816 0x7563 0x9661 0x810 0x77bc 0x9628 0x809 0x7a15 0x95f2 0x7fd 0x7c6e 0x95c0 0x80d 0x7ec7 0x9590 0x816 0x8120 0x9566 0x82a 0x8379 0x953b 0x82a 0x85d2 0x9512 0x834 0x882b 0x94eb 0x845 0x8a84 0x94c5 0x848 0x8cdd 0x94a7 0x853 0x8f36 0x9485 0x85f 0x918f 0x9465 0x866 0x93e8 0x9445 0x86d 0x9641 0x9429 0x870 0x989a 0x9412 0x870 0x9af3 0x93fa 0x873 0x9d4c 0x93ea 0x87f 0x9fa5 0x93da 0x88b 0xa1fe 0x93ce 0x8aa 0xa457 0x93c2 0x8b6 0xa6b0 0x93b1 0x8bf 0xa909 0x93a4 0x8dd 0xab62 0x9393 0x8f7 0xadbb 0x9381 0x918 0xb014 0x9366 0x929 0xb26d 0x9349 0x94d 0xb4c6 0x9328 0x973 0xb71f 0x9303 0x99e 0xb978 0x92dd 0x9cc 0xbbd1 0x92b4 0xa15 0xbe2a 0x9284 0xa62 0xc083 0x924c 0xaa4 0xc2dc 0x920f 0xaec 0xc535 0x91d0 0xb48 0xc78e 0x9192 0xbb5 0xc9e7 0x9149 0xc2d 0xcc40 0x90fb 0xcae 0xce99 0x90ac 0xd38 0xd0f2 0x9077 0xdef 0xd34b 0x9052 0xece 0xd5a4 0x9033 0xfe6 0xd7fd 0x900e 0x1130 0xda56 0x8fd0 0x12c0 0xdcaf 0x8f88 0x146a 0xdf08 0x8ebc 0x1631 0xe161 0x8d3b 0x181d 0xe3bb 0x8b0b 0x1b05 0xe613 0x8791 0x2081 0xe86c 0x8396 0x26fc>;
		battery1_profile_t4_num = <0x64>;
		battery1_profile_t4 = <0x00 0xab9c 0x17ca 0x259 0xaa70 0x17ca 0x4b2 0xa98d 0x17ba 0x70b 0xa8d2 0x1784 0x964 0xa82b 0x1748 0xbbd 0xa790 0x1720 0xe16 0xa709 0x16fa 0x106f 0xa681 0x16cc 0x12c8 0xa5fa 0x16a1 0x1521 0xa57c 0x1673 0x177a 0xa501 0x164d 0x19d3 0xa483 0x1615 0x1c2c 0xa40e 0x15f1 0x1e85 0xa39c 0x15cd 0x20de 0xa32c 0x15ba 0x2337 0xa2b6 0x159a 0x2590 0xa246 0x1593 0x27e9 0xa1d4 0x1562 0x2a42 0xa166 0x1523 0x2c9b 0xa0fa 0x14ed 0x2ef4 0xa08e 0x14be 0x314d 0xa033 0x14bb 0x33a6 0x9fdf 0x14e4 0x35ff 0x9f83 0x1517 0x3858 0x9f20 0x154d 0x3ab1 0x9ea4 0x1534 0x3d0a 0x9e13 0x14fc 0x3f63 0x9d77 0x149b 0x41bc 0x9ce3 0x1436 0x4415 0x9c55 0x13e2 0x466e 0x9bd9 0x13ae 0x48c7 0x9b6f 0x1385 0x4b20 0x9b11 0x1375 0x4d79 0x9abc 0x136a 0x4fd2 0x9a70 0x136a 0x522b 0x9a28 0x1369 0x5484 0x99dc 0x135b 0x56dd 0x998d 0x1343 0x5936 0x993a 0x1335 0x5b8f 0x98e5 0x132f 0x5de8 0x9890 0x1318 0x6041 0x9838 0x12f4 0x629a 0x97e6 0x12d4 0x64f3 0x9796 0x12c3 0x674c 0x974c 0x12b7 0x69a5 0x9704 0x12ac 0x6bfe 0x96be 0x12ac 0x6e57 0x967e 0x12bb 0x70b0 0x9640 0x12c3 0x7309 0x9608 0x12d6 0x7563 0x95d1 0x12f1 0x77bc 0x959d 0x12f1 0x7a15 0x956d 0x130b 0x7c6e 0x953f 0x1325 0x7ec7 0x9516 0x1345 0x8120 0x94ee 0x1364 0x8379 0x94c8 0x138e 0x85d2 0x94a5 0x13ab 0x882b 0x9481 0x13c1 0x8a84 0x9464 0x13f2 0x8cdd 0x944e 0x140e 0x8f36 0x943b 0x1438 0x918f 0x9429 0x1460 0x93e8 0x941a 0x149a 0x9641 0x940c 0x14cf 0x989a 0x9401 0x14f9 0x9af3 0x93f3 0x1547 0x9d4c 0x93e7 0x15a2 0x9fa5 0x93d8 0x15f8 0xa1fe 0x93c8 0x165d 0xa457 0x93b9 0x16cd 0xa6b0 0x93a8 0x175d 0xa909 0x9393 0x17e8 0xab62 0x937e 0x188a 0xadbb 0x9368 0x1948 0xb014 0x934b 0x1a02 0xb26d 0x932d 0x1acd 0xb4c6 0x930d 0x1bb8 0xb71f 0x92e7 0x1cab 0xb978 0x92be 0x1dbb 0xbbd1 0x9291 0x1ee8 0xbe2a 0x925f 0x2028 0xc083 0x9229 0x2178 0xc2dc 0x91ef 0x22ef 0xc535 0x91b1 0x2486 0xc78e 0x9174 0x2625 0xc9e7 0x9135 0x2804 0xcc40 0x90f5 0x2a15 0xce99 0x90b6 0x2c55 0xd0f2 0x907a 0x2edf 0xd34b 0x903e 0x318a 0xd5a4 0x9002 0x3406 0xd7fd 0x8fc4 0x3635 0xda56 0x8f7c 0x37fa 0xdcaf 0x8f1f 0x3955 0xdf08 0x8e84 0x3a6c 0xe161 0x8d68 0x3be5 0xe3ba 0x8bd0 0x3e14 0xe613 0x8987 0x41e6 0xe86c 0x85f6 0x481c>;
		battery3_profile_t0_num = <0x64>;
		battery3_profile_t0 = <0x00 0xaac3 0x424 0x259 0xaa14 0x420 0x4b2 0xa979 0x410 0x70b 0xa8f0 0x410 0x964 0xa86c 0x410 0xbbd 0xa7e7 0x406 0xe16 0xa76b 0x408 0x106f 0xa6f1 0x40e 0x12c8 0xa677 0x408 0x1521 0xa5fd 0x406 0x177a 0xa583 0x3fc 0x19d3 0xa509 0x3fc 0x1c2c 0xa492 0x3fc 0x1e85 0xa41d 0x3fc 0x20de 0xa3a6 0x3f8 0x2337 0xa332 0x3f2 0x2590 0xa2bf 0x3f7 0x27e9 0xa24a 0x40f 0x2a42 0xa1d6 0x420 0x2c9b 0xa166 0x431 0x2ef4 0xa0f6 0x442 0x314d 0xa087 0x43d 0x33a6 0xa01c 0x44c 0x35ff 0x9fb2 0x452 0x3858 0x9f49 0x452 0x3ab1 0x9ee1 0x44d 0x3d0a 0x9e7c 0x459 0x3f63 0x9e18 0x465 0x41bc 0x9db7 0x477 0x4415 0x9d57 0x46d 0x466e 0x9cf6 0x46f 0x48c7 0x9c9a 0x474 0x4b20 0x9c41 0x479 0x4d79 0x9be8 0x47e 0x4fd2 0x9b90 0x482 0x522b 0x9b3b 0x489 0x5484 0x9aea 0x495 0x56dd 0x9a9c 0x4a5 0x5936 0x9a4e 0x4be 0x5b8f 0x99ff 0x4cd 0x5de8 0x99b1 0x4e2 0x6041 0x995c 0x4e8 0x629a 0x98f0 0x4f1 0x64f3 0x985f 0x4db 0x674c 0x97e3 0x499 0x69a5 0x9776 0x449 0x6bfe 0x972a 0x425 0x6e57 0x96e6 0x410 0x70b0 0x96a9 0x409 0x7309 0x966a 0x406 0x7563 0x9635 0x3fc 0x77bc 0x9601 0x3fc 0x7a15 0x95cd 0x3fc 0x7c6e 0x959d 0x3fc 0x7ec7 0x9570 0x405 0x8120 0x9544 0x3fc 0x8379 0x951b 0x3fc 0x85d2 0x94f0 0x3fc 0x882b 0x94ca 0x403 0x8a84 0x94a3 0x3fd 0x8cdd 0x9481 0x406 0x8f36 0x9460 0x409 0x918f 0x9440 0x415 0x93e8 0x9422 0x413 0x9641 0x9401 0x419 0x989a 0x93e6 0x42f 0x9af3 0x93ce 0x436 0x9d4c 0x93b4 0x430 0x9fa5 0x9393 0x435 0xa1fe 0x9372 0x438 0xa457 0x9328 0x438 0xa6b0 0x92d6 0x435 0xa909 0x9297 0x423 0xab62 0x9266 0x40b 0xadbb 0x923f 0x3fd 0xb014 0x9211 0x3fc 0xb26d 0x91e3 0x3f8 0xb4c6 0x91bb 0x3fd 0xb71f 0x919a 0x402 0xb978 0x9178 0x3fc 0xbbd1 0x9154 0x406 0xbe2a 0x911e 0x406 0xc083 0x90e1 0x40c 0xc2dc 0x90a3 0x410 0xc535 0x906d 0x410 0xc78e 0x902a 0x41c 0xc9e7 0x8fde 0x424 0xcc40 0x8faf 0x41e 0xce99 0x8fa2 0x416 0xd0f2 0x8f97 0x410 0xd34b 0x8f8a 0x41f 0xd5a4 0x8f73 0x440 0xd7fd 0x8f38 0x458 0xda56 0x8e97 0x480 0xdcaf 0x8d16 0x488 0xdf08 0x8ae3 0x488 0xe161 0x87ee 0x498 0xe3ba 0x8379 0x4d4 0xe613 0x81ac 0x52c 0xe86c 0x81ac 0x5e6>;
		battery3_profile_t1_num = <0x64>;
		battery3_profile_t1 = <0x00 0xab5b 0x424 0x259 0xaab0 0x420 0x4b2 0xaa1b 0x410 0x70b 0xa993 0x410 0x964 0xa911 0x410 0xbbd 0xa88e 0x406 0xe16 0xa813 0x408 0x106f 0xa799 0x40e 0x12c8 0xa71d 0x408 0x1521 0xa6a3 0x406 0x177a 0xa627 0x3fc 0x19d3 0xa5b1 0x3fc 0x1c2c 0xa53c 0x3fc 0x1e85 0xa4c5 0x3fc 0x20de 0xa44f 0x3f8 0x2337 0xa3d9 0x3f2 0x2590 0xa365 0x3f7 0x27e9 0xa2ef 0x40f 0x2a42 0xa27e 0x420 0x2c9b 0xa20e 0x431 0x2ef4 0xa19e 0x442 0x314d 0xa12c 0x43d 0x33a6 0xa0bf 0x44c 0x35ff 0xa051 0x452 0x3858 0x9fe6 0x452 0x3ab1 0x9f7c 0x44d 0x3d0a 0x9f1c 0x459 0x3f63 0x9ebf 0x465 0x41bc 0x9e60 0x477 0x4415 0x9df4 0x46d 0x466e 0x9d80 0x46f 0x48c7 0x9d0c 0x474 0x4b20 0x9ca1 0x479 0x4d79 0x9c43 0x47e 0x4fd2 0x9bf0 0x482 0x522b 0x9ba2 0x489 0x5484 0x9b5b 0x495 0x56dd 0x9b14 0x4a5 0x5936 0x9ac6 0x4be 0x5b8f 0x9a78 0x4cd 0x5de8 0x9a26 0x4e2 0x6041 0x99ce 0x4e8 0x629a 0x9972 0x4f1 0x64f3 0x9903 0x4db 0x674c 0x9883 0x499 0x69a5 0x9802 0x449 0x6bfe 0x979e 0x425 0x6e57 0x9744 0x410 0x70b0 0x96fe 0x409 0x7309 0x96be 0x406 0x7563 0x9680 0x3fc 0x77bc 0x964b 0x3fc 0x7a15 0x9617 0x3fc 0x7c6e 0x95e3 0x3fc 0x7ec7 0x95b4 0x405 0x8120 0x9588 0x3fc 0x8379 0x955f 0x3fc 0x85d2 0x9536 0x3fc 0x882b 0x9510 0x403 0x8a84 0x94e7 0x3fd 0x8cdd 0x94c5 0x406 0x8f36 0x94a2 0x409 0x918f 0x9484 0x415 0x93e8 0x9464 0x413 0x9641 0x9445 0x419 0x989a 0x942c 0x42f 0x9af3 0x9414 0x436 0x9d4c 0x93fa 0x430 0x9fa5 0x93e0 0x435 0xa1fe 0x93c5 0x438 0xa457 0x93ae 0x438 0xa6b0 0x9390 0x435 0xa909 0x936e 0x423 0xab62 0x9347 0x40b 0xadbb 0x9322 0x3fd 0xb014 0x92ff 0x3fc 0xb26d 0x92d5 0x3f8 0xb4c6 0x92ac 0x3fd 0xb71f 0x9288 0x402 0xb978 0x9264 0x3fc 0xbbd1 0x9245 0x406 0xbe2a 0x921f 0x406 0xc083 0x91ee 0x40c 0xc2dc 0x91b3 0x410 0xc535 0x9176 0x410 0xc78e 0x913d 0x41c 0xc9e7 0x9101 0x424 0xcc40 0x90b1 0x41e 0xce99 0x9074 0x416 0xd0f2 0x9045 0x410 0xd34b 0x9036 0x41f 0xd5a4 0x902b 0x440 0xd7fd 0x9018 0x458 0xda56 0x8ffc 0x480 0xdcaf 0x8f81 0x488 0xdf08 0x8ec6 0x488 0xe161 0x8d00 0x498 0xe3ba 0x8aa1 0x4d4 0xe613 0x875f 0x52c 0xe86c 0x824b 0x5e6>;
		battery3_profile_t2_num = <0x64>;
		battery3_profile_t2 = <0x00 0xab71 0x5d2 0x259 0xaab1 0x5d0 0x4b2 0xaa10 0x5cc 0x70b 0xa982 0x5c9 0x964 0xa8f6 0x5b7 0xbbd 0xa872 0x5b4 0xe16 0xa7f1 0x5a8 0x106f 0xa775 0x59c 0x12c8 0xa6fa 0x599 0x1521 0xa683 0x59f 0x177a 0xa608 0x596 0x19d3 0xa591 0x594 0x1c2c 0xa51a 0x58c 0x1e85 0xa4a2 0x58c 0x20de 0xa42d 0x588 0x2337 0xa3ba 0x583 0x2590 0xa349 0x594 0x27e9 0xa2d5 0x590 0x2a42 0xa265 0x596 0x2c9b 0xa1f5 0x59e 0x2ef4 0xa185 0x5aa 0x314d 0xa115 0x5b4 0x33a6 0xa0a6 0x5b4 0x35ff 0xa03a 0x5ba 0x3858 0x9fd4 0x5be 0x3ab1 0x9f70 0x5c0 0x3d0a 0x9f1a 0x5e6 0x3f63 0x9ec0 0x612 0x41bc 0x9e5d 0x629 0x4415 0x9ddb 0x61f 0x466e 0x9d51 0x60d 0x48c7 0x9cca 0x601 0x4b20 0x9c55 0x5fa 0x4d79 0x9bf9 0x601 0x4fd2 0x9bae 0x60d 0x522b 0x9b67 0x619 0x5484 0x9b25 0x61f 0x56dd 0x9ae3 0x621 0x5936 0x9a9d 0x640 0x5b8f 0x9a50 0x64a 0x5de8 0x99f8 0x64a 0x6041 0x999b 0x644 0x629a 0x9937 0x62d 0x64f3 0x98c7 0x5f6 0x674c 0x9853 0x5ba 0x69a5 0x97e8 0x583 0x6bfe 0x9784 0x554 0x6e57 0x9733 0x541 0x70b0 0x96e7 0x52e 0x7309 0x96a5 0x51f 0x7563 0x966a 0x51e 0x77bc 0x9635 0x51e 0x7a15 0x9600 0x519 0x7c6e 0x95cd 0x514 0x7ec7 0x959e 0x51d 0x8120 0x9570 0x516 0x8379 0x9549 0x526 0x85d2 0x9520 0x520 0x882b 0x94fa 0x525 0x8a84 0x94d5 0x528 0x8cdd 0x94b3 0x532 0x8f36 0x9491 0x532 0x918f 0x9471 0x535 0x93e8 0x9454 0x53b 0x9641 0x9436 0x53c 0x989a 0x941b 0x546 0x9af3 0x9402 0x549 0x9d4c 0x93eb 0x550 0x9fa5 0x93d2 0x550 0xa1fe 0x93bc 0x550 0xa457 0x93ac 0x551 0xa6b0 0x939b 0x557 0xa909 0x9387 0x550 0xab62 0x9373 0x554 0xadbb 0x935f 0x55a 0xb014 0x933d 0x54e 0xb26d 0x9317 0x546 0xb4c6 0x92ec 0x546 0xb71f 0x92c5 0x54e 0xb978 0x929f 0x55a 0xbbd1 0x9280 0x571 0xbe2a 0x9257 0x582 0xc083 0x9223 0x588 0xc2dc 0x91e6 0x59b 0xc535 0x91ab 0x5af 0xc78e 0x9171 0x5c1 0xc9e7 0x912e 0x5d9 0xcc40 0x90db 0x5e6 0xce99 0x908e 0x5ee 0xd0f2 0x906e 0x60d 0xd34b 0x9057 0x635 0xd5a4 0x9044 0x671 0xd7fd 0x902c 0x6b3 0xda56 0x9007 0x703 0xdcaf 0x8fc0 0x789 0xdf08 0x8ecd 0x7e0 0xe161 0x8cf7 0x82b 0xe3ba 0x8a80 0x8fd 0xe613 0x8716 0xa7d 0xe86c 0x81a0 0xd70>;
		battery3_profile_t3_num = <0x64>;
		battery3_profile_t3 = <0x00 0xab96 0xa5a 0x259 0xaac1 0xa5e 0x4b2 0xaa17 0xa6a 0x70b 0xa985 0xa5e 0x964 0xa8f9 0xa52 0xbbd 0xa86f 0xa32 0xe16 0xa7f0 0xa20 0x106f 0xa771 0x9f8 0x12c8 0xa6fa 0x9ec 0x1521 0xa683 0x9ec 0x177a 0xa608 0x9e2 0x19d3 0xa592 0x9da 0x1c2c 0xa51d 0x9da 0x1e85 0xa4a8 0x9ce 0x20de 0xa434 0x9ce 0x2337 0xa3c4 0x9ce 0x2590 0xa351 0x9c2 0x27e9 0xa2e3 0x9ad 0x2a42 0xa273 0x9a2 0x2c9b 0xa206 0x99e 0x2ef4 0xa198 0x992 0x314d 0xa12b 0x98d 0x33a6 0xa0bb 0x97e 0x35ff 0xa051 0x971 0x3858 0x9ff1 0x97f 0x3ab1 0x9f95 0x99f 0x3d0a 0x9f40 0x9e0 0x3f63 0x9ee6 0xa22 0x41bc 0x9e79 0xa32 0x4415 0x9def 0xa14 0x466e 0x9d5d 0x9e9 0x48c7 0x9cc6 0x9b2 0x4b20 0x9c45 0x993 0x4d79 0x9bd6 0x981 0x4fd2 0x9b7b 0x987 0x522b 0x9b31 0x983 0x5484 0x9ae9 0x97b 0x56dd 0x9aa3 0x974 0x5936 0x9a5e 0x96d 0x5b8f 0x9a0f 0x961 0x5de8 0x99b2 0x940 0x6041 0x9951 0x919 0x629a 0x98e9 0x8df 0x64f3 0x9881 0x89e 0x674c 0x9820 0x873 0x69a5 0x97c6 0x850 0x6bfe 0x9772 0x838 0x6e57 0x9722 0x81b 0x70b0 0x96de 0x813 0x7309 0x969c 0x816 0x7563 0x9661 0x810 0x77bc 0x9628 0x809 0x7a15 0x95f2 0x7fd 0x7c6e 0x95c0 0x80d 0x7ec7 0x9590 0x816 0x8120 0x9566 0x82a 0x8379 0x953b 0x82a 0x85d2 0x9512 0x834 0x882b 0x94eb 0x845 0x8a84 0x94c5 0x848 0x8cdd 0x94a7 0x853 0x8f36 0x9485 0x85f 0x918f 0x9465 0x866 0x93e8 0x9445 0x86d 0x9641 0x9429 0x870 0x989a 0x9412 0x870 0x9af3 0x93fa 0x873 0x9d4c 0x93ea 0x87f 0x9fa5 0x93da 0x88b 0xa1fe 0x93ce 0x8aa 0xa457 0x93c2 0x8b6 0xa6b0 0x93b1 0x8bf 0xa909 0x93a4 0x8dd 0xab62 0x9393 0x8f7 0xadbb 0x9381 0x918 0xb014 0x9366 0x929 0xb26d 0x9349 0x94d 0xb4c6 0x9328 0x973 0xb71f 0x9303 0x99e 0xb978 0x92dd 0x9cc 0xbbd1 0x92b4 0xa15 0xbe2a 0x9284 0xa62 0xc083 0x924c 0xaa4 0xc2dc 0x920f 0xaec 0xc535 0x91d0 0xb48 0xc78e 0x9192 0xbb5 0xc9e7 0x9149 0xc2d 0xcc40 0x90fb 0xcae 0xce99 0x90ac 0xd38 0xd0f2 0x9077 0xdef 0xd34b 0x9052 0xece 0xd5a4 0x9033 0xfe6 0xd7fd 0x900e 0x1130 0xda56 0x8fd0 0x12c0 0xdcaf 0x8f88 0x146a 0xdf08 0x8ebc 0x1631 0xe161 0x8d3b 0x181d 0xe3bb 0x8b0b 0x1b05 0xe613 0x8791 0x2081 0xe86c 0x8396 0x26fc>;
		battery3_profile_t4_num = <0x64>;
		battery3_profile_t4 = <0x00 0xab9c 0x17ca 0x259 0xaa70 0x17ca 0x4b2 0xa98d 0x17ba 0x70b 0xa8d2 0x1784 0x964 0xa82b 0x1748 0xbbd 0xa790 0x1720 0xe16 0xa709 0x16fa 0x106f 0xa681 0x16cc 0x12c8 0xa5fa 0x16a1 0x1521 0xa57c 0x1673 0x177a 0xa501 0x164d 0x19d3 0xa483 0x1615 0x1c2c 0xa40e 0x15f1 0x1e85 0xa39c 0x15cd 0x20de 0xa32c 0x15ba 0x2337 0xa2b6 0x159a 0x2590 0xa246 0x1593 0x27e9 0xa1d4 0x1562 0x2a42 0xa166 0x1523 0x2c9b 0xa0fa 0x14ed 0x2ef4 0xa08e 0x14be 0x314d 0xa033 0x14bb 0x33a6 0x9fdf 0x14e4 0x35ff 0x9f83 0x1517 0x3858 0x9f20 0x154d 0x3ab1 0x9ea4 0x1534 0x3d0a 0x9e13 0x14fc 0x3f63 0x9d77 0x149b 0x41bc 0x9ce3 0x1436 0x4415 0x9c55 0x13e2 0x466e 0x9bd9 0x13ae 0x48c7 0x9b6f 0x1385 0x4b20 0x9b11 0x1375 0x4d79 0x9abc 0x136a 0x4fd2 0x9a70 0x136a 0x522b 0x9a28 0x1369 0x5484 0x99dc 0x135b 0x56dd 0x998d 0x1343 0x5936 0x993a 0x1335 0x5b8f 0x98e5 0x132f 0x5de8 0x9890 0x1318 0x6041 0x9838 0x12f4 0x629a 0x97e6 0x12d4 0x64f3 0x9796 0x12c3 0x674c 0x974c 0x12b7 0x69a5 0x9704 0x12ac 0x6bfe 0x96be 0x12ac 0x6e57 0x967e 0x12bb 0x70b0 0x9640 0x12c3 0x7309 0x9608 0x12d6 0x7563 0x95d1 0x12f1 0x77bc 0x959d 0x12f1 0x7a15 0x956d 0x130b 0x7c6e 0x953f 0x1325 0x7ec7 0x9516 0x1345 0x8120 0x94ee 0x1364 0x8379 0x94c8 0x138e 0x85d2 0x94a5 0x13ab 0x882b 0x9481 0x13c1 0x8a84 0x9464 0x13f2 0x8cdd 0x944e 0x140e 0x8f36 0x943b 0x1438 0x918f 0x9429 0x1460 0x93e8 0x941a 0x149a 0x9641 0x940c 0x14cf 0x989a 0x9401 0x14f9 0x9af3 0x93f3 0x1547 0x9d4c 0x93e7 0x15a2 0x9fa5 0x93d8 0x15f8 0xa1fe 0x93c8 0x165d 0xa457 0x93b9 0x16cd 0xa6b0 0x93a8 0x175d 0xa909 0x9393 0x17e8 0xab62 0x937e 0x188a 0xadbb 0x9368 0x1948 0xb014 0x934b 0x1a02 0xb26d 0x932d 0x1acd 0xb4c6 0x930d 0x1bb8 0xb71f 0x92e7 0x1cab 0xb978 0x92be 0x1dbb 0xbbd1 0x9291 0x1ee8 0xbe2a 0x925f 0x2028 0xc083 0x9229 0x2178 0xc2dc 0x91ef 0x22ef 0xc535 0x91b1 0x2486 0xc78e 0x9174 0x2625 0xc9e7 0x9135 0x2804 0xcc40 0x90f5 0x2a15 0xce99 0x90b6 0x2c55 0xd0f2 0x907a 0x2edf 0xd34b 0x903e 0x318a 0xd5a4 0x9002 0x3406 0xd7fd 0x8fc4 0x3635 0xda56 0x8f7c 0x37fa 0xdcaf 0x8f1f 0x3955 0xdf08 0x8e84 0x3a6c 0xe161 0x8d68 0x3be5 0xe3ba 0x8bd0 0x3e14 0xe613 0x8987 0x41e6 0xe86c 0x85f6 0x481c>;
		battery2_profile_t0_num = <0x64>;
		battery2_profile_t0 = <0x00 0xab1d 0x352 0x263 0xaa7f 0x354 0x4c6 0xa9f6 0x358 0x729 0xa975 0x352 0x98c 0xa8fb 0x35b 0xbf0 0xa882 0x35b 0xe53 0xa806 0x352 0x10b6 0xa78d 0x357 0x1319 0xa714 0x35c 0x157c 0xa69b 0x35c 0x17df 0xa622 0x35e 0x1a42 0xa5a9 0x362 0x1ca5 0xa530 0x356 0x1f08 0xa4ba 0x35b 0x216c 0xa444 0x365 0x23cf 0xa3cd 0x35c 0x2632 0xa359 0x35c 0x2895 0xa2e8 0x36b 0x2af8 0xa273 0x366 0x2d5b 0xa1fe 0x35c 0x2fbe 0xa18d 0x360 0x3221 0xa120 0x372 0x3484 0xa0b3 0x372 0x36e8 0xa043 0x370 0x394b 0x9fd5 0x370 0x3bae 0x9f6b 0x370 0x3e11 0x9f01 0x369 0x4074 0x9e9a 0x379 0x42d7 0x9e36 0x37a 0x453a 0x9dd2 0x37a 0x479d 0x9d70 0x380 0x4a00 0x9d0d 0x384 0x4c64 0x9cb0 0x389 0x4ec7 0x9c54 0x38e 0x512a 0x9bf9 0x38e 0x538d 0x9ba0 0x395 0x55f0 0x9b49 0x398 0x5853 0x9af6 0x3a3 0x5ab6 0x9aa6 0x3b0 0x5d19 0x9a55 0x3bc 0x5f7c 0x9a05 0x3c8 0x61e0 0x99b2 0x3ca 0x6443 0x995d 0x3e6 0x66a6 0x98eb 0x3d9 0x6909 0x985b 0x3a5 0x6b6c 0x97c9 0x373 0x6dcf 0x9765 0x366 0x7032 0x9715 0x366 0x7295 0x96d1 0x366 0x74f8 0x9693 0x366 0x775c 0x9656 0x35c 0x79bf 0x961b 0x354 0x7c22 0x95e6 0x35c 0x7e85 0x95b4 0x35c 0x80e8 0x9581 0x353 0x834b 0x9553 0x35b 0x85ae 0x9525 0x355 0x8811 0x94fc 0x359 0x8a74 0x94d4 0x353 0x8cd8 0x94ae 0x365 0x8f3b 0x9486 0x35e 0x919e 0x9464 0x366 0x9401 0x9442 0x366 0x9664 0x9422 0x366 0x98c7 0x9401 0x367 0x9b2a 0x93e6 0x373 0x9d8d 0x93cc 0x37a 0x9ff0 0x93b2 0x381 0xa254 0x9399 0x38d 0xa4b7 0x937e 0x396 0xa71a 0x9358 0x38a 0xa97d 0x9318 0x366 0xabe0 0x92c6 0x34a 0xae43 0x9281 0x348 0xb0a6 0x9259 0x355 0xb309 0x9230 0x35c 0xb56c 0x9206 0x35c 0xb7d0 0x91dd 0x35c 0xba33 0x91b8 0x362 0xbc96 0x9195 0x366 0xbef9 0x9175 0x372 0xc15c 0x9155 0x37a 0xc3bf 0x9125 0x37a 0xc622 0x90e5 0x36e 0xc885 0x90a6 0x366 0xcae8 0x906c 0x36d 0xcd4c 0x902b 0x379 0xcfaf 0x8fd8 0x36b 0xd212 0x8fa5 0x34d 0xd475 0x8f98 0x35f 0xd6d8 0x8f8e 0x376 0xd93b 0x8f84 0x38e 0xdb9e 0x8f6f 0x3c1 0xde01 0x8f2f 0x3db 0xe064 0x8ea8 0x3b6 0xe2c8 0x8d5f 0x3ac 0xe52b 0x8b58 0x3cd 0xf47d 0x888a 0x3f8 0xf47d 0x86a0 0x41a 0xf47d 0x86a0 0x41a>;
		battery2_profile_t1_num = <0x64>;
		battery2_profile_t1 = <0x00 0xab58 0x4d8 0x263 0xaabb 0x4d8 0x4c6 0xaa38 0x4d8 0x729 0xa9bb 0x4d1 0x98c 0xa942 0x4d7 0xbf0 0xa8c5 0x4d6 0xe53 0xa848 0x4c6 0x10b6 0xa7cd 0x4cc 0x1319 0xa751 0x4ce 0x157c 0xa6d7 0x4c4 0x17df 0xa661 0x4ce 0x1a42 0xa5e8 0x4ca 0x1ca5 0xa56f 0x4c1 0x1f08 0xa4f8 0x4bb 0x216c 0xa482 0x4ba 0x23cf 0xa40a 0x4b7 0x2632 0xa396 0x4b3 0x2895 0xa325 0x4b9 0x2af8 0xa2b3 0x4c4 0x2d5b 0xa23e 0x4b8 0x2fbe 0xa1ce 0x4ac 0x3221 0xa15f 0x4a6 0x3484 0xa0ef 0x4a6 0x36e8 0xa07e 0x4a7 0x394b 0xa00f 0x4ad 0x3bae 0x9fa1 0x4ac 0x3e11 0x9f3f 0x4c0 0x4074 0x9ee2 0x4d8 0x42d7 0x9ea9 0x51e 0x453a 0x9e46 0x511 0x479d 0x9db4 0x500 0x4a00 0x9d1d 0x4fc 0x4c64 0x9c8b 0x4f6 0x4ec7 0x9c21 0x500 0x512a 0x9bdc 0x51f 0x538d 0x9ba9 0x530 0x55f0 0x9b6a 0x537 0x5853 0x9b26 0x53a 0x5ab6 0x9ad7 0x53f 0x5d19 0x9a89 0x55d 0x5f7c 0x9a38 0x56d 0x61e0 0x99e6 0x57a 0x6443 0x998d 0x58c 0x66a6 0x9927 0x576 0x6909 0x98a4 0x526 0x6b6c 0x980a 0x4c4 0x6dcf 0x979d 0x49f 0x7032 0x973a 0x488 0x7295 0x96ef 0x488 0x74f8 0x96a9 0x488 0x775c 0x966f 0x474 0x79bf 0x9636 0x474 0x7c22 0x95ff 0x47f 0x7e85 0x95cd 0x480 0x80e8 0x959e 0x488 0x834b 0x9571 0x488 0x85ae 0x9546 0x488 0x8811 0x951b 0x47b 0x8a74 0x94f2 0x46b 0x8cd8 0x94c9 0x461 0x8f3b 0x94a7 0x46d 0x919e 0x9484 0x47a 0x9401 0x9462 0x476 0x9664 0x9446 0x488 0x98c7 0x9429 0x488 0x9b2a 0x940c 0x488 0x9d8d 0x93f0 0x48f 0x9ff0 0x93d9 0x49b 0xa254 0x93c2 0x49c 0xa4b7 0x93ab 0x49e 0xa71a 0x9390 0x4a4 0xa97d 0x9373 0x49e 0xabe0 0x934b 0x488 0xae43 0x931f 0x475 0xb0a6 0x92fb 0x47b 0xb309 0x92d8 0x477 0xb56c 0x92b3 0x474 0xb7d0 0x928e 0x47e 0xba33 0x9268 0x47e 0xbc96 0x9245 0x481 0xbef9 0x9227 0x487 0xc15c 0x9203 0x488 0xc3bf 0x91da 0x488 0xc622 0x919f 0x48c 0xc885 0x915f 0x48f 0xcae8 0x911d 0x489 0xcd4c 0x90e2 0x47f 0xcfaf 0x9094 0x485 0xd212 0x9043 0x478 0xd475 0x9022 0x47c 0xd6d8 0x9013 0x488 0xd93b 0x9007 0x496 0xdb9e 0x8ffb 0x4b3 0xde01 0x8fe3 0x4d8 0xe064 0x8f8c 0x4f8 0xe2c8 0x8f05 0x510 0xe52b 0x8d4c 0x4fd 0xf47d 0x8af5 0x53a 0xf47d 0x87c0 0x5a6 0xf47d 0x871c 0x5be>;
		battery2_profile_t2_num = <0x64>;
		battery2_profile_t2 = <0x00 0xab9c 0x97e 0x263 0xaaf1 0x985 0x4c6 0xaa66 0x9a3 0x729 0xa9e5 0x9b5 0x98c 0xa962 0x99f 0xbf0 0xa8e3 0x990 0xe53 0xa860 0x974 0x10b6 0xa7e3 0x94f 0x1319 0xa76c 0x92b 0x157c 0xa6f3 0x906 0x17df 0xa67a 0x8eb 0x1a42 0xa600 0x8d0 0x1ca5 0xa589 0x8c0 0x1f08 0xa514 0x8ae 0x216c 0xa49c 0x8a1 0x23cf 0xa429 0x898 0x2632 0xa3b5 0x898 0x2895 0xa345 0x89c 0x2af8 0xa2d5 0x8a2 0x2d5b 0xa266 0x8ac 0x2fbe 0xa1f5 0x8b0 0x3221 0xa185 0x8af 0x3484 0xa114 0x8b0 0x36e8 0xa0a3 0x8b6 0x394b 0xa036 0x8b6 0x3bae 0x9fd1 0x8b6 0x3e11 0x9f7c 0x8cd 0x4074 0x9f3a 0x8fc 0x42d7 0x9ef4 0x924 0x453a 0x9e79 0x91b 0x479d 0x9dcf 0x8ef 0x4a00 0x9d22 0x8cc 0x4c64 0x9c7d 0x8b5 0x4ec7 0x9c02 0x8af 0x512a 0x9b9f 0x8b6 0x538d 0x9b50 0x8c6 0x55f0 0x9b1b 0x8ed 0x5853 0x9ae9 0x912 0x5ab6 0x9ab3 0x91e 0x5d19 0x9a72 0x924 0x5f7c 0x9a1e 0x91b 0x61e0 0x99c2 0x909 0x6443 0x9961 0x8f2 0x66a6 0x98f0 0x8bd 0x6909 0x9873 0x86c 0x6b6c 0x97f8 0x816 0x6dcf 0x9796 0x7eb 0x7032 0x973a 0x7c7 0x7295 0x96ed 0x7af 0x74f8 0x96a9 0x79f 0x775c 0x966c 0x79d 0x79bf 0x9631 0x794 0x7c22 0x95fc 0x794 0x7e85 0x95cc 0x794 0x80e8 0x9598 0x794 0x834b 0x956d 0x79a 0x85ae 0x9542 0x7a2 0x8811 0x9516 0x7a8 0x8a74 0x94ee 0x7a8 0x8cd8 0x94cc 0x7b3 0x8f3b 0x94a8 0x7b9 0x919e 0x9484 0x7bc 0x9401 0x9462 0x7bc 0x9664 0x9446 0x7c6 0x98c7 0x9429 0x7c9 0x9b2a 0x9410 0x7dc 0x9d8d 0x93f4 0x7dd 0x9ff0 0x93dc 0x7e3 0xa254 0x93c8 0x7ee 0xa4b7 0x93b7 0x7f3 0xa71a 0x93aa 0x805 0xa97d 0x939e 0x81c 0xabe0 0x938f 0x82a 0xae43 0x9380 0x836 0xb0a6 0x936a 0x83e 0xb309 0x934f 0x83e 0xb56c 0x932f 0x83e 0xb7d0 0x9309 0x848 0xba33 0x92dd 0x84b 0xbc96 0x92b7 0x86b 0xbef9 0x9297 0x8a2 0xc15c 0x926f 0x8c0 0xc3bf 0x9242 0x8ef 0xc622 0x9203 0x90f 0xc885 0x91c2 0x938 0xcae8 0x9183 0x96f 0xcd4c 0x9145 0x9ad 0xcfaf 0x90f7 0x9ef 0xd212 0x90a8 0xa31 0xd475 0x906e 0xa86 0xd6d8 0x9051 0xaf0 0xd93b 0x9037 0xb7d 0xdb9e 0x901d 0xc31 0xde01 0x8ff2 0xd27 0xe064 0x8fbe 0xe46 0xe2c8 0x8f29 0xfa2 0xe52b 0x8db4 0x1123 0xf47d 0x8b68 0x135d 0xf47d 0x87cc 0x1735 0xf47d 0x83a0 0x1bb2>;
		battery2_profile_t3_num = <0x64>;
		battery2_profile_t3 = <0x00 0xab9c 0x12e8 0x263 0xaad5 0x12eb 0x4c6 0xaa36 0x12fe 0x729 0xa9a1 0x130d 0x98c 0xa912 0x1307 0xbf0 0xa889 0x12f6 0xe53 0xa803 0x12d7 0x10b6 0xa785 0x12e7 0x1319 0xa70a 0x12b7 0x157c 0xa690 0x127a 0x17df 0xa617 0x1244 0x1a42 0xa59f 0x1222 0x1ca5 0xa526 0x11fb 0x1f08 0xa4b1 0x11dd 0x216c 0xa43e 0x11cf 0x23cf 0xa3ca 0x11bf 0x2632 0xa35a 0x11aa 0x2895 0xa2ec 0x1197 0x2af8 0xa27e 0x1194 0x2d5b 0xa20f 0x1192 0x2fbe 0xa19b 0x118a 0x3221 0xa12b 0x1186 0x3484 0xa0bd 0x117d 0x36e8 0xa050 0x1178 0x394b 0x9ff4 0x118d 0x3bae 0x9fa4 0x11aa 0x3e11 0x9f58 0x11c8 0x4074 0x9f0a 0x11da 0x42d7 0x9e8a 0x11aa 0x453a 0x9de0 0x1151 0x479d 0x9d27 0x10fb 0x4a00 0x9c89 0x10c5 0x4c64 0x9bf8 0x10a3 0x4ec7 0x9b89 0x109d 0x512a 0x9b32 0x10aa 0x538d 0x9ae9 0x10c5 0x55f0 0x9aac 0x10e5 0x5853 0x9a6e 0x10fc 0x5ab6 0x9a2c 0x10f4 0x5d19 0x99e0 0x10e7 0x5f7c 0x9987 0x10ce 0x61e0 0x9922 0x108f 0x6443 0x98ba 0x1051 0x66a6 0x9850 0x102b 0x6909 0x97eb 0x1012 0x6b6c 0x978b 0xff0 0x6dcf 0x9736 0xfbf 0x7032 0x96e4 0xf97 0x7295 0x969d 0xf8c 0x74f8 0x965b 0xf8c 0x775c 0x961f 0xf96 0x79bf 0x95e8 0xf96 0x7c22 0x95b5 0xfa1 0x7e85 0x9583 0xfaa 0x80e8 0x9554 0xfb4 0x834b 0x952a 0xfb8 0x85ae 0x9501 0xfd1 0x8811 0x94d9 0xff7 0x8a74 0x94b6 0x1016 0x8cd8 0x9491 0x1037 0x8f3b 0x946f 0x1045 0x919e 0x944f 0x1057 0x9401 0x9435 0x1066 0x9664 0x941b 0x1086 0x98c7 0x9408 0x1097 0x9b2a 0x93f6 0x10c0 0x9d8d 0x93e7 0x10f1 0x9ff0 0x93db 0x1133 0xa254 0x93cc 0x115b 0xa4b7 0x93c0 0x1187 0xa71a 0x93b2 0x11be 0xa97d 0x93a4 0x11ef 0xabe0 0x9393 0x122a 0xae43 0x9382 0x127b 0xb0a6 0x936a 0x12b4 0xb309 0x934e 0x12f2 0xb56c 0x9332 0x133b 0xb7d0 0x9310 0x137d 0xba33 0x92ec 0x13d8 0xbc96 0x92c2 0x142c 0xbef9 0x9295 0x148e 0xc15c 0x9266 0x14f0 0xc3bf 0x922f 0x1568 0xc622 0x91f0 0x15e3 0xc885 0x91ae 0x1683 0xcae8 0x9168 0x173c 0xcd4c 0x911e 0x17fb 0xcfaf 0x90cc 0x18cb 0xd212 0x9084 0x19b1 0xd475 0x904d 0x1ac9 0xd6d8 0x9024 0x1c1b 0xd93b 0x8ffb 0x1d88 0xdb9e 0x8fce 0x1f5b 0xde01 0x8f8d 0x2198 0xe064 0x8f17 0x242b 0xe2c8 0x8deb 0x2756 0xe52b 0x8c64 0x2ad0 0xf47d 0x89c4 0x2f88 0xf47d 0x8611 0x354a 0xf47d 0x8552 0x3660>;
		battery2_profile_t4_num = <0x64>;
		battery2_profile_t4 = <0x00 0xabe7 0x2d28 0x263 0xaaf2 0x2d4e 0x4c6 0xaa2f 0x2dc5 0x729 0xa97d 0x2da0 0x98c 0xa8d6 0x2d3d 0xbf0 0xa837 0x2cb9 0xe53 0xa7a2 0x2c3b 0x10b6 0xa714 0x2bb2 0x1319 0xa68a 0x2b26 0x157c 0xa604 0x2a9e 0x17df 0xa584 0x2a10 0x1a42 0xa508 0x2991 0x1ca5 0xa48f 0x2911 0x1f08 0xa416 0x2897 0x216c 0xa3a4 0x281d 0x23cf 0xa332 0x27a6 0x2632 0xa2c0 0x2727 0x2895 0xa24f 0x2699 0x2af8 0xa1dd 0x260c 0x2d5b 0xa16f 0x25db 0x2fbe 0xa104 0x25aa 0x3221 0xa0a2 0x2587 0x3484 0xa048 0x2554 0x36e8 0x9ff1 0x2519 0x394b 0x9f94 0x24f1 0x3bae 0x9f27 0x249e 0x3e11 0x9e96 0x2409 0x4074 0x9df6 0x2364 0x42d7 0x9d50 0x22af 0x453a 0x9cb5 0x220d 0x479d 0x9c2d 0x21af 0x4a00 0x9bbb 0x217a 0x4c64 0x9b50 0x2144 0x4ec7 0x9af4 0x2123 0x512a 0x9aa3 0x2124 0x538d 0x9a56 0x2120 0x55f0 0x9a0a 0x2111 0x5853 0x99bd 0x20fb 0x5ab6 0x996a 0x20d2 0x5d19 0x9914 0x20a1 0x5f7c 0x98bc 0x2079 0x61e0 0x9863 0x2052 0x6443 0x980a 0x2026 0x66a6 0x97b8 0x2037 0x6909 0x9763 0x2044 0x6b6c 0x9712 0x2026 0x6dcf 0x96c9 0x1ffb 0x7032 0x9682 0x1fce 0x7295 0x9642 0x1fab 0x74f8 0x9607 0x1fb6 0x775c 0x95cb 0x1fc2 0x79bf 0x9598 0x1fc2 0x7c22 0x9566 0x1fbc 0x7e85 0x9537 0x1fb0 0x80e8 0x950a 0x1fb8 0x834b 0x94e6 0x1fd0 0x85ae 0x94c3 0x1fe4 0x8811 0x94a4 0x2019 0x8a74 0x9489 0x2054 0x8cd8 0x9470 0x209a 0x8f3b 0x945b 0x20d7 0x919e 0x9447 0x2109 0x9401 0x9434 0x215c 0x9664 0x9421 0x21a2 0x98c7 0x9412 0x2213 0x9b2a 0x9403 0x225d 0x9d8d 0x93f1 0x22b3 0x9ff0 0x93e4 0x2315 0xa254 0x93d3 0x236e 0xa4b7 0x93c2 0x23dc 0xa71a 0x93b1 0x244a 0xa97d 0x93a2 0x24a1 0xabe0 0x938f 0x2512 0xae43 0x9379 0x25a0 0xb0a6 0x9360 0x261a 0xb309 0x9346 0x2695 0xb56c 0x9329 0x2732 0xb7d0 0x930a 0x27d0 0xba33 0x92e6 0x286b 0xbc96 0x92be 0x2924 0xbef9 0x9291 0x29ea 0xc15c 0x9260 0x2a9e 0xc3bf 0x9227 0x2b7b 0xc622 0x91eb 0x2c8e 0xc885 0x91ab 0x2d94 0xcae8 0x916a 0x2ed5 0xcd4c 0x911f 0x3003 0xcfaf 0x90d0 0x315d 0xd212 0x9089 0x32c2 0xd475 0x9047 0x342a 0xd6d8 0x900f 0x3584 0xd93b 0x8fe4 0x3701 0xdb9e 0x8fb5 0x389a 0xde01 0x8f79 0x3a4b 0xe064 0x8f31 0x3bf7 0xe2c8 0x8e9f 0x3dea 0xe52b 0x8d64 0x4003 0xf47d 0x8b56 0x4283 0xf47d 0x87e3 0x4707 0xf47d 0x83da 0x4c54>;
		linux,phandle = <0x78>;
		phandle = <0x78>;
	};

	topmisc@10011000 {
		compatible = "mediatek,topmisc";
		reg = <0x00 0x10011000 0x00 0x1000>;
	};

	dvfsrc@10012000 {
		compatible = "mediatek,dvfsrc";
		reg = <0x00 0x10012000 0x00 0x1000 0x00 0x110780 0x00 0x80>;
	};

	mbist_ao@10013000 {
		compatible = "mediatek,mbist_ao";
		reg = <0x00 0x10013000 0x00 0x1000>;
	};

	apcldmain_ao@10014000 {
		compatible = "mediatek,apcldmain_ao";
		reg = <0x00 0x10014000 0x00 0x400>;
	};

	apcldmaout_ao@10014400 {
		compatible = "mediatek,apcldmaout_ao";
		reg = <0x00 0x10014400 0x00 0x400>;
	};

	apcldmamisc_ao@10014800 {
		compatible = "mediatek,apcldmamisc_ao";
		reg = <0x00 0x10014800 0x00 0x400>;
	};

	ddrphy@10015000 {
		compatible = "mediatek,ddrphy";
		reg = <0x00 0x10015000 0x00 0x1000>;
	};

	aes_top0@10016000 {
		compatible = "mediatek,aes_top0";
		reg = <0x00 0x10016000 0x00 0x1000>;
	};

	sys_timer@10017000 {
		compatible = "mediatek,sys_timer";
		reg = <0x00 0x10017000 0x00 0x1000>;
		reg-names = "sys_timer_base";
		interrupts = <0x00 0xc2 0x04>;
	};

	modem_temp_share@10018000 {
		compatible = "mediatek,modem_temp_share";
		reg = <0x00 0x10018000 0x00 0x1000>;
	};

	security_ao@1001a000 {
		compatible = "mediatek,security_ao";
		reg = <0x00 0x1001a000 0x00 0x1000>;
	};

	topckgen_ao@1001b000 {
		compatible = "mediatek,topckgen_ao";
		reg = <0x00 0x1001b000 0x00 0x1000>;
	};

	dramc0@1001d000 {
		compatible = "mediatek,dramc0";
		reg = <0x00 0x1001d000 0x00 0x1000>;
	};

	ddrphy@1001e000 {
		compatible = "mediatek,ddrphy";
		reg = <0x00 0x1001e000 0x00 0x1000>;
	};

	iocfg_0@10002000 {
		compatible = "mediatek,iocfg_0";
		reg = <0x00 0x10002000 0x00 0x200>;
	};

	iocfg_1@10002200 {
		compatible = "mediatek,iocfg_1";
		reg = <0x00 0x10002200 0x00 0x200>;
	};

	iocfg_2@10002400 {
		compatible = "mediatek,iocfg_2";
		reg = <0x00 0x10002400 0x00 0x200>;
	};

	iocfg_3@10002600 {
		compatible = "mediatek,iocfg_3";
		reg = <0x00 0x10002600 0x00 0x200>;
	};

	iocfg_4@10002800 {
		compatible = "mediatek,iocfg_4";
		reg = <0x00 0x10002800 0x00 0x200>;
	};

	iocfg_5@10002a00 {
		compatible = "mediatek,iocfg_5";
		reg = <0x00 0x10002a00 0x00 0x200>;
	};

	mdcldmain_ao@10015000 {
		compatible = "mediatek,mdcldmain_ao";
		reg = <0x00 0x10015000 0x00 0x400>;
	};

	mdcldmaout_ao@10015400 {
		compatible = "mediatek,mdcldmaout_ao";
		reg = <0x00 0x10015400 0x00 0x400>;
	};

	mdcldmamisc_ao@10015800 {
		compatible = "mediatek,mdcldmamisc_ao";
		reg = <0x00 0x10015800 0x00 0x400>;
	};

	sys_cirq@10204000 {
		compatible = "mediatek,sys_cirq";
		reg = <0x00 0x10204000 0x00 0x1000>;
		mediatek,cirq_num = <0xd1>;
		mediatek,spi_start_offset = <0x48>;
		interrupts = <0x00 0x118 0x08>;
	};

	mcucfg@10200000 {
		compatible = "mediatek,mcucfg";
		reg = <0x00 0x10200000 0x00 0x1000>;
		interrupts = <0x00 0x00 0x08>;
	};

	mcucfg_mp0_counter@10200000 {
		compatible = "mediatek,mcucfg_mp0_counter";
		reg = <0x00 0x10200000 0x00 0x4000>;
	};

	m4u@10205000 {
		cell-index = <0x00>;
		compatible = "mediatek,iommu_v0";
		reg = <0x00 0x10205000 0x00 0x1000>;
		mediatek,larbs = <0x20 0x21 0x22 0x23>;
		interrupts = <0x00 0x9e 0x08>;
		#iommu-cells = <0x01>;
		linux,phandle = <0x4b>;
		phandle = <0x4b>;
	};

	devapc@10207000 {
		compatible = "mediatek,devapc";
		reg = <0x00 0x10207000 0x00 0x1000 0x00 0x1000e000 0x00 0x1000>;
		interrupts = <0x00 0x8e 0x08>;
		clocks = <0x24 0x28>;
		clock-names = "devapc-infra-clock";
	};

	bus_dbg@10208000 {
		compatible = "mediatek,bus_dbg-v2";
		reg = <0x00 0x10208000 0x00 0x1000 0x00 0x10001000 0x00 0x1000>;
		mediatek,bus_dbg_con_offset = <0x2fc>;
		interrupts = <0x00 0x8d 0x08>;
	};

	ap_ccif0@10209000 {
		compatible = "mediatek,ap_ccif0";
		reg = <0x00 0x10209000 0x00 0x1000>;
		interrupts = <0x00 0x94 0x08>;
	};

	md_ccif0@1020a000 {
		compatible = "mediatek,md_ccif0";
		reg = <0x00 0x1020a000 0x00 0x1000>;
	};

	ap_ccif1@1020b000 {
		compatible = "mediatek,ap_ccif1";
		reg = <0x00 0x1020b000 0x00 0x1000>;
		interrupts = <0x00 0x96 0x08>;
	};

	md_ccif1@1020c000 {
		compatible = "mediatek,md_ccif1";
		reg = <0x00 0x1020c000 0x00 0x1000>;
	};

	infra_mbist@1020d000 {
		compatible = "mediatek,infra_mbist";
		reg = <0x00 0x1020d000 0x00 0x1000>;
	};

	infracfg@1020e000 {
		compatible = "mediatek,infracfg";
		reg = <0x00 0x1020e000 0x00 0x1000>;
	};

	trng@1020f000 {
		compatible = "mediatek,trng";
		reg = <0x00 0x1020f000 0x00 0x1000>;
		interrupts = <0x00 0xa1 0x08>;
	};

	dxcc_sec@10210000 {
		compatible = "mediatek,dxcc_sec";
		reg = <0x00 0x10210000 0x00 0x1000>;
		interrupts = <0x00 0xa2 0x04>;
	};

	mcupm_sram2@10211000 {
		compatible = "mediatek,mcupm_sram2";
		reg = <0x00 0x10211000 0x00 0x1000>;
	};

	cq_dma@10212000 {
		compatible = "mediatek,mt-cqdma-v1";
		reg = <0x00 0x10212000 0x00 0x80 0x00 0x10212080 0x00 0x80>;
		interrupts = <0x00 0x71 0x08 0x00 0x72 0x08>;
		nr_channel = <0x02>;
		keep_clock_ao = "yes";
		clocks = <0x24 0x43>;
		clock-names = "cqdma";
	};

	mcupm_sram3@10213000 {
		compatible = "mediatek,mcupm_sram3";
		reg = <0x00 0x10213000 0x00 0x1000>;
	};

	sramrom@10214000 {
		compatible = "mediatek,sramrom";
		reg = <0x00 0x10214000 0x00 0x1000>;
	};

	mcupm_reg@10216000 {
		compatible = "mediatek,mcupm_reg";
		reg = <0x00 0x10216000 0x00 0x1000>;
	};

	mcupm_sram0@10217000 {
		compatible = "mediatek,mcupm_sram0";
		reg = <0x00 0x10217000 0x00 0x1000>;
	};

	mcupm_sram1@10218000 {
		compatible = "mediatek,mcupm_sram1";
		reg = <0x00 0x10218000 0x00 0x1000>;
	};

	emi@10219000 {
		compatible = "mediatek,emi";
		reg = <0x00 0x10219000 0x00 0x1000 0x00 0x10226000 0x00 0x1000 0x00 0x1022d000 0x00 0x1000 0x00 0x10235000 0x00 0x1000>;
		interrupts = <0x00 0x90 0x08>;
	};

	apcldmain@1021b000 {
		compatible = "mediatek,apcldmain";
		reg = <0x00 0x1021b000 0x00 0x00>;
	};

	apcldmaout@1021b400 {
		compatible = "mediatek,apcldmaout";
		reg = <0x00 0x1021b400 0x00 0x00>;
	};

	apcldmamisc@1021b800 {
		compatible = "mediatek,apcldmamisc";
		reg = <0x00 0x1021b800 0x00 0x00>;
		interrupts = <0x00 0xa5 0x04>;
	};

	mdcldmain@1021c000 {
		compatible = "mediatek,mdcldmain";
		reg = <0x00 0x1021c000 0x00 0x400>;
	};

	mdcldmaout@1021c400 {
		compatible = "mediatek,mdcldmaout";
		reg = <0x00 0x1021c400 0x00 0x400>;
	};

	mdcldmamisc@1021c800 {
		compatible = "mediatek,mdcldmamisc";
		reg = <0x00 0x1021c800 0x00 0x1000>;
	};

	mdcldma@10014000 {
		compatible = "mediatek,mdcldma";
		reg = <0x00 0x10014000 0x00 0x1000 0x00 0x1021b000 0x00 0x1000 0x00 0x10209000 0x00 0x1000 0x00 0x1020a000 0x00 0x1000>;
		interrupts = <0x00 0xa5 0x04 0x00 0x94 0x08 0x00 0x95 0x08 0x00 0x105 0x02>;
		mediatek,md_id = <0x00>;
		mediatek,cldma_capability = <0x06>;
		clocks = <0x25 0x00 0x24 0x32 0x24 0x29 0x24 0x2c 0x24 0x23 0x24 0x24 0x24 0x51 0x24 0x52>;
		clock-names = "scp-sys-md1-main\0infra-cldma-bclk\0infra-ccif-ap\0infra-ccif-md\0infra-ccif1-ap\0infra-ccif1-md\0infra-ccif2-ap\0infra-ccif2-md";
		linux,phandle = <0x1c>;
		phandle = <0x1c>;
	};

	dramc_nao@1021d000 {
		compatible = "mediatek,dramc_nao";
		reg = <0x00 0x1021d000 0x00 0x1000>;
	};

	bpi_bsi_slv0@1021e000 {
		compatible = "mediatek,bpi_bsi_slv0";
		reg = <0x00 0x1021e000 0x00 0x1000>;
	};

	bpi_bsi_slv1@1021f000 {
		compatible = "mediatek,bpi_bsi_slv1";
		reg = <0x00 0x1021f000 0x00 0x6000>;
	};

	bpi_bsi_slv2@10225000 {
		compatible = "mediatek,bpi_bsi_slv2";
		reg = <0x00 0x10225000 0x00 0x1000>;
	};

	dvfsp@10227000 {
		compatible = "mediatek,dvfsp";
		reg = <0x00 0x10227000 0x00 0x1000>;
	};

	dvfsp@00110800 {
		compatible = "mediatek,mt6765-dvfsp";
		reg = <0x00 0x110800 0x00 0x1400 0x00 0x110800 0x00 0x1400>;
	};

	eem_fsm@1100b000 {
		compatible = "mediatek,eem_fsm";
		reg = <0x00 0x1100b000 0x00 0x1000>;
		interrupts = <0x00 0x7d 0x08>;
	};

	dramc@1022a000 {
		compatible = "mediatek,dramc";
		reg = <0x00 0x1022a000 0x00 0x2000 0x00 0x10232000 0x00 0x2000 0x00 0x1022c000 0x00 0x1000 0x00 0x10234000 0x00 0x1000 0x00 0x10228000 0x00 0x2000 0x00 0x10230000 0x00 0x2000 0x00 0x1022e000 0x00 0x1000 0x00 0x10236000 0x00 0x1000>;
	};

	gce@10238000 {
		compatible = "mediatek,gce\0syscon";
		reg = <0x00 0x10238000 0x00 0x4000>;
		#clock-cells = <0x01>;
		interrupts = <0x00 0x9a 0x08 0x00 0x9b 0x08>;
		g3d_config_base = <0x13000000 0x00 0xffff0000>;
		mmsys_config_base = <0x14000000 0x01 0xffff0000>;
		disp_dither_base = <0x14010000 0x02 0xffff0000>;
		mm_na_base = <0x14020000 0x03 0xffff0000>;
		imgsys_base = <0x15020000 0x04 0xffff0000>;
		vdec_gcon_base = <0x18800000 0x05 0xffff0000>;
		venc_gcon_base = <0x18810000 0x06 0xffff0000>;
		conn_peri_base = <0x18820000 0x07 0xffff0000>;
		topckgen_base = <0x18830000 0x08 0xffff0000>;
		kp_base = <0x18840000 0x09 0xffff0000>;
		scp_sram_base = <0x10000000 0x0a 0xffff0000>;
		infra_na3_base = <0x10010000 0x0b 0xffff0000>;
		infra_na4_base = <0x10020000 0x0c 0xffff0000>;
		scp_base = <0x10030000 0x0d 0xffff0000>;
		mcucfg_base = <0x10040000 0x0e 0xffff0000>;
		gcpu_base = <0x10050000 0x0f 0xffff0000>;
		usb0_base = <0x10200000 0x10 0xffff0000>;
		usb_sif_base = <0x10280000 0x11 0xffff0000>;
		audio_base = <0x17000000 0x12 0xffff0000>;
		vdec_base = <0x17010000 0x13 0xffff0000>;
		msdc2_base = <0x17020000 0x14 0xffff0000>;
		vdec1_base = <0x17030000 0x15 0xffff0000>;
		msdc3_base = <0x18000000 0x16 0xffff0000>;
		ap_dma_base = <0x18010000 0x17 0xffff0000>;
		gce_base = <0x18020000 0x18 0xffff0000>;
		vdec2_base = <0x18040000 0x19 0xffff0000>;
		vdec3_base = <0x18050000 0x1a 0xffff0000>;
		camsys_base = <0x18080000 0x1b 0xffff0000>;
		camsys1_base = <0x180a0000 0x1c 0xffff0000>;
		camsys2_base = <0x180b0000 0x1d 0xffff0000>;
		pwm_sw_base = <0x1100e000 0x63 0xffff0000>;
		mipitx0_base = <0x11c80000 0x63 0xffff0000>;
		mdp_rdma0_sof = <0x00>;
		mdp_ccorr0_sof = <0x01>;
		mdp_rsz0_sof = <0x02>;
		mdp_rsz1_sof = <0x03>;
		mdp_wdma_sof = <0x04>;
		mdp_wrot0_sof = <0x05>;
		mdp_tdshp0_sof = <0x06>;
		disp_ovl0_sof = <0x07>;
		disp_2l_ovl0_sof = <0x08>;
		disp_rdma0_sof = <0x09>;
		disp_wdma0_sof = <0x0a>;
		disp_color0_sof = <0x0b>;
		disp_ccorr0_sof = <0x0c>;
		disp_aal0_sof = <0x0d>;
		disp_gamma0_sof = <0x0e>;
		disp_dither0_sof = <0x0f>;
		disp_dsi0_sof = <0x10>;
		disp_rsz0_sof = <0x11>;
		img_dl_relay_sof = <0x12>;
		disp_pwm0_sof = <0x13>;
		mdp_rdma0_frame_done = <0x14>;
		mdp_ccorr0_frame_done = <0x15>;
		mdp_rsz0_frame_done = <0x16>;
		mdp_rsz1_frame_done = <0x17>;
		mdp_wrot0_write_frame_done = <0x18>;
		mdp_wdma_frame_done = <0x19>;
		mdp_tdshp0_frame_done = <0x1a>;
		disp_ovl0_frame_done = <0x1b>;
		disp_2l_ovl0_frame_done = <0x1c>;
		disp_rsz0_frame_done = <0x1d>;
		disp_rdma0_frame_done = <0x1e>;
		disp_wdma0_frame_done = <0x1f>;
		disp_color0_frame_done = <0x20>;
		disp_ccorr0_frame_done = <0x21>;
		disp_aal0_frame_done = <0x22>;
		disp_gamma0_frame_done = <0x23>;
		disp_dither0_frame_done = <0x24>;
		disp_dsi0_frame_done = <0x25>;
		stream_done_0 = <0x82>;
		stream_done_1 = <0x83>;
		stream_done_2 = <0x84>;
		stream_done_3 = <0x85>;
		stream_done_4 = <0x86>;
		stream_done_5 = <0x87>;
		stream_done_6 = <0x88>;
		stream_done_7 = <0x89>;
		stream_done_8 = <0x8a>;
		stream_done_9 = <0x8b>;
		buf_underrun_event_0 = <0x8c>;
		dsi0_te_event = <0x8d>;
		dsi0_irq_event = <0x8e>;
		dsi0_done_event = <0x8f>;
		disp_wdma0_rst_done = <0x93>;
		mdp_wdma_rst_done = <0x94>;
		mdp_wrot0_rst_done = <0x95>;
		mdp_rdma0_rst_done = <0x97>;
		disp_ovl0_frame_rst_done_pusle = <0x98>;
		dip_cq_thread0_frame_done = <0x101>;
		dip_cq_thread1_frame_done = <0x102>;
		dip_cq_thread2_frame_done = <0x103>;
		dip_cq_thread3_frame_done = <0x104>;
		dip_cq_thread4_frame_done = <0x105>;
		dip_cq_thread5_frame_done = <0x106>;
		dip_cq_thread6_frame_done = <0x107>;
		dip_cq_thread7_frame_done = <0x108>;
		dip_cq_thread8_frame_done = <0x109>;
		dip_cq_thread9_frame_done = <0x10a>;
		dip_cq_thread10_frame_done = <0x10b>;
		dip_cq_thread11_frame_done = <0x10c>;
		dip_cq_thread12_frame_done = <0x10d>;
		dip_cq_thread13_frame_done = <0x10e>;
		dip_cq_thread14_frame_done = <0x10f>;
		dip_cq_thread15_frame_done = <0x110>;
		dip_cq_thread16_frame_done = <0x111>;
		dip_cq_thread17_frame_done = <0x112>;
		dip_cq_thread18_frame_done = <0x113>;
		dve_frame_done = <0x114>;
		wmf_frame_done = <0x115>;
		rsc_frame_done = <0x116>;
		venc_done = <0x121>;
		jpgenc_done = <0x122>;
		jpgdec_done = <0x123>;
		venc_mb_done = <0x124>;
		venc_128byte_cnt_done = <0x125>;
		max_prefetch_cnt = <0x01>;
		prefetch_size = <0x60>;
		sram_size_cpr_64 = <0x40>;
		mmsys_config = <0x26>;
		mdp_rdma0 = <0x27>;
		mdp_rsz0 = <0x28>;
		mdp_rsz1 = <0x29>;
		mdp_wdma0 = <0x2a>;
		mdp_wrot0 = <0x2b>;
		mdp_tdshp0 = <0x2c>;
		mdp_color0 = <0x2d>;
		mdp_ccorr0 = <0x2e>;
		mm_mutex = <0x2f>;
		sram_share_cnt = <0x01>;
		sram_share_engine = <0x0a>;
		sram_share_event = <0x2c6>;
		clocks = <0x24 0x09 0x24 0x18>;
		clock-names = "GCE\0GCE_TIMER";
		mediatek,mailbox-gce = <0x30>;
		thread_count = <0x10>;
		secure_thread = <0x08 0x0a>;
		mboxes = <0x30 0x00 0x00 0x04 0x30 0x01 0x00 0x04 0x30 0x02 0x00 0x05 0x30 0x03 0x00 0x04 0x30 0x04 0x00 0x04 0x30 0x05 0x00 0x04 0x30 0x06 0x00 0x03 0x30 0x07 0xffffffff 0x02 0x30 0x08 0x00 0x01 0x30 0x09 0x00 0x01 0x30 0x0a 0x00 0x01 0x30 0x0b 0x00 0x01 0x30 0x0c 0x00 0x01 0x30 0x0d 0x00 0x01 0x30 0x0e 0x00 0x01 0x30 0x0f 0x00 0x01>;
		linux,phandle = <0x79>;
		phandle = <0x79>;
	};

	gce_mbox@10238000 {
		compatible = "mediatek,mailbox-gce";
		reg = <0x00 0x10238000 0x00 0x4000>;
		interrupts = <0x00 0x9a 0x08 0x00 0x9b 0x08>;
		#mbox-cells = <0x03>;
		#gce-event-cells = <0x01>;
		#gce-subsys-cells = <0x02>;
		clocks = <0x24 0x09 0x24 0x18>;
		clock-names = "gce\0GCE_TIMER";
		linux,phandle = <0x30>;
		phandle = <0x30>;
	};

	gce_mbox_svp@10238000 {
		compatible = "mediatek,mailbox-gce-svp";
		reg = <0x00 0x10238000 0x00 0x4000>;
		interrupts = <0x00 0x9a 0x08 0x00 0x9b 0x08>;
		#mbox-cells = <0x03>;
		clocks = <0x24 0x09 0x24 0x18>;
		clock-names = "gce\0GCE_TIMER";
		linux,phandle = <0x7a>;
		phandle = <0x7a>;
	};

	ap_ccif2@1023c000 {
		compatible = "mediatek,ap_ccif2";
		reg = <0x00 0x1023c000 0x00 0x1000>;
		interrupts = <0x00 0x8f 0x08>;
	};

	md_ccif2@1023d000 {
		compatible = "mediatek,md_ccif2";
		reg = <0x00 0x1023d000 0x00 0x1000>;
	};

	ap_ccif3@1023e000 {
		compatible = "mediatek,ap_ccif3";
		reg = <0x00 0x1023e000 0x00 0x1000>;
		interrupts = <0x00 0x92 0x08>;
	};

	md_ccif3@1023f000 {
		compatible = "mediatek,md_ccif3";
		reg = <0x00 0x1023f000 0x00 0x1000>;
	};

	sspm@10440000 {
		compatible = "mediatek,sspm";
		reg = <0x00 0x10440000 0x00 0x10000 0x00 0x10450000 0x00 0x100 0x00 0x10451000 0x00 0x08 0x00 0x10460000 0x00 0x100 0x00 0x10461000 0x00 0x08 0x00 0x10470000 0x00 0x100 0x00 0x10471000 0x00 0x08 0x00 0x10480000 0x00 0x100 0x00 0x10481000 0x00 0x08 0x00 0x10490000 0x00 0x100 0x00 0x10491000 0x00 0x08>;
		reg-names = "cfgreg\0mbox0_base\0mbox0_ctrl\0mbox1_base\0mbox1_ctrl\0mbox2_base\0mbox2_ctrl\0mbox3_base\0mbox3_ctrl\0mbox4_base\0mbox4_ctrl";
		interrupts = <0x00 0xca 0x04 0x00 0xcd 0x04 0x00 0xce 0x04 0x00 0xcf 0x04 0x00 0xd0 0x04 0x00 0xd1 0x04>;
		interrupt-names = "ipc\0mbox0\0mbox1\0mbox2\0mbox3\0mbox4";
	};

	gic500@0c000000 {
		compatible = "mediatek,gic500";
		reg = <0x00 0xc000000 0x00 0x1000>;
	};

	gic_cpu@0c400000 {
		compatible = "mediatek,gic_cpu";
		reg = <0x00 0xc400000 0x00 0x40000>;
	};

	dfd@10200b00 {
		compatible = "mediatek,dfd";
		reg = <0x00 0x10200b00 0x00 0x10000>;
		mediatek,enabled = <0x01>;
		mediatek,chain_length = <0xc350>;
		mediatek,rg_dfd_timeout = <0xa0>;
	};

	dbg_cti@0d020000 {
		compatible = "mediatek,dbg_cti";
		reg = <0x00 0xd020000 0x00 0x10000>;
	};

	dbg_etr@0d030000 {
		compatible = "mediatek,dbg_etr";
		reg = <0x00 0xd030000 0x00 0x10000>;
	};

	dbg_funnel@0d040000 {
		compatible = "mediatek,dbg_funnel";
		reg = <0x00 0xd040000 0x00 0x10000>;
	};

	dbg_dem@0d0a0000 {
		compatible = "mediatek,dbg_dem";
		reg = <0x00 0xd0a0000 0x00 0x10000>;
		interrupts = <0x00 0x8c 0x08>;
	};

	dbg_mdsys1@0d0c0000 {
		compatible = "mediatek,dbg_mdsys1";
		reg = <0x00 0xd0c0000 0x00 0x40000>;
	};

	dbg_apmcu_mp0@0d400000 {
		compatible = "mediatek,dbg_apmcu_mp0";
		reg = <0x00 0xd400000 0x00 0x1000>;
	};

	dbg_apmcu_mp0@0d410000 {
		compatible = "mediatek,dbg_apmcu_mp0";
		reg = <0x00 0xd410000 0x00 0x1000>;
	};

	dbg_apmcu_mp0@0d420000 {
		compatible = "mediatek,dbg_apmcu_mp0";
		reg = <0x00 0xd420000 0x00 0x1000>;
	};

	dbg_apmcu_mp0@0d430000 {
		compatible = "mediatek,dbg_apmcu_mp0";
		reg = <0x00 0xd430000 0x00 0x1000>;
	};

	dbg_apmcu_mp0@0d440000 {
		compatible = "mediatek,dbg_apmcu_mp0";
		reg = <0x00 0xd440000 0x00 0x1000>;
	};

	dbg_apmcu_mp0@0d510000 {
		compatible = "mediatek,dbg_apmcu_mp0";
		reg = <0x00 0xd510000 0x00 0x1000>;
	};

	dbg_apmcu_mp0@0d520000 {
		compatible = "mediatek,dbg_apmcu_mp0";
		reg = <0x00 0xd520000 0x00 0x1000>;
	};

	dbg_apmcu_mp0@0d530000 {
		compatible = "mediatek,dbg_apmcu_mp0";
		reg = <0x00 0xd530000 0x00 0x1000>;
	};

	dbg_apmcu_mp0@0d540000 {
		compatible = "mediatek,dbg_apmcu_mp0";
		reg = <0x00 0xd540000 0x00 0x1000>;
	};

	dbg_apmcu_mp0@0d610000 {
		compatible = "mediatek,dbg_apmcu_mp0";
		reg = <0x00 0xd610000 0x00 0x1000>;
	};

	dbg_apmcu_mp0@0d620000 {
		compatible = "mediatek,dbg_apmcu_mp0";
		reg = <0x00 0xd620000 0x00 0x1000>;
	};

	dbg_apmcu_mp0@0d630000 {
		compatible = "mediatek,dbg_apmcu_mp0";
		reg = <0x00 0xd630000 0x00 0x1000>;
	};

	dbg_apmcu_mp0@0d640000 {
		compatible = "mediatek,dbg_apmcu_mp0";
		reg = <0x00 0xd640000 0x00 0x1000>;
	};

	dbg_apmcu_mp0@0d710000 {
		compatible = "mediatek,dbg_apmcu_mp0";
		reg = <0x00 0xd710000 0x00 0x1000>;
	};

	dbg_apmcu_mp0@0d720000 {
		compatible = "mediatek,dbg_apmcu_mp0";
		reg = <0x00 0xd720000 0x00 0x1000>;
	};

	dbg_apmcu_mp0@0d730000 {
		compatible = "mediatek,dbg_apmcu_mp0";
		reg = <0x00 0xd730000 0x00 0x1000>;
	};

	dbg_apmcu_mp0@0d740000 {
		compatible = "mediatek,dbg_apmcu_mp0";
		reg = <0x00 0xd740000 0x00 0x1000>;
	};

	dbg_apmcu_mp1@0d800000 {
		compatible = "mediatek,dbg_apmcu_mp1";
		reg = <0x00 0xd800000 0x00 0x1000>;
	};

	dbg_apmcu_mp1@0d810000 {
		compatible = "mediatek,dbg_apmcu_mp1";
		reg = <0x00 0xd810000 0x00 0x1000>;
	};

	dbg_apmcu_mp1@0d820000 {
		compatible = "mediatek,dbg_apmcu_mp1";
		reg = <0x00 0xd820000 0x00 0x1000>;
	};

	dbg_apmcu_mp1@0d830000 {
		compatible = "mediatek,dbg_apmcu_mp1";
		reg = <0x00 0xd830000 0x00 0x1000>;
	};

	dbg_apmcu_mp1@0d840000 {
		compatible = "mediatek,dbg_apmcu_mp1";
		reg = <0x00 0xd840000 0x00 0x1000>;
	};

	dbg_apmcu_mp1@0d910000 {
		compatible = "mediatek,dbg_apmcu_mp1";
		reg = <0x00 0xd910000 0x00 0x1000>;
	};

	dbg_apmcu_mp1@0d920000 {
		compatible = "mediatek,dbg_apmcu_mp1";
		reg = <0x00 0xd920000 0x00 0x1000>;
	};

	dbg_apmcu_mp1@0d930000 {
		compatible = "mediatek,dbg_apmcu_mp1";
		reg = <0x00 0xd930000 0x00 0x1000>;
	};

	dbg_apmcu_mp1@0d940000 {
		compatible = "mediatek,dbg_apmcu_mp1";
		reg = <0x00 0xd940000 0x00 0x1000>;
	};

	dbg_apmcu_mp1@0da10000 {
		compatible = "mediatek,dbg_apmcu_mp1";
		reg = <0x00 0xda10000 0x00 0x1000>;
	};

	dbg_apmcu_mp1@0da20000 {
		compatible = "mediatek,dbg_apmcu_mp1";
		reg = <0x00 0xda20000 0x00 0x1000>;
	};

	dbg_apmcu_mp1@0da30000 {
		compatible = "mediatek,dbg_apmcu_mp1";
		reg = <0x00 0xda30000 0x00 0x1000>;
	};

	dbg_apmcu_mp1@0da40000 {
		compatible = "mediatek,dbg_apmcu_mp1";
		reg = <0x00 0xda40000 0x00 0x1000>;
	};

	dbg_apmcu_mp1@0db10000 {
		compatible = "mediatek,dbg_apmcu_mp1";
		reg = <0x00 0xdb10000 0x00 0x1000>;
	};

	dbg_apmcu_mp1@0db20000 {
		compatible = "mediatek,dbg_apmcu_mp1";
		reg = <0x00 0xdb20000 0x00 0x1000>;
	};

	dbg_apmcu_mp1@0db30000 {
		compatible = "mediatek,dbg_apmcu_mp1";
		reg = <0x00 0xdb30000 0x00 0x1000>;
	};

	dbg_apmcu_mp1@0db40000 {
		compatible = "mediatek,dbg_apmcu_mp1";
		reg = <0x00 0xdb40000 0x00 0x1000>;
	};

	ap_dma@11000000 {
		compatible = "mediatek,ap_dma";
		reg = <0x00 0x11000000 0x00 0x1000>;
		interrupts = <0x00 0x61 0x08>;
	};

	auxadc@11001000 {
		compatible = "mediatek,auxadc";
		reg = <0x00 0x11001000 0x00 0x10000>;
		interrupts = <0x00 0x4c 0x02>;
		clocks = <0x24 0x21>;
		clock-names = "auxadc-main";
		linux,phandle = <0x7b>;
		phandle = <0x7b>;
	};

	dma-controller@11000580 {
		compatible = "mediatek,mt6577-uart-dma";
		reg = <0x00 0x11000680 0x00 0x80 0x00 0x11000700 0x00 0x80 0x00 0x11000780 0x00 0x80 0x00 0x11000800 0x00 0x80>;
		interrupts = <0x00 0x6d 0x08 0x00 0x6e 0x08 0x00 0x6f 0x08 0x00 0x74 0x08>;
		clocks = <0x24 0x26>;
		clock-names = "apdma";
		#dma-cells = <0x01>;
		linux,phandle = <0x31>;
		phandle = <0x31>;
	};

	serial@11020000 {
		compatible = "mediatek,mt6758-uart\0mediatek,mt6577-uart";
		reg = <0x00 0x11002000 0x00 0x1000>;
		interrupts = <0x00 0x5b 0x08>;
		clocks = <0x1f 0x24 0x16>;
		clock-names = "baud\0bus";
		dmas = <0x31 0x00 0x31 0x01>;
		dma-names = "tx\0rx";
		linux,phandle = <0x7c>;
		phandle = <0x7c>;
	};

	serial@11030000 {
		compatible = "mediatek,mt6758-uart\0mediatek,mt6577-uart";
		reg = <0x00 0x11003000 0x00 0x1000>;
		interrupts = <0x00 0x5c 0x08>;
		clocks = <0x1f 0x24 0x17>;
		clock-names = "baud\0bus";
		linux,phandle = <0x7d>;
		phandle = <0x7d>;
	};

	i2c_common {
		compatible = "mediatek,i2c_common";
		dma_support = [02];
		idvfs = [01];
		set_dt_div = [01];
		check_max_freq = [01];
		ver = [02];
		set_ltiming = [01];
		ext_time_config = [18 01];
		cnt_constraint = [01];
		linux,phandle = <0x7e>;
		phandle = <0x7e>;
	};

	i2c0@11007000 {
		compatible = "mediatek,i2c";
		id = <0x00>;
		reg = <0x00 0x11007000 0x00 0x1000 0x00 0x11000080 0x00 0x80>;
		interrupts = <0x00 0x54 0x08>;
		clocks = <0x24 0x0b 0x24 0x26>;
		clock-names = "main\0dma";
		clock-div = <0x05>;
		scl-gpio-id = <0x53>;
		sda-gpio-id = <0x52>;
		gpio_start = <0x10002a00>;
		mem_len = <0x200>;
		eh_cfg = <0x20>;
		pu_cfg = <0x50>;
		rsel_cfg = <0x70>;
		aed = <0x1a>;
		mediatek,hs_only;
		linux,phandle = <0x7f>;
		phandle = <0x7f>;
	};

	i2c1@11008000 {
		compatible = "mediatek,i2c";
		id = <0x01>;
		reg = <0x00 0x11008000 0x00 0x1000 0x00 0x11000100 0x00 0x80>;
		interrupts = <0x00 0x55 0x08>;
		clocks = <0x24 0x0b 0x24 0x26>;
		clock-names = "main\0dma";
		clock-div = <0x05>;
		scl-gpio-id = <0x54>;
		sda-gpio-id = <0x51>;
		gpio_start = <0x10002a00>;
		mem_len = <0x200>;
		eh_cfg = <0x20>;
		pu_cfg = <0x50>;
		rsel_cfg = <0x70>;
		aed = <0x1a>;
		mediatek,hs_only;
		linux,phandle = <0x80>;
		phandle = <0x80>;
	};

	i2c2@11009000 {
		compatible = "mediatek,i2c";
		id = <0x02>;
		reg = <0x00 0x11009000 0x00 0x1000 0x00 0x11000180 0x00 0x180>;
		interrupts = <0x00 0x56 0x08>;
		clocks = <0x24 0x0b 0x24 0x26>;
		clock-names = "main\0dma";
		clock-div = <0x05>;
		scl-gpio-id = <0x67>;
		sda-gpio-id = <0x68>;
		gpio_start = <0x10002800>;
		mem_len = <0x200>;
		eh_cfg = <0x20>;
		pu_cfg = <0x60>;
		rsel_cfg = <0xa0>;
		aed = <0x1a>;
		ch_offset_default = <0x100>;
		ch_offset_ccu = <0x200>;
		mediatek,hs_only;
		linux,phandle = <0x81>;
		phandle = <0x81>;
	};

	i2c3@1100f000 {
		compatible = "mediatek,i2c";
		id = <0x03>;
		reg = <0x00 0x1100f000 0x00 0x1000 0x00 0x11000300 0x00 0x100>;
		interrupts = <0x00 0x57 0x08>;
		clocks = <0x24 0x0b 0x24 0x26>;
		clock-names = "main\0dma";
		clock-div = <0x05>;
		scl-gpio-id = <0x32>;
		sda-gpio-id = <0x33>;
		gpio_start = <0x10002600>;
		mem_len = <0x200>;
		eh_cfg = <0x20>;
		pu_cfg = <0x90>;
		rsel_cfg = <0xb0>;
		aed = <0x1a>;
		ch_offset_default = <0x100>;
		mediatek,hs_only;
		linux,phandle = <0x82>;
		phandle = <0x82>;
	};

	i2c4@11011000 {
		compatible = "mediatek,i2c";
		id = <0x04>;
		reg = <0x00 0x11011000 0x00 0x1000 0x00 0x11000400 0x00 0x180>;
		interrupts = <0x00 0x58 0x08>;
		clocks = <0x24 0x0b 0x24 0x26>;
		clock-names = "main\0dma";
		clock-div = <0x05>;
		scl-gpio-id = <0x69>;
		sda-gpio-id = <0x6a>;
		gpio_start = <0x10002800>;
		mem_len = <0x200>;
		eh_cfg = <0x20>;
		pu_cfg = <0x60>;
		rsel_cfg = <0xa0>;
		aed = <0x1a>;
		ch_offset_default = <0x100>;
		ch_offset_ccu = <0x200>;
		mediatek,hs_only;
		linux,phandle = <0x83>;
		phandle = <0x83>;
	};

	i2c5@11016000 {
		compatible = "mediatek,i2c";
		id = <0x05>;
		reg = <0x00 0x11016000 0x00 0x1000 0x00 0x11000580 0x00 0x80>;
		interrupts = <0x00 0x82 0x08>;
		clocks = <0x24 0x0b 0x24 0x26>;
		clock-names = "main\0dma";
		clock-div = <0x05>;
		scl-gpio-id = <0x30>;
		sda-gpio-id = <0x31>;
		gpio_start = <0x10002600>;
		mem_len = <0x200>;
		eh_cfg = <0x20>;
		pu_cfg = <0x90>;
		rsel_cfg = <0xb0>;
		aed = <0x1a>;
		mediatek,hs_only;
		linux,phandle = <0x84>;
		phandle = <0x84>;
	};

	i2c6@1100d000 {
		compatible = "mediatek,i2c";
		id = <0x06>;
		reg = <0x00 0x1100d000 0x00 0x1000 0x00 0x11000600 0x00 0x80>;
		interrupts = <0x00 0x83 0x08>;
		clocks = <0x24 0x0b 0x24 0x26>;
		clock-names = "main\0dma";
		clock-div = <0x05>;
		scl-gpio-id = <0xa1>;
		sda-gpio-id = <0xa2>;
		gpio_start = <0x10002c00>;
		mem_len = <0x200>;
		eh_cfg = <0x20>;
		pu_cfg = <0x50>;
		rsel_cfg = <0x70>;
		aed = <0x1a>;
		ch_offset_default = <0x100>;
		ch_offset_ccu = <0x200>;
		mediatek,hs_only;
		linux,phandle = <0x85>;
		phandle = <0x85>;
	};

	pwm@11006000 {
		compatible = "mediatek,pwm";
		reg = <0x00 0x11006000 0x00 0x10000>;
		interrupts = <0x00 0x4d 0x08>;
		clocks = <0x24 0x10 0x24 0x11 0x24 0x12 0x24 0x13 0x24 0x14 0x24 0x30 0x24 0x0f 0x24 0x15>;
		clock-names = "PWM1-main\0PWM2-main\0PWM3-main\0PWM4-main\0PWM5-main\0PWM6-main\0PWM-HCLK-main\0PWM-main";
		linux,phandle = <0x86>;
		phandle = <0x86>;
	};

	spi@1100a000 {
		compatible = "mediatek,mt6765-spi";
		mediatek,pad-select = <0x00>;
		reg = <0x00 0x1100a000 0x00 0x1000>;
		interrupts = <0x00 0x76 0x08>;
		clocks = <0x1e 0x0b 0x1e 0x6b 0x24 0x1b>;
		clock-names = "parent-clk\0sel-clk\0spi-clk";
		linux,phandle = <0x87>;
		phandle = <0x87>;
	};

	therm_ctrl@1100b000 {
		compatible = "mediatek,therm_ctrl";
		reg = <0x00 0x1100b000 0x00 0x1000>;
		interrupts = <0x00 0x4e 0x08>;
		clocks = <0x24 0x0a>;
		clock-names = "therm-main";
	};

	btif@1100c000 {
		compatible = "mediatek,btif";
		reg = <0x00 0x1100c000 0x00 0x1000 0x00 0x11000880 0x00 0x80 0x00 0x11000900 0x00 0x80>;
		interrupts = <0x00 0x70 0x08 0x00 0x84 0x08 0x00 0x85 0x08>;
		clocks = <0x24 0x1a 0x24 0x26>;
		clock-names = "btifc\0apdmac";
	};

	consys@18002000 {
		compatible = "mediatek,mt6765-consys";
		#address-cells = <0x02>;
		#size-cells = <0x02>;
		reg = <0x00 0x18002000 0x00 0x1000 0x00 0x10007000 0x00 0x100 0x00 0x10001000 0x00 0x1000 0x00 0x10006000 0x00 0x1000 0x00 0x18007000 0x00 0x1000 0x00 0x180b1000 0x00 0x1000 0x00 0x180a3000 0x00 0x1000 0x00 0x180a5000 0x00 0x800 0x00 0x180c1000 0x00 0x1000 0x00 0x18004000 0x00 0x1000 0x00 0x00 0x00 0x00 0x00 0x00 0x00 0x00 0x00 0x1020e000 0x00 0x1000>;
		interrupts = <0x00 0x10b 0x08 0x00 0x10d 0x08 0x00 0x10e 0x01>;
		clocks = <0x25 0x01>;
		clock-names = "conn";
		linux,phandle = <0x1b>;
		phandle = <0x1b>;
	};

	wifi@18000000 {
		compatible = "mediatek,wifi";
		reg = <0x00 0x18000000 0x00 0x100000>;
		interrupts = <0x00 0x10c 0x08>;
	};

	disp_pwm@1100e000 {
		compatible = "mediatek,disp_pwm";
		reg = <0x00 0x1100e000 0x00 0x1000>;
	};

	spi@11010000 {
		compatible = "mediatek,mt6765-spi";
		mediatek,pad-select = <0x00>;
		reg = <0x00 0x11010000 0x00 0x1000>;
		interrupts = <0x00 0x7a 0x08>;
		clocks = <0x1e 0x0b 0x1e 0x6b 0x24 0x34>;
		clock-names = "parent-clk\0sel-clk\0spi-clk";
		linux,phandle = <0x88>;
		phandle = <0x88>;
	};

	spi@11012000 {
		compatible = "mediatek,mt6765-spi";
		mediatek,pad-select = <0x00>;
		reg = <0x00 0x11012000 0x00 0x1000>;
		interrupts = <0x00 0x80 0x08>;
		clocks = <0x1e 0x0b 0x1e 0x6b 0x24 0x37>;
		clock-names = "parent-clk\0sel-clk\0spi-clk";
		linux,phandle = <0x89>;
		phandle = <0x89>;
	};

	spi@11013000 {
		compatible = "mediatek,mt6765-spi";
		mediatek,pad-select = <0x00>;
		reg = <0x00 0x11013000 0x00 0x1000>;
		interrupts = <0x00 0x81 0x08>;
		clocks = <0x1e 0x0b 0x1e 0x6b 0x24 0x38>;
		clock-names = "parent-clk\0sel-clk\0spi-clk";
		linux,phandle = <0x8a>;
		phandle = <0x8a>;
	};

	spi@11014000 {
		compatible = "mediatek,mt6765-spi";
		mediatek,pad-select = <0x00>;
		reg = <0x00 0x11014000 0x00 0x1000>;
		interrupts = <0x00 0x5f 0x08>;
		clocks = <0x1e 0x0b 0x1e 0x6b 0x24 0x41>;
		clock-names = "parent-clk\0sel-clk\0spi-clk";
		linux,phandle = <0x8b>;
		phandle = <0x8b>;
	};

	spi@11015000 {
		compatible = "mediatek,mt6765-spi";
		mediatek,pad-select = <0x00>;
		reg = <0x00 0x11015000 0x00 0x1000>;
		interrupts = <0x00 0x60 0x08>;
		clocks = <0x1e 0x0b 0x1e 0x6b 0x24 0x42>;
		clock-names = "parent-clk\0sel-clk\0spi-clk";
		linux,phandle = <0x8c>;
		phandle = <0x8c>;
	};

	imp_iic@11017000 {
		compatible = "mediatek,imp_iic";
		reg = <0x00 0x11017000 0x00 0x1000>;
	};

	nfi@11018000 {
		compatible = "mediatek,nfi";
		reg = <0x00 0x11018000 0x00 0x1000>;
	};

	nfiecc@11019000 {
		compatible = "mediatek,nfiecc";
		reg = <0x00 0x11019000 0x00 0x1000>;
	};

	usb0@11200000 {
		compatible = "mediatek,mt6765-usb20";
		reg = <0x00 0x11200000 0x00 0x10000 0x00 0x11cc0000 0x00 0x10000>;
		interrupts = <0x00 0x49 0x08>;
		mode = <0x02>;
		multipoint = <0x01>;
		num_eps = <0x10>;
		clocks = <0x24 0x08 0x1e 0x76 0x1e 0x20>;
		clock-names = "usb0\0usb0_clk_top_sel\0usb0_clk_univpll3_d4";
	};

	usb_sif@11210000 {
		compatible = "mediatek,usb_sif";
		reg = <0x00 0x11210000 0x00 0x10000>;
	};

	msdc@11230000 {
		compatible = "mediatek,msdc";
		reg = <0x00 0x11230000 0x00 0x10000>;
		interrupts = <0x00 0x4f 0x08>;
		index = [00];
		clk_src = [01];
		bus-width = <0x08>;
		max-frequency = <0xbebc200>;
		cap-mmc-highspeed;
		mmc-ddr-1_8v;
		mmc-hs200-1_8v;
		mmc-hs400-1_8v;
		no-sd;
		no-sdio;
		non-removable;
		pinctl = <0x32>;
		pinctl_hs400 = <0x33>;
		pinctl_hs200 = <0x34>;
		register_setting = <0x35>;
		host_function = [00];
		bootable;
		status = "okay";
		vmmc-supply = <0x36>;
		clocks = <0x24 0x4c 0x24 0x1c 0x24 0x44>;
		clock-names = "msdc0-clock\0msdc0-hclock\0msdc0-aes-clock";
		linux,phandle = <0x8d>;
		phandle = <0x8d>;
	};

	msdc@11240000 {
		compatible = "mediatek,msdc";
		reg = <0x00 0x11240000 0x00 0x10000>;
		interrupts = <0x00 0x50 0x08>;
		index = [01];
		clk_src = [02];
		bus-width = <0x04>;
		max-frequency = <0xbebc200>;
		cap-sd-highspeed;
		sd-uhs-sdr12;
		sd-uhs-sdr25;
		sd-uhs-sdr50;
		sd-uhs-sdr104;
		sd-uhs-ddr50;
		no-mmc;
		no-sdio;
		pinctl = <0x37>;
		pinctl_sdr104 = <0x38>;
		pinctl_sdr50 = <0x39>;
		pinctl_ddr50 = <0x3a>;
		register_setting = <0x3b>;
		host_function = [01];
		cd_level = [01];
		cd-gpios = <0x3c 0x00 0x00>;
		status = "okay";
		vmmc-supply = <0x3d>;
		vqmmc-supply = <0x3e>;
		clocks = <0x24 0x4d 0x24 0x1d>;
		clock-names = "msdc1-clock\0msdc1-hclock";
		linux,phandle = <0x8e>;
		phandle = <0x8e>;
	};

	msdc@11250000 {
		compatible = "mediatek,msdc2";
		reg = <0x00 0x11250000 0x00 0x10000>;
		status = "disable";
		linux,phandle = <0x8f>;
		phandle = <0x8f>;
	};

	msdc@11260000 {
		compatible = "mediatek,msdc3";
		reg = <0x00 0x11250000 0x00 0x10000>;
		status = "disable";
		linux,phandle = <0x90>;
		phandle = <0x90>;
	};

	msdc1_ins@0 {
		compatible = "mediatek,mt6765-sdcard-ins";
		linux,phandle = <0x91>;
		phandle = <0x91>;
	};

	msdc0_top@11cd0000 {
		compatible = "mediatek,msdc0_top";
		reg = <0x00 0x11cd0000 0x00 0x1000>;
	};

	msdc1_top@11c90000 {
		compatible = "mediatek,msdc1_top";
		reg = <0x00 0x11c90000 0x00 0x1000>;
	};

	usb1p_sif@11210000 {
		compatible = "mediatek,usb1p_sif";
		reg = <0x00 0x11210000 0x00 0x10000>;
	};

	audio@11220000 {
		compatible = "mediatek,audio\0syscon";
		reg = <0x00 0x11220000 0x00 0x1000>;
		#clock-cells = <0x01>;
		mediatek,btcvsd_snd = <0x3f>;
		linux,phandle = <0x40>;
		phandle = <0x40>;
	};

	mt_soc_dl1_pcm@11220000 {
		compatible = "mediatek,mt_soc_pcm_dl1";
		reg = <0x00 0x11220000 0x00 0x1000>;
		interrupts = <0x00 0x99 0x08>;
		clocks = <0x40 0x00 0x40 0x04 0x40 0x05 0x40 0x03 0x40 0x01 0x40 0x02 0x40 0x06 0x24 0x2b 0x24 0x33 0x1e 0x6f 0x1e 0x70 0x1e 0x03 0x1e 0x71 0x1e 0x29 0x1e 0x72 0x1e 0x2c 0x41 0x08 0x1f>;
		clock-names = "aud_afe_clk\0aud_dac_clk\0aud_dac_predis_clk\0aud_adc_clk\0aud_apll22m_clk\0aud_apll1_tuner_clk\0aud_tml_clk\0aud_infra_clk\0mtkaif_26m_clk\0top_mux_audio\0top_mux_audio_int\0top_sys_pll1_d4\0top_mux_aud_1\0top_apll1_ck\0top_mux_aud_eng1\0top_apll1_d8\0apmixed_apll1\0top_clk26m_clk";
		linux,phandle = <0x92>;
		phandle = <0x92>;
	};

	audio_sram@11221000 {
		compatible = "mediatek,audio_sram";
		reg = <0x00 0x11221000 0x00 0x9000>;
	};

	mtk-btcvsd-snd@18050000 {
		compatible = "mediatek,mtk-btcvsd-snd";
		reg = <0x00 0x18050000 0x00 0x1000 0x00 0x18080000 0x00 0x10000>;
		interrupts = <0x00 0x10a 0x08>;
		mediatek,infracfg = <0x24>;
		mediatek,offset = <0xf00 0x800 0x140 0x144 0x148>;
		linux,phandle = <0x3f>;
		phandle = <0x3f>;
	};

	mipi_rx_ana_csi0a@11c10000 {
		compatible = "mediatek,mipi_rx_ana_csi0a\0syscon";
		reg = <0x00 0x11c10000 0x00 0x1000>;
		#clock-cells = <0x01>;
		linux,phandle = <0x45>;
		phandle = <0x45>;
	};

	mipi_rx_ana_csi0b@11c11000 {
		compatible = "mediatek,mipi_rx_ana_csi0b\0syscon";
		reg = <0x00 0x11c11000 0x00 0x1000>;
		#clock-cells = <0x01>;
		linux,phandle = <0x46>;
		phandle = <0x46>;
	};

	mipi_rx_ana_csi1a@11c12000 {
		compatible = "mediatek,mipi_rx_ana_csi1a\0syscon";
		reg = <0x00 0x11c12000 0x00 0x1000>;
		#clock-cells = <0x01>;
		linux,phandle = <0x47>;
		phandle = <0x47>;
	};

	mipi_rx_ana_csi1b@11c13000 {
		compatible = "mediatek,mipi_rx_ana_csi1b\0syscon";
		reg = <0x00 0x11c13000 0x00 0x1000>;
		#clock-cells = <0x01>;
		linux,phandle = <0x48>;
		phandle = <0x48>;
	};

	mipi_rx_ana_csi2a@11c14000 {
		compatible = "mediatek,mipi_rx_ana_csi2a\0syscon";
		reg = <0x00 0x11c14000 0x00 0x1000>;
		#clock-cells = <0x01>;
		linux,phandle = <0x49>;
		phandle = <0x49>;
	};

	mipi_rx_ana_csi2b@11c15000 {
		compatible = "mediatek,mipi_rx_ana_csi2b\0syscon";
		reg = <0x00 0x11c15000 0x00 0x1000>;
		#clock-cells = <0x01>;
		linux,phandle = <0x4a>;
		phandle = <0x4a>;
	};

	efusec@11c50000 {
		compatible = "mediatek,efusec";
		reg = <0x00 0x11c50000 0x00 0x10000>;
	};

	mipi_tx0@11c80000 {
		compatible = "mediatek,mipi_tx0";
		reg = <0x00 0x11c80000 0x00 0x10000>;
	};

	msdc1_pad_macro@11c90000 {
		compatible = "mediatek,msdc1_pad_macro";
		reg = <0x00 0x11c90000 0x00 0x10000>;
	};

	msdc0_pad_macro@11cd0000 {
		compatible = "mediatek,msdc0_pad_macro";
		reg = <0x00 0x11cd0000 0x00 0x10000>;
	};

	mfg_doma@13000000 {
		compatible = "mediatek,doma";
		reg = <0x00 0x13000000 0x00 0x80000>;
		interrupts = <0x00 0x103 0x08>;
		interrupt-names = "RGX";
		clock-frequency = <0x21f98280>;
	};

	mfg_cfg@13ffe000 {
		compatible = "mediatek,mfgcfg\0syscon";
		reg = <0x00 0x13ffe000 0x00 0x1000>;
		#clock-cells = <0x01>;
		linux,phandle = <0x93>;
		phandle = <0x93>;
	};

	gpufreq {
		compatible = "mediatek,mt6765-gpufreq";
		clocks = <0x1e 0x64 0x1e 0x26 0x1f 0x25 0x08 0x25 0x04 0x25 0x07>;
		clock-names = "clk_mux\0clk_main_parent\0clk_sub_parent\0mtcmos_mfg_async\0mtcmos_mfg\0mtcmos_mfg_core0";
	};

	mmsys_config@14000000 {
		compatible = "mediatek,mmsys_config\0syscon";
		reg = <0x00 0x14000000 0x00 0x1000>;
		interrupts = <0x00 0xe3 0x08>;
		#clock-cells = <0x01>;
		clocks = <0x26 0x17 0x26 0x1a 0x26 0x1b>;
		clock-names = "CAM_MDP\0IMG_DL_RELAY\0IMG_DL_ASYNC_TOP";
		linux,phandle = <0x26>;
		phandle = <0x26>;
	};

	nfc {
		compatible = "mediatek,nfc-gpio-v2";
		gpio-rst = <0xac>;
		gpio-rst-std = <0x3c 0xac 0x00>;
		gpio-irq = <0x0a>;
		gpio-irq-std = <0x3c 0x0a 0x00>;
		linux,phandle = <0x94>;
		phandle = <0x94>;
	};

	irq_nfc {
		compatible = "mediatek,irq_nfc-eint";
		linux,phandle = <0x95>;
		phandle = <0x95>;
	};

	disp_mutex0@14001000 {
		compatible = "mediatek,disp_mutex0";
		reg = <0x00 0x14001000 0x00 0x1000>;
		interrupts = <0x00 0xd2 0x08>;
		linux,phandle = <0x2f>;
		phandle = <0x2f>;
	};

	smi_common@14002000 {
		compatible = "mediatek,smi_common";
		reg = <0x00 0x14002000 0x00 0x1000>;
		nr_larbs = <0x04>;
		larbs = <0x20 0x21 0x22 0x23>;
		mmsys_config = <0x26>;
		clocks = <0x25 0x03 0x26 0x15 0x26 0x16 0x26 0x13 0x1e 0x62 0x1e 0x21 0x1e 0x17 0x1e 0x22>;
		clock-names = "mtcmos-mm\0smi-common-gals-comm0\0smi-common-gals-comm1\0smi-common\0mmdvfs_clk_mm_sel_ck\0mmdvfs_clk_mmpll_ck\0mmdvfs_clk_univpll1_d2_ck\0mmdvfs_clk_mmpll_d2_ck";
	};

	mmdvfs_pmqos {
		compatible = "mediatek,mmdvfs_pmqos";
		mm_step0 = <0x1c9 0x01 0x00 0x01>;
		mm_step1 = <0x138 0x01 0x00 0x02>;
		mm_step2 = <0xe4 0x01 0x00 0x03>;
		vopp_steps = <0x00 0x01 0x03>;
		disp_freq = "mm_step0\0mm_step1\0mm_step2";
		mdp_freq = "mm_step0\0mm_step1\0mm_step2";
		cam_freq = "mm_step0\0mm_step1\0mm_step2";
		img_freq = "mm_step0\0mm_step1\0mm_step2";
		vdec_freq = "mm_step0\0mm_step1\0mm_step2";
		venc_freq = "mm_step0\0mm_step1\0mm_step2";
		clocks = <0x1e 0x62 0x1e 0x21 0x1e 0x17 0x1e 0x22>;
		clock-names = "mmdvfs_clk_mm_sel_ck\0mmdvfs_clk_mmpll_ck\0mmdvfs_clk_univpll1_d2_ck\0mmdvfs_clk_mmpll_d2_ck";
	};

	imgsys@15020000 {
		compatible = "mediatek,imgsys\0syscon";
		reg = <0x00 0x15020000 0x00 0x1000>;
		#clock-cells = <0x01>;
		clocks = <0x25 0x03 0x25 0x05 0x25 0x09 0x42 0x01 0x43 0x02 0x43 0x03 0x43 0x04 0x43 0x05 0x43 0x06 0x43 0x07>;
		clock-names = "ISP_SCP_SYS_DIS\0ISP_SCP_SYS_ISP\0ISP_SCP_SYS_CAM\0ISP_CLK_IMG_DIP\0ISP_CLK_CAM\0ISP_CLK_CAMTG\0ISP_CLK_CAM_SENINF\0ISP_CLK_CAMSV0\0ISP_CLK_CAMSV1\0ISP_CLK_CAMSV2";
		linux,phandle = <0x42>;
		phandle = <0x42>;
	};

	dip1@15022000 {
		compatible = "mediatek,dip1";
		reg = <0x00 0x15022000 0x00 0x3000>;
		interrupts = <0x00 0xff 0x08>;
	};

	dpe@15028000 {
		compatible = "mediatek,dpe";
		reg = <0x00 0x15028000 0x00 0x1000>;
		interrupts = <0x00 0x100 0x08>;
		clocks = <0x42 0x03>;
		clock-names = "DPE_CG_IMG_DPE";
	};

	smi_larb0@14003000 {
		cell-index = <0x00>;
		compatible = "mediatek,smi_larb0\0mediatek,smi_larb";
		reg = <0x00 0x14003000 0x00 0x1000>;
		clocks = <0x25 0x03 0x26 0x14>;
		clock-names = "mtcmos-mm\0mm-larb0";
		linux,phandle = <0x20>;
		phandle = <0x20>;
	};

	mdp_rdma0@14004000 {
		compatible = "mediatek,mdp_rdma0";
		reg = <0x00 0x14004000 0x00 0x1000>;
		interrupts = <0x00 0xd3 0x08>;
		clocks = <0x26 0x00>;
		clock-names = "MDP_RDMA0";
		linux,phandle = <0x27>;
		phandle = <0x27>;
	};

	mdp_ccorr0@14005000 {
		compatible = "mediatek,mdp_ccorr0";
		reg = <0x00 0x14005000 0x00 0x1000>;
		interrupts = <0x00 0xe2 0x08>;
		clocks = <0x26 0x01>;
		clock-names = "MDP_CCORR";
		linux,phandle = <0x2e>;
		phandle = <0x2e>;
	};

	mdp_rsz0@14006000 {
		compatible = "mediatek,mdp_rsz0";
		reg = <0x00 0x14006000 0x00 0x1000>;
		interrupts = <0x00 0xd4 0x08>;
		clocks = <0x26 0x02>;
		clock-names = "MDP_RSZ0";
		linux,phandle = <0x28>;
		phandle = <0x28>;
	};

	mdp_rsz1@14007000 {
		compatible = "mediatek,mdp_rsz1";
		reg = <0x00 0x14007000 0x00 0x1000>;
		interrupts = <0x00 0xd5 0x08>;
		clocks = <0x26 0x03>;
		clock-names = "MDP_RSZ1";
		linux,phandle = <0x29>;
		phandle = <0x29>;
	};

	mdp_wdma0@14008000 {
		compatible = "mediatek,mdp_wdma0";
		reg = <0x00 0x14008000 0x00 0x1000>;
		interrupts = <0x00 0xd8 0x08>;
		clocks = <0x26 0x06>;
		clock-names = "MDP_WDMA";
		linux,phandle = <0x2a>;
		phandle = <0x2a>;
	};

	mdp_wrot0@14009000 {
		compatible = "mediatek,mdp_wrot0";
		reg = <0x00 0x14009000 0x00 0x1000>;
		interrupts = <0x00 0xd7 0x08>;
		clocks = <0x26 0x05>;
		clock-names = "MDP_WROT0";
		linux,phandle = <0x2b>;
		phandle = <0x2b>;
	};

	mdp_tdshp0@1400a000 {
		compatible = "mediatek,mdp_tdshp0";
		reg = <0x00 0x1400a000 0x00 0x1000>;
		clocks = <0x26 0x04>;
		clock-names = "MDP_TDSHP";
		linux,phandle = <0x2c>;
		phandle = <0x2c>;
	};

	disp_ovl0@1400b000 {
		compatible = "mediatek,disp_ovl0";
		reg = <0x00 0x1400b000 0x00 0x1000>;
		interrupts = <0x00 0xd9 0x08>;
	};

	disp_ovl0_2l@1400c000 {
		compatible = "mediatek,disp_ovl0_2l";
		reg = <0x00 0x1400c000 0x00 0x1000>;
		interrupts = <0x00 0xe5 0x08>;
	};

	disp_rdma0@1400d000 {
		compatible = "mediatek,disp_rdma0";
		reg = <0x00 0x1400d000 0x00 0x1000>;
		interrupts = <0x00 0xda 0x08>;
	};

	disp_wdma0@1400e000 {
		compatible = "mediatek,disp_wdma0";
		reg = <0x00 0x1400e000 0x00 0x1000>;
		interrupts = <0x00 0xdb 0x08>;
	};

	disp_color0@1400f000 {
		compatible = "mediatek,disp_color0";
		reg = <0x00 0x1400f000 0x00 0x1000>;
		interrupts = <0x00 0xdc 0x08>;
		clocks = <0x26 0x0c>;
		clock-names = "MDP_COLOR";
		linux,phandle = <0x2d>;
		phandle = <0x2d>;
	};

	disp_ccorr0@14010000 {
		compatible = "mediatek,disp_ccorr0";
		reg = <0x00 0x14010000 0x00 0x1000>;
		interrupts = <0x00 0xdd 0x08>;
	};

	disp_aal0@14011000 {
		compatible = "mediatek,disp_aal0";
		reg = <0x00 0x14011000 0x00 0x1000>;
		interrupts = <0x00 0xde 0x08>;
	};

	disp_gamma0@14012000 {
		compatible = "mediatek,disp_gamma0";
		reg = <0x00 0x14012000 0x00 0x1000>;
		interrupts = <0x00 0xdf 0x08>;
	};

	disp_dither0@14013000 {
		compatible = "mediatek,disp_dither0";
		reg = <0x00 0x14013000 0x00 0x1000>;
		interrupts = <0x00 0xe0 0x08>;
	};

	dsi0@14014000 {
		compatible = "mediatek,dsi0";
		reg = <0x00 0x14014000 0x00 0x1000>;
		interrupts = <0x00 0xe1 0x08>;
	};

	disp_rsz0@14015000 {
		compatible = "mediatek,disp_rsz0";
		reg = <0x00 0x14015000 0x00 0x1000>;
		interrupts = <0x00 0x114 0x08>;
	};

	mtkfb@0 {
		compatible = "mediatek,mtkfb";
		linux,phandle = <0x96>;
		phandle = <0x96>;
	};

	dispsys {
		compatible = "mediatek,dispsys";
		mediatek,larb = <0x20>;
		clocks = <0x25 0x03 0x26 0x13 0x26 0x14 0x26 0x15 0x26 0x16 0x26 0x07 0x26 0x08 0x26 0x0a 0x26 0x0b 0x26 0x0c 0x26 0x0d 0x26 0x0e 0x26 0x0f 0x26 0x10 0x26 0x11 0x26 0x1c 0x26 0x1d 0x26 0x09 0x41 0x15 0x1e 0x73 0x24 0x31 0x1f 0x1e 0x1b 0x1e 0x2e 0x1e 0x30>;
		clock-names = "MMSYS_MTCMOS\0MMSYS_SMI_COMMON\0MMSYS_SMI_LARB0\0MMSYS_GALS_COMM0\0MMSYS_GALS_COMM1\0MMSYS_DISP_OVL0\0MMSYS_DISP_OVL0_2L\0MMSYS_DISP_RDMA0\0MMSYS_DISP_WDMA0\0MMSYS_DISP_COLOR0\0MMSYS_DISP_CCORR0\0MMSYS_DISP_AAL0\0MMSYS_DISP_GAMMA0\0MMSYS_DISP_DITHER0\0MMSYS_DSI0_MM_CK\0MMSYS_DSI0_IF_CK\0MMSYS_26M\0MMSYS_DISP_RSZ0\0APMIXED_MIPI_26M\0TOP_MUX_DISP_PWM\0DISP_PWM\0TOP_26M\0TOP_UNIVPLL2_D4\0TOP_ULPOSC1_D2\0TOP_ULPOSC1_D8";
	};

	dsi_te {
		compatible = "mediatek, DSI_TE-eint";
		status = "disabled";
		linux,phandle = <0x97>;
		phandle = <0x97>;
	};

	smi_larb2@15021000 {
		cell-index = <0x02>;
		compatible = "mediatek,smi_larb2\0mediatek,smi_larb";
		reg = <0x00 0x15021000 0x00 0x1000>;
		clocks = <0x25 0x05 0x26 0x18 0x42 0x00>;
		clock-names = "mtcmos-isp\0gals-img2mm\0img-larb2";
		linux,phandle = <0x22>;
		phandle = <0x22>;
	};

	fdvt@1502b000 {
		compatible = "mediatek,fdvt";
		reg = <0x00 0x1502b000 0x00 0x1000>;
		interrupts = <0x00 0x102 0x08>;
		clocks = <0x42 0x02>;
		clock-names = "FD_CLK_IMG_FDVT";
	};

	venc_gcon@17000000 {
		compatible = "mediatek,venc_gcon\0syscon";
		reg = <0x00 0x17000000 0x00 0x10000>;
		clocks = <0x25 0x03 0x25 0x0a 0x26 0x15 0x26 0x16 0x26 0x13 0x44 0x03 0x44 0x01>;
		clock-names = "MT_SCP_SYS_DIS\0MT_SCP_SYS_VCODEC\0MT_CG_MM_SMI_COMM0\0MT_CG_MM_SMI_COMM1\0MT_CG_MM_SMI_COMMON\0MT_CG_VDEC\0MT_CG_VENC";
		#clock-cells = <0x01>;
		linux,phandle = <0x44>;
		phandle = <0x44>;
	};

	smi_larb1@17010000 {
		cell-index = <0x01>;
		compatible = "mediatek,smi_larb1\0mediatek,smi_larb";
		reg = <0x00 0x17010000 0x00 0x1000>;
		clocks = <0x25 0x0a 0x44 0x01>;
		clock-names = "mtcmos-vcodec\0venc-larb1";
		linux,phandle = <0x21>;
		phandle = <0x21>;
	};

	venc@17020000 {
		compatible = "mediatek,venc";
		reg = <0x00 0x17020000 0x00 0x10000>;
		interrupts = <0x00 0xe6 0x08>;
	};

	venc_jpg@17030000 {
		compatible = "mediatek,venc_jpg";
		reg = <0x00 0x17030000 0x00 0x10000>;
		interrupts = <0x00 0xe8 0x08>;
		clocks = <0x44 0x02>;
		clock-names = "MT_CG_VENC_JPGENC";
	};

	vdec@17040000 {
		compatible = "mediatek,vdec";
		reg = <0x00 0x17040000 0x00 0x10000>;
		interrupts = <0x00 0xe9 0x08>;
	};

	mbist@17050000 {
		compatible = "mediatek,mbist";
		reg = <0x00 0x17050000 0x00 0x10000>;
	};

	camsys@1a000000 {
		compatible = "mediatek,camsys\0syscon";
		reg = <0x00 0x1a000000 0x00 0x1000>;
		#clock-cells = <0x01>;
		linux,phandle = <0x43>;
		phandle = <0x43>;
	};

	smi_larb3@1a002000 {
		cell-index = <0x03>;
		compatible = "mediatek,smi_larb3\0mediatek,smi_larb";
		reg = <0x00 0x1a002000 0x00 0x1000>;
		clocks = <0x25 0x09 0x26 0x19 0x43 0x00>;
		clock-names = "mtcmos-cam\0gals-cam2mm\0cam-larb3";
		linux,phandle = <0x23>;
		phandle = <0x23>;
	};

	cam1@1a003000 {
		compatible = "mediatek,cam1";
		reg = <0x00 0x1a003000 0x00 0x1000>;
		interrupts = <0x00 0xeb 0x08>;
	};

	cam2@1a004000 {
		compatible = "mediatek,cam2";
		reg = <0x00 0x1a004000 0x00 0x1000>;
		interrupts = <0x00 0xec 0x08>;
	};

	cam3@1a005000 {
		compatible = "mediatek,cam3";
		reg = <0x00 0x1a005000 0x00 0x1000>;
		interrupts = <0x00 0xed 0x08>;
	};

	cam_set@1a00b000 {
		compatible = "mediatek,cam_set";
		reg = <0x00 0x1a00b000 0x00 0x1000>;
	};

	cama_set@1a00c000 {
		compatible = "mediatek,cama_set";
		reg = <0x00 0x1a00c000 0x00 0x1000>;
	};

	camb_set@1a00d000 {
		compatible = "mediatek,camb_set";
		reg = <0x00 0x1a00d000 0x00 0x1000>;
	};

	cam_inner@1a013000 {
		compatible = "mediatek,cam_inner";
		reg = <0x00 0x1a013000 0x00 0x1000>;
	};

	cama_inner@1a014000 {
		compatible = "mediatek,cama_inner";
		reg = <0x00 0x1a014000 0x00 0x1000>;
	};

	camb_inner@1a015000 {
		compatible = "mediatek,camb_inner";
		reg = <0x00 0x1a015000 0x00 0x1000>;
	};

	cam_clear@1a01b000 {
		compatible = "mediatek,cam_clear";
		reg = <0x00 0x1a01b000 0x00 0x1000>;
	};

	cama_clear@1a01c000 {
		compatible = "mediatek,cama_clear";
		reg = <0x00 0x1a01c000 0x00 0x1000>;
	};

	camb_clear@1a01d000 {
		compatible = "mediatek,camb_clear";
		reg = <0x00 0x1a01d000 0x00 0x1000>;
	};

	cama_ext@1a024000 {
		compatible = "mediatek,cama_ext";
		reg = <0x00 0x1a024000 0x00 0x1000>;
	};

	camb_ext@1a025000 {
		compatible = "mediatek,camb_ext";
		reg = <0x00 0x1a025000 0x00 0x1000>;
	};

	seninf1@1a040000 {
		compatible = "mediatek,seninf1";
		reg = <0x00 0x1a040000 0x00 0x1000>;
	};

	seninf2@1a041000 {
		compatible = "mediatek,seninf2";
		reg = <0x00 0x1a041000 0x00 0x1000>;
	};

	seninf3@1a042000 {
		compatible = "mediatek,seninf3";
		reg = <0x00 0x1a042000 0x00 0x1000>;
	};

	seninf4@1a043000 {
		compatible = "mediatek,seninf4";
		reg = <0x00 0x1a043000 0x00 0x1000>;
	};

	kd_camera_hw1@1a040000 {
		compatible = "mediatek,camera_hw";
		reg = <0x00 0x1a040000 0x00 0x1000>;
		clocks = <0x1e 0x66 0x1e 0x67 0x1e 0x68 0x1e 0x69 0x1e 0x14 0x1e 0x13 0x1e 0x1d 0x1e 0x11 0x1e 0x1c 0x1e 0x12 0x1f 0x43 0x04 0x41 0x0e 0x41 0x12 0x45 0x00 0x46 0x00 0x47 0x00 0x48 0x00 0x49 0x00 0x4a 0x00 0x1e 0x7d 0x1e 0x1a 0x25 0x09>;
		clock-names = "CLK_TOP_CAMTG_SEL\0CLK_TOP_CAMTG1_SEL\0CLK_TOP_CAMTG2_SEL\0CLK_TOP_CAMTG3_SEL\0CLK_MCLK_6M\0CLK_MCLK_12M\0CLK_MCLK_13M\0CLK_MCLK_48M\0CLK_MCLK_52M\0CLK_MCLK_24M\0CLK_MCLK_26M\0CLK_CAM_SENINF_CG\0CLK_MIPI_C0_26M_CG\0CLK_MIPI_C1_26M_CG\0CLK_MIPI_ANA_0A_CG\0CLK_MIPI_ANA_0B_CG\0CLK_MIPI_ANA_1A_CG\0CLK_MIPI_ANA_1B_CG\0CLK_MIPI_ANA_2A_CG\0CLK_MIPI_ANA_2B_CG\0CLK_TOP_CAMTM_SEL_CG\0CLK_TOP_CAMTM_208_CG\0CLK_SCP_SYS_CAM";
		linux,phandle = <0x98>;
		phandle = <0x98>;
	};

	camsv1@1a050000 {
		compatible = "mediatek,camsv1";
		reg = <0x00 0x1a050000 0x00 0x1000>;
		interrupts = <0x00 0xf3 0x08>;
	};

	camsv2@1a051000 {
		compatible = "mediatek,camsv2";
		reg = <0x00 0x1a051000 0x00 0x1000>;
		interrupts = <0x00 0xf4 0x08>;
	};

	camsv3@1a052000 {
		compatible = "mediatek,camsv3";
		reg = <0x00 0x1a052000 0x00 0x1000>;
		interrupts = <0x00 0xf1 0x08>;
	};

	camsv4@1a053000 {
		compatible = "mediatek,camsv4";
		reg = <0x00 0x1a053000 0x00 0x1000>;
		interrupts = <0x00 0xf2 0x08>;
	};

	flashlight_core {
		compatible = "mediatek,flashlight_core";
		linux,phandle = <0x99>;
		phandle = <0x99>;
	};

	flashlights_mt6370 {
		compatible = "mediatek,flashlights_mt6370";
		decouple = <0x00>;
		linux,phandle = <0x9a>;
		phandle = <0x9a>;

		channel@1 {
			type = <0x00>;
			ct = <0x00>;
			part = <0x00>;
		};

		channel@2 {
			type = <0x00>;
			ct = <0x01>;
			part = <0x00>;
		};
	};

	flashlights_aw36515 {
		compatible = "mediatek,flashlights_aw36515";
		linux,phandle = <0x9b>;
		phandle = <0x9b>;
	};

	gps {
		compatible = "mediatek,gps";
	};

	ccu@1a0b0000 {
		compatible = "mediatek,ccu";
		reg = <0x00 0x1a0b1000 0x00 0x1000>;
		interrupts = <0x00 0xf6 0x08>;
		clocks = <0x43 0x08 0x25 0x09>;
		clock-names = "CCU_CLK_CAM_CCU\0CAM_PWR";
	};

	mt6357_charger {
		compatible = "mediatek,mt6357_charger";
	};

	mt_charger {
		compatible = "mediatek,mt-charger";
		linux,phandle = <0x9c>;
		phandle = <0x9c>;
	};

	lk_charger {
		compatible = "mediatek,lk_charger";
		enable_anime;
		max_charger_voltage = <0x632ea0>;
		fast_charge_voltage = <0x2625a0>;
		usb_charger_current = <0x7a120>;
		ac_charger_current = <0x10c8e0>;
		ac_charger_input_current = <0x10c8e0>;
		non_std_ac_charger_current = <0x7a120>;
		charging_host_charger_current = <0xf4240>;
		ta_ac_charger_current = <0x2dc6c0>;
		pd_charger_current = <0x7a120>;
		temp_t4_threshold = <0x32>;
		temp_t3_threshold = <0x2d>;
		temp_t1_threshold = <0x00>;
		linux,phandle = <0x9d>;
		phandle = <0x9d>;
	};

	charger {
		compatible = "mediatek,charger";
		algorithm_name = "LinearCharging";
		enable_sw_jeita;
		disable_pd_dual;
		battery_cv = <0x432380>;
		max_charger_voltage = <0x632ea0>;
		min_charger_voltage = <0x4630c0>;
		min_charger_voltage_1 = <0x432380>;
		min_charger_voltage_2 = <0x401640>;
		max_dmivr_charger_current = <0x155cc0>;
		usb_charger_current_suspend = <0x00>;
		usb_charger_current_unconfigured = <0x11170>;
		usb_charger_current_configured = <0x7ef40>;
		usb_charger_current = <0x7ef40>;
		ac_charger_current = <0x1cafc0>;
		ac_charger_input_current = <0x1cafc0>;
		non_std_ac_charger_current = <0x120160>;
		charging_host_charger_current = <0xf4240>;
		apple_1_0a_charger_current = <0x9eb10>;
		apple_2_1a_charger_current = <0xc3500>;
		ta_ac_charger_current = <0x2dc6c0>;
		jeita_temp_above_t4_cv = <0x3e8fa0>;
		jeita_temp_t3_to_t4_cv = <0x3e8fa0>;
		jeita_temp_t2_to_t3_cv = <0x432380>;
		jeita_temp_t1_to_t2_cv = <0x432380>;
		jeita_temp_t0_to_t1_cv = <0x432380>;
		jeita_temp_below_t0_cv = <0x432380>;
		temp_t4_thres = <0x37>;
		temp_t4_thres_minus_x_degree = <0x33>;
		temp_t3_thres = <0x2d>;
		temp_t3_thres_minus_x_degree = <0x2c>;
		temp_t2_thres = <0x0f>;
		temp_t2_thres_plus_x_degree = <0x10>;
		temp_t1_thres = <0x01>;
		temp_t1_thres_plus_x_degree = <0x01>;
		temp_t0_thres = <0x01>;
		temp_t0_thres_plus_x_degree = <0x01>;
		temp_neg_10_thres = <0x02>;
		enable_min_charge_temp;
		min_charge_temp = <0x00>;
		min_charge_temp_plus_x_degree = <0x01>;
		max_charge_temp = <0x35>;
		max_charge_temp_minus_x_degree = <0x34>;
		ta_12v_support;
		ta_9v_support;
		pe_ichg_level_threshold = <0xf4240>;
		ta_ac_12v_input_current = <0x30d400>;
		ta_ac_9v_input_current = <0x30d400>;
		ta_ac_7v_input_current = <0x30d400>;
		pe20_ichg_level_threshold = <0xf4240>;
		ta_start_battery_soc = <0x00>;
		ta_stop_battery_soc = <0x55>;
		high_temp_to_leave_pe40 = <0x2e>;
		high_temp_to_enter_pe40 = <0x27>;
		low_temp_to_leave_pe40 = <0x0a>;
		low_temp_to_enter_pe40 = <0x10>;
		pe40_single_charger_input_current = <0x2dc6c0>;
		pe40_single_charger_current = <0x2dc6c0>;
		pe40_dual_charger_input_current = <0x2dc6c0>;
		pe40_dual_charger_chg1_current = <0x1e8480>;
		pe40_dual_charger_chg2_current = <0x1e8480>;
		pe40_stop_battery_soc = <0x50>;
		pe40_r_cable_1a_lower = <0x229>;
		pe40_r_cable_2a_lower = <0x19f>;
		pe40_r_cable_3a_lower = <0x113>;
		chg1_ta_ac_charger_current = <0x16e360>;
		chg2_ta_ac_charger_current = <0x16e360>;
		slave_mivr_diff = <0x186a0>;
		dual_polling_ieoc = <0x6ddd0>;
		cable_imp_threshold = <0x2bb>;
		vbat_cable_imp_threshold = <0x3b8260>;
		bif_threshold1 = <0x40d990>;
		bif_threshold2 = <0x419ce0>;
		bif_cv_under_threshold2 = <0x43e6d0>;
		pd_vbus_low_bound = <0x4c4b40>;
		pd_vbus_upper_bound = <0x4c4b40>;
		pd_ichg_level_threshold = <0xf4240>;
		pd_stop_battery_soc = <0x50>;
		ibus_err = <0x0e>;
		vsys_watt = <0x4c4b40>;
		enable_sw_safety_timer;
		max_charging_time = <0x11940>;
		recharge_offset = <0x186a0>;
		topoff_voltage = <0x401640>;
		topoff_time = <0x5460>;
		chg_full_current = <0x30d40>;
		linux,phandle = <0x9e>;
		phandle = <0x9e>;
	};

	tran_battery {
		compatible = "tran,chg_fun";
		enable_pcb_tml;
		pcb_temp_step_one = <0xa028>;
		pcb_cur_step_one = <0xc8>;
		pcb_temp_step_two = <0xa7f8>;
		pcb_cur_step_two = <0x64>;
		pcb_min_chg_cur = <0x120160>;
		jeita_below_t0_chg_cur = <0x00>;
		jeita_t0_to_t1_chg_cur = <0xc3500>;
		jeita_t2_to_t3_chg_cur = <0x1cafc0>;
		jeita_t3_to_t4_chg_cur = <0x1cafc0>;
		jeita_above_t4_chg_cur = <0x00>;
		jeita_below_t0_input_cur = <0xc3500>;
		jeita_t0_to_t1_input_cur = <0xc3500>;
		jeita_t2_to_t3_input_cur = <0x1cafc0>;
		jeita_t3_to_t4_input_cur = <0x1cafc0>;
		jeita_above_t4_input_cur = <0xf4240>;
		jeita_above_t4_topoff_voltage = <0x3c45b0>;
		jeita_t3_to_t4_topoff_voltage = <0x3c45b0>;
		jeita_t2_to_t3_topoff_voltage = <0x401640>;
		jeita_t1_to_t2_topoff_voltage = <0x401640>;
		jeita_t0_to_t1_topoff_voltage = <0x401640>;
		jeita_below_t0_topoff_voltage = <0x401640>;
		linux,phandle = <0x9f>;
		phandle = <0x9f>;
	};

	irtx_pwm {
		compatible = "mediatek,irtx-pwm";
		pwm_ch = <0x00>;
		pwm_data_invert = <0x00>;
		linux,phandle = <0xa0>;
		phandle = <0xa0>;
	};

	odm {
		compatible = "simple-bus";
		linux,phandle = <0xa1>;
		phandle = <0xa1>;
	};

	memory-ssmr-features {
		compatible = "mediatek,memory-ssmr-features";
		svp-size = <0x00 0x10000000>;
		iris-recognition-size = <0x00 0x10000000>;
		2d_fr-size = <0x00 0x8000000>;
		tui-size = <0x00 0x4000000>;
		wfd-size = <0x00 0x4000000>;
		prot-sharedmem-size = <0x00 0x8000000>;
		ta-elf-size = <0x00 0x1000000>;
		ta-stack-heap-size = <0x00 0x6000000>;
		sdsp-tee-sharedmem-size = <0x00 0x1000000>;
		sdsp-firmware-size = <0x00 0x1000000>;
		linux,phandle = <0xa2>;
		phandle = <0xa2>;
	};

	audio_snd_card {
		compatible = "mediatek,audio_snd_card";
	};

	mt_soc_deep_buffer_dl_pcm {
		compatible = "mediatek,mt_soc_pcm_deep_buffer_dl";
	};

	mt_soc_ul1_pcm {
		compatible = "mediatek,mt_soc_pcm_capture";
	};

	mt_soc_voice_md1 {
		compatible = "mediatek,mt_soc_pcm_voice_md1";
	};

	mt_soc_uldlloopback_pcm {
		compatible = "mediatek,mt_soc_pcm_uldlloopback";
	};

	mt_soc_i2s0_pcm {
		compatible = "mediatek,mt_soc_pcm_dl1_i2s0";
	};

	mt_soc_mrgrx_pcm {
		compatible = "mediatek,mt_soc_pcm_mrgrx";
	};

	mt_soc_mrgrx_awb_pcm {
		compatible = "mediatek,mt_soc_pcm_mrgrx_awb";
	};

	mt_soc_fm_i2s_pcm {
		compatible = "mediatek,mt_soc_pcm_fm_i2s";
	};

	mt_soc_fm_i2s_awb_pcm {
		compatible = "mediatek,mt_soc_pcm_fm_i2s_awb";
	};

	mt_soc_i2s0dl1_pcm {
		compatible = "mediatek,mt_soc_pcm_dl1_i2s0dl1";
	};

	mt_soc_dl1_awb_pcm {
		compatible = "mediatek,mt_soc_pcm_dl1_awb";
	};

	mt_soc_voice_md1_bt {
		compatible = "mediatek,mt_soc_pcm_voice_md1_bt";
	};

	mt_soc_voip_bt_out {
		compatible = "mediatek,mt_soc_pcm_dl1_bt";
	};

	mt_soc_voip_bt_in {
		compatible = "mediatek,mt_soc_pcm_bt_dai";
	};

	mt_soc_tdmrx_pcm {
		compatible = "mediatek,mt_soc_tdm_capture";
	};

	mt_soc_fm_mrgtx_pcm {
		compatible = "mediatek,mt_soc_pcm_fmtx";
	};

	mt_soc_ul2_pcm {
		compatible = "mediatek,mt_soc_pcm_capture2";
	};

	mt_soc_i2s0_awb_pcm {
		compatible = "mediatek,mt_soc_pcm_i2s0_awb";
	};

	mt_soc_voice_md2 {
		compatible = "mediatek,mt_soc_pcm_voice_md2";
	};

	mt_soc_pcm_dl1_scp_spk {
		compatible = "mediatek,mt_soc_pcm_dl1_scp_spk";
	};

	mt_soc_pcm_voice_scp {
		compatible = "mediatek,mt_soc_pcm_voice_scp";
	};

	mt_soc_routing_pcm {
		compatible = "mediatek,mt_soc_pcm_routing";
	};

	mt_soc_voice_md2_bt {
		compatible = "mediatek,mt_soc_pcm_voice_md2_bt";
	};

	mt_soc_hp_impedance_pcm {
		compatible = "mediatek,mt_soc_pcm_hp_impedance";
	};

	mt_soc_codec_name {
		compatible = "mediatek,mt_soc_codec_63xx";
		use_hp_depop_flow = <0x00>;
		use_ul_260k = <0x00>;
	};

	mt_soc_dummy_pcm {
		compatible = "mediatek,mt_soc_pcm_dummy";
	};

	mt_soc_codec_dummy_name {
		compatible = "mediatek,mt_soc_codec_dummy";
	};

	mt_soc_routing_dai_name {
		compatible = "mediatek,mt_soc_dai_routing";
	};

	mt_soc_dai_name {
		compatible = "mediatek,mt_soc_dai_stub";
	};

	mt_soc_dl2_pcm {
		compatible = "mediatek,mt_soc_pcm_dl2";
	};

	mt_soc_anc_pcm {
		compatible = "mediatek,mt_soc_pcm_anc";
	};

	mt_soc_pcm_voice_ultra {
		compatible = "mediatek,mt_soc_pcm_voice_ultra";
	};

	mt_soc_pcm_voice_usb {
		compatible = "mediatek,mt_soc_pcm_voice_usb";
	};

	mt_soc_pcm_voice_usb_echoref {
		compatible = "mediatek,mt_soc_pcm_voice_usb_echoref";
	};

	pmic_clock_buffer_ctrl {
		compatible = "mediatek,pmic_clock_buffer";
		mediatek,clkbuf-quantity = <0x07>;
		mediatek,clkbuf-config = <0x02 0x01 0x01 0x02 0x00 0x00 0x00>;
		mediatek,clkbuf-driving-current = <0x01 0x01 0x01 0x01 0x01 0x01 0x01>;
		linux,phandle = <0xa3>;
		phandle = <0xa3>;
	};

	i2c7 {
		linux,phandle = <0xa4>;
		phandle = <0xa4>;
	};

	i2c8 {
		linux,phandle = <0xa5>;
		phandle = <0xa5>;
	};

	i2c9 {
		linux,phandle = <0xa6>;
		phandle = <0xa6>;
	};

	smart_pa {
		linux,phandle = <0xa7>;
		phandle = <0xa7>;
	};

	md1_sim1_hot_plug_eint {
		linux,phandle = <0xa8>;
		phandle = <0xa8>;
	};

	md1_sim2_hot_plug_eint {
		linux,phandle = <0xa9>;
		phandle = <0xa9>;
	};

	pseudo_m4u {
		compatible = "mediatek,mt-pseudo_m4u";
		iommus = <0x4b 0x02>;
	};

	pseudo_m4u-larb0 {
		compatible = "mediatek,mt-pseudo_m4u-port";
		mediatek,larbid = <0x00>;
		iommus = <0x4b 0x00 0x4b 0x01 0x4b 0x02 0x4b 0x03 0x4b 0x04 0x4b 0x05 0x4b 0x06 0x4b 0x07>;
	};

	pseudo_m4u-larb1 {
		compatible = "mediatek,mt-pseudo_m4u-port";
		mediatek,larbid = <0x01>;
		iommus = <0x4b 0x20 0x4b 0x21>;
	};

	pseudo_m4u-larb2 {
		compatible = "mediatek,mt-pseudo_m4u-port";
		mediatek,larbid = <0x02>;
		iommus = <0x4b 0x40 0x4b 0x41>;
	};

	pseudo_m4u-larb3 {
		compatible = "mediatek,mt-pseudo_m4u-port";
		mediatek,larbid = <0x03>;
		iommus = <0x4b 0x60 0x4b 0x61>;
	};

	eas {
		eff_turn_point = <0x1d3>;
		tiny = <0x32>;
	};

	radio_md_cfg {
		compatible = "mediatek,radio_md_cfg";
		linux,phandle = <0xaa>;
		phandle = <0xaa>;
	};

	dynamic_options {
		compatible = "mediatek,dynamic_options";
		linux,phandle = <0xab>;
		phandle = <0xab>;
	};

	mt6370_pmu_dts {
		interrupt-controller;
		#interrupt-cells = <0x01>;
		mt6370,intr_gpio_num = <0x03>;
		mt6370,intr_gpio = <0x3c 0x03 0x00>;
		linux,phandle = <0xac>;
		phandle = <0xac>;

		core {
			compatible = "mediatek,mt6370_pmu_core";
			interrupt-names = "otp\0vdda_ovp\0vdda_uv";
			i2cstmr_rst_tmr = <0x00>;
			mrstb_en;
			mrstb_tmr = <0x03>;
			int_wdt = <0x00>;
			int_deg = <0x00>;
		};

		charger {
			compatible = "mediatek,mt6370_pmu_charger";
			interrupt-names = "chg_mivr\0chg_aiclmeasi\0attachi\0ovpctrl_uvp_d_evt\0chg_wdtmri\0chg_vbusov\0chg_tmri\0chg_treg";
			charger_name = "primary_chg";
			load_switch_name = "primary_load_switch";
			ichg = <0x1e8480>;
			aicr = <0x7a120>;
			mivr = <0x432380>;
			cv = <0x426030>;
			ieoc = <0x249f0>;
			safety_timer = <0x0c>;
			dc_wdt = <0x3d0900>;
			ircmp_resistor = <0x61a8>;
			ircmp_vclamp = <0x7d00>;
			enable_te;
			enable_wdt;
		};

		mt6370_pmu_fled1 {
			compatible = "mediatek,mt6370_pmu_fled1";
			interrupt-names = "fled_lvf\0fled2_short\0fled1_short";
			fled_enable = <0x01>;
			torch_cur = <0x493e0>;
			strobe_cur = <0x124f80>;
			strobe_timeout = <0x960>;
		};

		mt6370_pmu_fled2 {
			compatible = "mediatek,mt6370_pmu_fled2";
			fled_enable = <0x01>;
			torch_cur = <0x30d40>;
			strobe_cur = <0xf4240>;
			strobe_timeout = <0x4b0>;
		};

		ldo {
			compatible = "mediatek,mt6370_pmu_ldo";
			interrupt-names = "ldo_oc";
			ldo_oms = <0x01>;
			ldo_vrc_lt = <0x01>;

			mt6370_ldo {
				regulator-name = "irtx_ldo";
				regulator-min-microvolt = <0x186a00>;
				regulator-max-microvolt = <0x3d0900>;
			};
		};

		rgbled {
			compatible = "mediatek,mt6370_pmu_rgbled";
			interrupt-names = "isink4_short\0isink3_short\0isink2_short\0isink1_short\0isink4_open\0isink3_open\0isink2_open\0isink1_open";
			mt,led_name = "mt6370_pmu_led1\0mt6370_pmu_led2\0mt6370_pmu_led3\0mt6370_pmu_led4";
			mt,led_default_trigger = "cc_mode\0cc_mode\0cc_mode\0none";
		};

		bled {
			compatible = "mediatek,mt6370_pmu_bled";
			interrupt-names = "bled_ocp";
			mt,bled_name = "mt6370_pmu_bled";
			mt,chan_en = <0x0f>;
			mt,map_linear;
			mt,bl_ovp_level = <0x03>;
			mt,bl_ocp_level = <0x02>;
			mt,use_pwm;
			mt,pwm_fsample = <0x02>;
			mt,pwm_deglitch = <0x01>;
			mt,pwm_hys_en = <0x01>;
			mt,pwm_hys = <0x00>;
			mt,pwm_avg_cycle = <0x00>;
			mt,bled_ramptime = <0x03>;
			mt,bled_flash_ramp = <0x01>;
			mt,max_bled_brightness = <0x200>;
		};

		dsv {
			compatible = "mediatek,mt6370_pmu_dsv";
			interrupt-names = "dsv_vneg_ocp\0dsv_vpos_ocp\0dsv_bst_ocp\0dsv_vneg_scp\0dsv_vpos_scp";
			db_ext_en = <0x00>;
			db_periodic_fix = <0x00>;
			db_single_pin = <0x00>;
			db_freq_pm = <0x00>;
			db_periodic_mode = <0x00>;
			db_startup = <0x00>;
			db_vneg_20ms = <0x01>;
			db_vneg_disc = <0x00>;
			db_vpos_20ms = <0x01>;
			db_vpos_disc = <0x01>;
			db_delay = <0x03>;
			db_vbst = <0x1644>;
			db_vpos_slew = <0x01>;
			db_vneg_slew = <0x01>;

			mt6370_dsvp {
				regulator-name = "dsv_pos";
				regulator-min-microvolt = <0x3d0900>;
				regulator-max-microvolt = <0x5b8d80>;
			};

			mt6370_dsvn {
				regulator-name = "dsv_neg";
				regulator-min-microvolt = <0x3d0900>;
				regulator-max-microvolt = <0x5b8d80>;
			};
		};
	};

	type_c_port0 {
		tcpc-dual,supported_modes = <0x00>;
		mt-tcpc,name = "type_c_port0";
		mt-tcpc,role_def = <0x04>;
		mt-tcpc,rp_level = <0x00>;
		mt-tcpc,vconn_supply = <0x01>;
		mt6370pd,intr_gpio = <0x3c 0x18 0x00>;
		mt6370pd,intr_gpio_num = <0x18>;
		linux,phandle = <0xad>;
		phandle = <0xad>;

		pd-data {
			pd,vid = <0x29cf>;
			pd,pid = <0x5081>;
			pd,source-cap-ext = <0x171129cf 0x00 0x102 0x00 0x00 0x2000000>;
			pd,mfrs = "RichtekTCPC";
			pd,charging_policy = <0x21>;
			pd,source-pdo-size = <0x01>;
			pd,source-pdo-data = <0x19032>;
			pd,sink-pdo-size = <0x02>;
			pd,sink-pdo-data = <0x190c8 0xc0761e3c>;
			pd,id-vdo-size = <0x03>;
			pd,id-vdo-data = <0xd10029cf 0x00 0x10000>;
			bat,nr = <0x01>;
			pd,country_nr = <0x00>;

			bat-info0 {
				bat,vid = <0x29cf>;
				bat,pid = <0x1711>;
				bat,mfrs = "bat1";
				bat,design_cap = <0xbb8>;
			};
		};

		dpm_caps {
			local_dr_power;
			local_dr_data;
			local_usb_comm;
			local_no_suspend;
			local_vconn_supply;
			attemp_enter_dp_mode;
			attemp_discover_cable;
			attemp_discover_id;
			pr_check = <0x00>;
			pr_check_gp_source;
			dr_check = <0x00>;
		};
	};

	__symbols__ {
		chosen = "/chosen";
		cpu0 = "/cpus/cpu@000";
		cpu1 = "/cpus/cpu@001";
		cpu2 = "/cpus/cpu@002";
		cpu3 = "/cpus/cpu@003";
		cpu4 = "/cpus/cpu@100";
		cpu5 = "/cpus/cpu@101";
		cpu6 = "/cpus/cpu@102";
		cpu7 = "/cpus/cpu@103";
		STANDBY = "/cpus/idle-states/standby";
		MCDI_CPU = "/cpus/idle-states/mcdi-cpu";
		MCDI_CLUSTER = "/cpus/idle-states/mcdi-cluster";
		SODI = "/cpus/idle-states/sodi";
		SODI3 = "/cpus/idle-states/sodi3";
		DPIDLE = "/cpus/idle-states/dpidle";
		SUSPEND = "/cpus/idle-states/suspend";
		reserved_memory = "/reserved-memory";
		cpu_dbgapb = "/cpu_dbgapb@0d410000";
		gic = "/interrupt-controller@0c000000";
		sysirq = "/intpol-controller@10200a80";
		infracfg_ao = "/infracfg_ao@10001000";
		scpsys = "/scpsys@10001000";
		topckgen = "/topckgen@10000000";
		syscfg_pctl_1 = "/syscfg_pctl_1@0x10002000";
		syscfg_pctl_2 = "/syscfg_pctl_2@0x10002200";
		syscfg_pctl_3 = "/syscfg_pctl_3@0x10002400";
		syscfg_pctl_4 = "/syscfg_pctl_4@0x10002600";
		syscfg_pctl_5 = "/syscfg_pctl_5@0x10002800";
		syscfg_pctl_6 = "/syscfg_pctl_6@0x10002a00";
		syscfg_pctl_7 = "/syscfg_pctl_7@0x10002c00";
		pericfg = "/pericfg@10003000";
		gpio_usage_mapping = "/gpio";
		gpio = "/gpio@10005000";
		syscfg_pctl_0 = "/syscfg_pctl_0@10005000";
		pio = "/pinctrl@1000b000";
		msdc0_pins_default = "/pinctrl@1000b000/msdc0@default";
		msdc0_pins_hs400 = "/pinctrl@1000b000/msdc0@hs400";
		msdc0_pins_hs200 = "/pinctrl@1000b000/msdc0@hs200";
		msdc0_register_setting_default = "/pinctrl@1000b000/msdc0@register_default";
		msdc1_pins_default = "/pinctrl@1000b000/msdc1@default";
		msdc1_pins_sdr104 = "/pinctrl@1000b000/msdc1@sdr104";
		msdc1_pins_sdr50 = "/pinctrl@1000b000/msdc1@sdr50";
		msdc1_pins_ddr50 = "/pinctrl@1000b000/msdc1@ddr50";
		msdc1_register_setting_default = "/pinctrl@1000b000/msdc1@register_default";
		msdc3_pins_default = "/pinctrl@1000b000/msdc3@default";
		msdc3_register_setting_default = "/pinctrl@1000b000/msdc3@register_default";
		clk26m = "/clocks/clk26m";
		clk32k = "/clocks/clk32k";
		apmixed = "/apmixed@1000c000";
		main_pmic = "/mt-pmic";
		pmic_auxadc = "/mt-pmic/mt635x-auxadc";
		mt_pmic_vs1_buck_reg = "/mt-pmic/buck_regulators/buck_vs1";
		mt_pmic_vmodem_buck_reg = "/mt-pmic/buck_regulators/buck_vmodem";
		mt_pmic_vcore_buck_reg = "/mt-pmic/buck_regulators/buck_vcore";
		mt_pmic_vproc_buck_reg = "/mt-pmic/buck_regulators/buck_vproc";
		mt_pmic_vpa_buck_reg = "/mt-pmic/buck_regulators/buck_vpa";
		mt_pmic_vfe28_ldo_reg = "/mt-pmic/ldo_regulators/ldo_vfe28";
		mt_pmic_vxo22_ldo_reg = "/mt-pmic/ldo_regulators/ldo_vxo22";
		mt_pmic_vrf18_ldo_reg = "/mt-pmic/ldo_regulators/ldo_vrf18";
		mt_pmic_vrf12_ldo_reg = "/mt-pmic/ldo_regulators/ldo_vrf12";
		mt_pmic_vefuse_ldo_reg = "/mt-pmic/ldo_regulators/ldo_vefuse";
		mt_pmic_vcn33_bt_ldo_reg = "/mt-pmic/ldo_regulators/ldo_vcn33_bt";
		mt_pmic_vcn33_wifi_ldo_reg = "/mt-pmic/ldo_regulators/ldo_vcn33_wifi";
		mt_pmic_vcn28_ldo_reg = "/mt-pmic/ldo_regulators/ldo_vcn28";
		mt_pmic_vcn18_ldo_reg = "/mt-pmic/ldo_regulators/ldo_vcn18";
		mt_pmic_vcama_ldo_reg = "/mt-pmic/ldo_regulators/ldo_vcama";
		mt_pmic_vcamd_ldo_reg = "/mt-pmic/ldo_regulators/ldo_vcamd";
		mt_pmic_vcamio_ldo_reg = "/mt-pmic/ldo_regulators/ldo_vcamio";
		mt_pmic_vldo28_ldo_reg = "/mt-pmic/ldo_regulators/ldo_vldo28";
		mt_pmic_vsram_others_ldo_reg = "/mt-pmic/ldo_regulators/ldo_vsram_others";
		mt_pmic_vsram_proc_ldo_reg = "/mt-pmic/ldo_regulators/ldo_vsram_proc";
		mt_pmic_vaux18_ldo_reg = "/mt-pmic/ldo_regulators/ldo_vaux18";
		mt_pmic_vaud28_ldo_reg = "/mt-pmic/ldo_regulators/ldo_vaud28";
		mt_pmic_vio28_ldo_reg = "/mt-pmic/ldo_regulators/ldo_vio28";
		mt_pmic_vio18_ldo_reg = "/mt-pmic/ldo_regulators/ldo_vio18";
		mt_pmic_vdram_ldo_reg = "/mt-pmic/ldo_regulators/ldo_vdram";
		mt_pmic_vmc_ldo_reg = "/mt-pmic/ldo_regulators/ldo_vmc";
		mt_pmic_vmch_ldo_reg = "/mt-pmic/ldo_regulators/ldo_vmch";
		mt_pmic_vemc_ldo_reg = "/mt-pmic/ldo_regulators/ldo_vemc";
		mt_pmic_vsim1_ldo_reg = "/mt-pmic/ldo_regulators/ldo_vsim1";
		mt_pmic_vsim2_ldo_reg = "/mt-pmic/ldo_regulators/ldo_vsim2";
		mt_pmic_vibr_ldo_reg = "/mt-pmic/ldo_regulators/ldo_vibr";
		mt_pmic_vusb33_ldo_reg = "/mt-pmic/ldo_regulators/ldo_vusb33";
		keypad = "/kp@10010000";
		otg_iddig = "/otg_iddig";
		mrdump_ext_rst = "/mrdump_ext_rst";
		touch = "/touch";
		accdet = "/accdet";
		goodix_fp = "/fingerprint";
		bat_gm30 = "/battery";
		iommu = "/m4u@10205000";
		mdcldma = "/mdcldma@10014000";
		gce = "/gce@10238000";
		gce_mbox = "/gce_mbox@10238000";
		gce_mbox_svp = "/gce_mbox_svp@10238000";
		auxadc = "/auxadc@11001000";
		apdma = "/dma-controller@11000580";
		uart0 = "/serial@11020000";
		uart1 = "/serial@11030000";
		i2c_common = "/i2c_common";
		i2c0 = "/i2c0@11007000";
		i2c1 = "/i2c1@11008000";
		i2c2 = "/i2c2@11009000";
		i2c3 = "/i2c3@1100f000";
		i2c4 = "/i2c4@11011000";
		i2c5 = "/i2c5@11016000";
		i2c6 = "/i2c6@1100d000";
		pwm = "/pwm@11006000";
		spi0 = "/spi@1100a000";
		consys = "/consys@18002000";
		spi1 = "/spi@11010000";
		spi2 = "/spi@11012000";
		spi3 = "/spi@11013000";
		spi4 = "/spi@11014000";
		spi5 = "/spi@11015000";
		msdc0 = "/msdc@11230000";
		msdc1 = "/msdc@11240000";
		msdc2 = "/msdc@11250000";
		msdc3 = "/msdc@11260000";
		msdc1_ins = "/msdc1_ins@0";
		audio = "/audio@11220000";
		audgpio = "/mt_soc_dl1_pcm@11220000";
		btcvsd_snd = "/mtk-btcvsd-snd@18050000";
		mipi_rx_ana_csi0a = "/mipi_rx_ana_csi0a@11c10000";
		mipi_rx_ana_csi0b = "/mipi_rx_ana_csi0b@11c11000";
		mipi_rx_ana_csi1a = "/mipi_rx_ana_csi1a@11c12000";
		mipi_rx_ana_csi1b = "/mipi_rx_ana_csi1b@11c13000";
		mipi_rx_ana_csi2a = "/mipi_rx_ana_csi2a@11c14000";
		mipi_rx_ana_csi2b = "/mipi_rx_ana_csi2b@11c15000";
		mfg_cfg = "/mfg_cfg@13ffe000";
		mmsys_config = "/mmsys_config@14000000";
		nfc = "/nfc";
		irq_nfc = "/irq_nfc";
		disp_mutex0 = "/disp_mutex0@14001000";
		imgsys = "/imgsys@15020000";
		smi_larb0 = "/smi_larb0@14003000";
		mdp_rdma0 = "/mdp_rdma0@14004000";
		mdp_ccorr = "/mdp_ccorr0@14005000";
		mdp_rsz0 = "/mdp_rsz0@14006000";
		mdp_rsz1 = "/mdp_rsz1@14007000";
		mdp_wdma0 = "/mdp_wdma0@14008000";
		mdp_wrot0 = "/mdp_wrot0@14009000";
		mdp_tdshp0 = "/mdp_tdshp0@1400a000";
		disp_color0 = "/disp_color0@1400f000";
		mtkfb = "/mtkfb@0";
		dsi_te = "/dsi_te";
		smi_larb2 = "/smi_larb2@15021000";
		venc_gcon = "/venc_gcon@17000000";
		smi_larb1 = "/smi_larb1@17010000";
		camsys = "/camsys@1a000000";
		smi_larb3 = "/smi_larb3@1a002000";
		kd_camera_hw1 = "/kd_camera_hw1@1a040000";
		flashlight_core = "/flashlight_core";
		flashlights_mt6370 = "/flashlights_mt6370";
		flashlights_aw36515 = "/flashlights_aw36515";
		mt_charger = "/mt_charger";
		lk_charger = "/lk_charger";
		charger = "/charger";
		tran_battery = "/tran_battery";
		irtx_pwm = "/irtx_pwm";
		odm = "/odm";
		memory_ssmr_features = "/memory-ssmr-features";
		pmic_clock_buffer_ctrl = "/pmic_clock_buffer_ctrl";
		i2c7 = "/i2c7";
		i2c8 = "/i2c8";
		i2c9 = "/i2c9";
		smart_pa = "/smart_pa";
		md1_sim1_hot_plug_eint = "/md1_sim1_hot_plug_eint";
		md1_sim2_hot_plug_eint = "/md1_sim2_hot_plug_eint";
		radio_md_cfg = "/radio_md_cfg";
		dynamic_options = "/dynamic_options";
		mt6370_pmu = "/mt6370_pmu_dts";
		mt6370_typec = "/type_c_port0";
	};
};
